/*
 * gbemu.ino — Game Boy (DMG) эмулятор для этой консоли. ВЕРСИЯ 9.7.2
 *              RP2040 + ST7789 240x240 (SPI0) + 9 кнопок
 *
 * Ядро: Peanut-GB (deltabeard/Peanut-GB, zlib). peanut_gb.h — рядом со скетчем,
 *       он специально подготовлен: горячий код ядра можно исполнять из ОЗУ.
 * ROM : rom.h генерируется скриптом make_rom_header.py / .ps1 из вашего .gb.
 *
 * ===========================================================================
 * ГЛАВНОЕ В ЭТОЙ ВЕРСИИ (9.7.2)
 *
 * 0) НАСТРОЙКИ НАКОНЕЦ СОХРАНЯЮТСЯ (баг «не сохраняются после перезапуска»).
 *    Запись настроек шла во flash БЕЗ защиты: на время стирания flash выключен из
 *    шины, прерывание звука зовёт код из flash — чип падал (консоль
 *    «перезагружалась» вместо выключения), а сектор уже был стёрт — настройки
 *    пропадали. Теперь запись защищена как все остальные (тихо + без прерываний),
 *    сверяется с подтверждением (не сошлось — повтор), и настройки дополнительно
 *    пишутся при старте игры, если менялись (переживут даже reset).
 *
 * ГЛАВНОЕ В ЭТОЙ ВЕРСИИ (9.7.1)
 *
 * 0) ЧИСТЫЙ ЭКРАН ПРИ ВКЛЮЧЕНИИ (баг «следы прошлого кадра»). На экране оставалась
 *    цифра отсчёта выключения (или цветной шум) и стиралась только при движении
 *    картинки. Причина: тест-кадр смены частоты SPI шёл ДО инициализации панели и
 *    «закрывал» кэш диффа строк — из-за этого стартовая зачистка экрана пропускала
 *    все 240 строк, и в GRAM панели жил кадр выключения. Теперь: тест-кадр только
 *    после инициализации, кэш сбрасывается в конце lcdInit, зачистка шлёт всё.
 *
 * ГЛАВНОЕ В ЭТОЙ ВЕРСИИ (9.7)
 *
 * 0) НАСТРОЙКИ ПЕРЕЖИВАЮТ ВЫКЛЮЧЕНИЕ. Всё, что накрутил пользователь (свет
 *    панели, яркость палитры, контраст, громкость, палитра, инверсия, звук,
 *    частота панели), пишется в последний сектор flash при штатном выключении
 *    и восстанавливается при включении (раньше сбрасывалось каждый запуск).
 * 1) ПАЛИТРА BLUE — тёмно-синяя, под цвет корпуса (замер по фото при свете:
 *    пластик #001030..#2C3E68; самый светлый шаг ≈ освещённый корпус).
 * 2) МЯГКИЙ ЛИМИТ ГРОМКОСТИ 10%: крутилка в меню не выкручивает выше (выше —
 *    ток усилителя роняет питание и подсветку; громче в этой консоли не нужно).
 * 3) ВЫКЛЮЧЕНИЕ ВЕЗДЕ: держать START/MENU 3 с можно и в списке игр, и в меню
 *    (раньше — только в игре; отсюда вопрос «как выключить, не заходя в игру»).
 * 4) СТАРТ БЕЗ RESET (смягчение бага «после выключения не стартует, пока не
 *    ткнуть RESET»): сторож включается СРАЗУ при подаче питания (раньше —
 *    почти в конце загрузки: зависание на старте висело навсегда). Теперь
 *    зависание на старте перезагрузит консоль саму через ~4 с, в журнале
 *    (Serial) будет видно, где встали. Плюс мягкий старт подсветки (всплеск
 *    тока на старте сглажен).
 *
 * ГЛАВНОЕ В ЭТОЙ ВЕРСИИ (9.6)
 *
 * 0) МЕРЦАНИЕ ЭКРАНА В ТАКТ ЗВУКУ УХОДИТ (главное). Как только журчание стало
 *    почти незаметным, стало видно следующий эффект: при включённом звуке
 *    экран/подсветка мерцает по громкости музыки (сильнее на слабой батарее:
 *    3,31 В = 1 деление). Это физика: ток усилителя пропорционален размаху
 *    звукового сигнала, питание «дышит» в такт музыке, подсветка сидит на той
 *    же шине. Убираем обе части эффекта:
 *    а) ШИМ ПОДСВЕТКИ -> 25 кГц (ультразвук): 1 кГц сам по себе видимо мерцает
 *       и усиливает восприятие; на 25 кГц мерцания ШИМ не существует.
 *    б) МЯГКИЙ ОГРАНИЧИТЕЛЬ ПИКОВ ЗВУКА: всё, что громче 120 уровней ШИМ,
 *       сжимается 3:1 (тише становятся ТОЛЬКО самые громкие пики, музыка почти
 *       не меняется) — размах тока усилителя и, значит, «дыхание» питания меньше.
 *    Полностью убрать мерцание на севшей батарее может только железо
 *    (конденсатор по питанию усилителя) — но оно должно стать редким и слабым.
 * 1) Строка сборки (GBEMU_BUILD) наконец догоняет версию: в v9.5 она осталась
 *    «v9.4» (в 's' печаталась старая).
 *
 * ===========================================================================
 * ГЛАВНОЕ В ЭТОЙ ВЕРСИИ (9.5)
 *
 * 0) ЖУРЧАНИЕ ПОД МУЗЫКОЙ УХОДИТ: РЕЖЕМ НАВОДКУ ОТ ШИНЫ ПАНЕЛИ (главное).
 *    А/Б-тест v9.4 (o + f = SPI 20,8 МГц + 30 кадр/с «существенно тише»)
 *    подтвердил: источник журчания — трафик SPI/нагрузка панели, наводящиеся
 *    на усилитель. Почему в стоке было тихо: сток ДЕРЖАЛ усилитель заглушённым
 *    (GP20 = HIGH) и пищал короткими сигналами, а не сплошной музыкой, —
 *    наводка существовала всегда, просто не усиливалась. Теперь мы гасим саму
 *    наводку:
 *    а) КАДРОВЫЙ ДИФФ: неизменившиеся строки кадра в панель НЕ шлём вообще
 *       (строка сравнивается с прошлым кадром по хэшу готовых байтов; полосы,
 *       HUD и статичные зоны молчат). Строки идут сериями — у каждой серии
 *       своё окно панели (пропуски ломают автоинкремент курсора).
 *    б) ШИНА 62,5 МГц ПО УМОЛЧАНИЮ (было 125): фронт данных мягче, тактов
 *       меньше. Клавиша o — цикл: 62,5 -> 41,7 -> 20,8 -> 125.
 *    Вместе с гейтом усилителя (v9.4: 2 с тишины — глушим) журчание под
 *    музыкой должно уйти. Если осталось слышно — следующий кандидат ШИМ
 *    подсветки на 1 кГц (analogWriteFreq), но сначала — эта сборка.
 * 1) AMP по-прежнему не в меню (HIGH = просто глухо, рабочий режим только LOW).
 *
 * ===========================================================================
 * ГЛАВНОЕ В ЭТОЙ ВЕРСИИ (9.4)
 *
 * 0) ЖУРЧАНИЕ — ЭТО НАВОДКА ОТ НАГРУЗКИ, И ОНО УХОДИТ ВМЕСТЕ С ТИШИНОЙ.
 *    Ваши А/Б-тесты всё расставили по местам: в меню (игра стоит, панель молчит)
 *    журчания нет даже при включённом усилителе, а при volume 0 (игра идёт)
 *    журчание остаётся — значит дело НЕ в звуковом сигнале, а в наводке от
 *    процессора игры и SPI-панели на усилитель. Поэтому возвращаем стоковое
 *    поведение GP20: LOW только на время звука, после 2 с настоящей тишины
 *    усилитель глушится — и наводка вместе с ним. Включение — только вместе с
 *    мягким входом (12 мс), щелчков вкл/выкл нет: тишина детектируется по
 *    DC-блокеру (постоянка каналов больше не держит усилитель включённым —
 *    в v9.2 из-за неё он щёлкал на паузах). Если под МУЗЫКОЙ журчание слышно —
 *    это уже железо (питание усилителя); проверка без паяльника: на паузе
 *    клавиши o (SPI 20,8 МГц) и f (30 кадр/с) — если тише, источник шина панели.
 * 1) AMP по-прежнему не в меню: HIGH = просто глухо, выбирать нечего.
 *
 * ===========================================================================
 * ГЛАВНОЕ В ЭТОЙ ВЕРСИИ (9.3)
 *
 * 0) ЗВУК БЕЗ ТРЕСКА (главное). На паузе/в тишине слышался фоновый «треск,
 *    будто журчит» — три причины, все убраны:
 *    а) УСИЛИТЕЛЬ ЩЁЛКАЛ. GP20 опускался только пока шёл звук («как в стоке»),
 *       и на каждой паузе усилитель щёлкал вкл/выкл — отсюда треск. Теперь
 *       GP20 = LOW всё время, пока звук включён (проба звука: LOW = звук).
 *       Режим AMP из меню убран: правильный уровень только LOW.
 *    б) ПОСТОЯНКА ОТ КАНАЛОВ. Канал «включён, но молчит» давал −15 уровней
 *       смещения: динамик подмагничивался, каждое вкл/выкл канала — щелчок.
 *       Теперь на выходе цифровой «разделительный конденсатор» (ФВЧ ~35 Гц).
 *    в) АЛИАСИНГ. Шумовой (LFSR) и прямоугольные каналы брались точкой на
 *       22 кГц — высокие частоты сворачивались в «журчание». Теперь семпл
 *       усредняется за период (boxcar): высокие ноты честно приглушаются,
 *       как через динамик настоящего DMG. Плюс прерывание звука поднято
 *       в приоритете над USB — тайминг семплов стабильнее.
 *       Меню/пауза больше не рвут сигнал обрывом на IDLE — гасим за ~12 мс.
 * 1) ПАЛИТРА BLUE — в цвет корпуса, и она же теперь умолчание.
 * 2) КОНТРАСТ ПО УМОЛЧАНИЮ 120 % (было 140 — многовато).
 * 3) МЕРЦАНИЕ ЭКРАНА шло за громкостью (уходило на volume 0) — это была
 *    нагрузка усилителя: GP20 щёлкал, ток прыгал, подсветка мигала. С постоянным
 *    GP20 = LOW нагрузка ровная. Если мерцание вернётся — следующий кандидат
 *    ШИМ подсветки на 1 кГц (analogWriteFreq).
 *
 * ===========================================================================
 * ГЛАВНОЕ В ЭТОЙ ВЕРСИИ (9.2)
 *
 * 0) ФУЛСПИД ВЕРНУЛСЯ. v9.1 тихо собрался на 133 МГц с -Os (флаги build_flags
 *    проиграли флагам платформы) — игра шла на 75 % скорости. Теперь частота
 *    задаётся правильно (board_build.f_cpu), платформа зафиксирована на теге,
 *    а в коде стоят сторожа сборки: медленный билд не линкуется, а падает
 *    с понятной ошибкой. Такое больше не повторится.
 * 1) ЯРКОСТЬ БАТАРЕЕЙ НЕ ТРОГАЕМ ВООБЩЕ. Потолок по заряду и автосброс при
 *    просадке удалены: яркость — только крутилка LIGHT, скорость — всегда
 *    полная. Индикатор батареи, вольты, LOW и предупреждения в Serial остались.
 *    Честно: на слабой батарее вместо затемнения теперь возможен внезапный
 *    сброс внешней схемой — это железо, лечится зарядкой.
 *
 * ===========================================================================
 * ГЛАВНОЕ В ЭТОЙ ВЕРСИИ (9.1)
 *
 * 0) СЕЙВЫ НЕ УДАЛЯЮТСЯ МОЛЧА. Запуск игры, вытесняющей чужой сейв, — только
 *    с вопросом (показываем, чей сейв пострадает: A — заменить, B — назад).
 *    Перезапись чужого сейвстейта — тоже с вопросом. Автозапуск при включении
 *    в такой ситуации не стартует молча, а открывает список игр.
 * 1) ВИДНО, ГДЕ СЕЙВЫ: в списке игр квадратик ярче и шире, если сейв уже лежит;
 *    в меню слоты стейтов помечены (* — мой, X — чужой, пусто — свободен).
 *
 * ===========================================================================
 * ГЛАВНОЕ В ЭТОЙ ВЕРСИИ (9.0)
 *
 * 0) ОБЛАСТЬ ИГР ПЕРЕЕХАЛА ВНИЗ: 0x100000 -> 0x80000. Прошивка занимает всего
 *    ~135 КБ, а граница стояла на 1 МБ — полмегабайта пустовало. Теперь под игры
 *    1516 КБ (было 1004): влезают образы до 1 МБ (покемоны!) и ~47 мелких игр.
 * 1) МАГИЯ ТАБЛИЦЫ GMR1 -> GMR2: старые наборы новая прошивка честно не видит
 *    (экран NO ROM) — их надо пересобрать новым упаковщиком. Сейвы SRAM
 *    и сейвстейты лежат ниже новой границы сами (стража уже была на ROMS_TABLE_OFF).
 *
 * ===========================================================================
 * ГЛАВНОЕ В ЭТОЙ ВЕРСИИ (8.9y)
 *
 * 0) СКОРОСТЬ ИГРЫ НЕ ТРОГАЕМ НИКОГДА. Автосброс нагрузки переведён с панели
 *    на подсветку: при просадке яркость временно падает до 50 % (потом сама
 *    возвращается), панель всегда на выбранной частоте. Стартовое прибивание
 *    панели на 62,5 МГц убрано.
 * 1) ПОТОЛОК ЯРКОСТИ ПО ЗАРЯДУ: сегменты 4-3 — без ограничений, 2 — 75 %,
 *    1 — 60 %, 0 — 50 % (в 0 — никогда). В меню такой LIGHT помечен BAT.
 *    На зарядке потолок снимается сам.
 *
 * ===========================================================================
 * ГЛАВНОЕ В ЭТОЙ ВЕРСИИ (8.9x)
 *
 * 0) БАТАРЕЯ НЕ ПРЫГАЕТ: вольты сглаживаются (~8 с), иконка — 4 сегмента
 *    с гистерезисом 25 мВ (была сплошная заливка от мгновенного замера, а шина
 *    гуляет ±100 мВ — иконка скакала снизу доверху). LOW/красный — тоже
 *    по сглаженному, без мигания.
 * 1) ИКОНКА В ИГРЕ С ОТСТУПОМ: 8 px в 12-пиксельной полосе (по 2 px чёрного
 *    сверху и снизу), к картинке больше не прилипает.
 * 2) ПОРОГ «СЛАБАЯ БАТАРЕЯ» 3,64 -> 3,50 В: при норме этой платы (3,61 В)
 *    консоль стартовала на 62,5 МГц и подсветке 78 % вместо 125 МГц и 100 %.
 *
 * ===========================================================================
 * ГЛАВНОЕ В ЭТОЙ ВЕРСИИ (8.9w)
 *
 * 0) КАЛИБРОВКА БАТАРЕИ ПОД ЭТУ ПЛАТУ: 100 % = 3,62 В (было 3,80 — из-за этого
 *    свежая батарея 3,61 В выглядела «наполовину пустой», а 3,58 В после пяти
 *    минут игры — «половина съедена»). Пусто и LOW — по-прежнему 3,30 В.
 * 1) ИНДИКАТОР В ИГРЕ МИНИМАЛИСТИЧНЫЙ: только иконка, без цифр (цифры мельтешили
 *    и отвлекали). Цвет — приглушённый светлый цвет текущей палитры (под каждую
 *    игру свой оттенок, из картинки не выбивается), разряд — красным.
 *
 * ===========================================================================
 * ГЛАВНОЕ В ЭТОЙ ВЕРСИИ (8.9v)
 *
 * 0) БАТАРЕЯ ВЕЗДЕ. В игре — индикатор в нижней чёрной полосе (иконка + вольты,
 *    при разряде красным + LOW); в шапках меню и списка игр — иконка + вольты
 *    (были только цифры). Замер — раз в секунду, полоса игры не страдает.
 * 1) ЗАСТАВКА ЧЕСТНАЯ: на старте со списком игр — «SELECT GAME» вместо названия
 *    прошлой игры; строка SAVES: AUTO убрана; «HOLD START 3S» заменено на
 *    «HOLD START = OFF» (3S читалось как 35: S и 5 в шрифте 3x5 одинаковые).
 * 2) Заливка иконки батареи — самым тёмным оттенком (на светлом фоне видно лучше).
 *
 * ===========================================================================
 * ГЛАВНОЕ В ЭТОЙ ВЕРСИИ (8.9u)
 *
 * 0) МЕНЮ ПОДСВЕТКИ ЧЕСТНОЕ. Строка BRIGHT показывала 78 % при «яркости 100» —
 *    это были ДВЕ разные яркости: подсветка (железо, 200/255 = 78 %) и яркость
 *    палитры (софт, 100 %). Теперь строка называется LIGHT и показывает именно
 *    подсветку, а умолчание — 255 (100 %). Если батарея слабая, при включении
 *    подсветка сама опускается до 200 (в меню LIGHT можно вернуть обратно).
 *    Проба звука и неудачное выключение больше не сбрасывают подсветку на 200.
 * 1) ГРОМКОСТЬ ПО УМОЛЧАНИЮ 10 % (было 30).
 * 2) ШРИФТ 3x5: добавлены J Q Z ( ) . , * _ ' — «ZELDA» больше не выглядит как
 *    полоски. Неизвестный знак теперь рисуется как '?', а не '='.
 * 3) ЗАСТАВКА БЕЗ SERIAL-МУСОРА: только настоящие кнопки (MENU = опции,
 *    HOLD START = выключение, сейвы авто) + индикатор батареи.
 * 4) ИНДИКАТОР БАТАРЕИ НА ЭКРАНЕ: иконка + вольты на заставке, вольты в шапке
 *    меню и списка игр. Читается канал A3 (GP29) — тот же, что у ловушки
 *    просадки в прерывании звука, поэтому гонки с прерыванием нет.
 *
 * ===========================================================================
 * ГЛАВНОЕ В ЭТОЙ ВЕРСИИ (8.9t)
 *
 * 0) ДЕФОЛТЫ, КАК ВЫ ПРОСИЛИ: яркость 100 %, контраст 140 %, громкость 30 %,
 *    палитра AMBER.
 * 1) ПРОБА ЗВУКА СПРЯТАНА. Нажатие z больше ничего не запускает: сначала предупреждение,
 *    запуск — повторным z в течение 5 с. И выход из пробы теперь есть ВСЕГДА: кнопка A
 *    или B, любая клавиша в терминале, 20 с без действий — проба кончается сама.
 *    Ресет (зубочистка) для выхода не нужен.
 * 2) ПОМЕХА АЦП БОЛЬШЕ НЕ ВЫГЛЯДИТ КАК ПРОСАДКА. В логе v8.9r были «просадки» до
 *    1,12 В и «просадка 2583 мВ» при живой батарее 3,7 В — это грязь при переключении
 *    канала. Теперь: отсчёты ниже 2,0 В отбрасываются (при таком питании чип бы уже
 *    не работал), а просадкой считается низкий участок длиной >= 10 мс (настоящая
 *    просадка под нагрузкой держится десятки мс). После перебора каналов пропускаем
 *    4 отсчёта вместо одного.
 * 3) ТЕМПЕРАТУРА ЧЕСТНО. Датчик этой платы врёт: сразу после включения он даёт 0,566 В,
 *    что по формуле даташита = 108 °C — так не бывает. Теперь база — самый холодный
 *    замер сеанса (комнатная температура), а в лог идёт НАГРЕВ: «нагрев чипа +12 °C
 *    к базовому». Предупреждение — при +55 °C. Абсолютная цифра печатается справочно
 *    с пометкой, что верить ей нельзя.
 * 4) Отчёт о прошлом запуске не печатает мусор из записи старого формата
 *    («панель: МГц, ступеней вниз 255, возвратов 65535»).
 *
 * ГЛАВНОЕ В ЭТОЙ ВЕРСИИ (8.9s)
 *
 * 0) АВТОСБРОС НАГРУЗКИ БОЛЬШЕ НЕ СЪЕДАЕТ СКОРОСТЬ. Он делал ДВЕ ступени
 *    (125 -> 62,5 -> 41,7 МГц), и вторая ступень оставляла 46 кадр/с — это и есть
 *    «76 % скорости» при активном геймплее. Теперь автоматически берётся РОВНО ОДНА
 *    ступень: 125 -> 62,5 МГц (это ~90-96 % кадров). И сразу после неё прошивка
 *    ПРОВЕРЯЕТ, помогло ли:
 *      – помогло (просадки прекратились) — панель остаётся на 62,5 и вернётся на 125,
 *        как только станет тихо (правило 2 минут из v8.9r);
 *      – НЕ помогло (просадки идут дальше) — дело не в панели: частота возвращается
 *        на 125 МГц (скорость не отдаём зря), в лог уходит честная строка про
 *        батарею/контакты, и в этом сеансе панель автоматически больше не трогаем
 *        (руками — клавиша o).
 *    До 41,7 МГц прошивка сама не опускается НИКОГДА: эту частоту можно поставить
 *    только руками клавишей o, если вы сознательно предпочитаете запас питания кадрам.
 *    В статусе рядом с процентами теперь печатается частота панели — причина видна.
 *
 * ГЛАВНОЕ В ЭТОЙ ВЕРСИИ (8.9r)
 *
 * 0) «ПРОИЗВОДИТЕЛЬНОСТЬ УПАЛА» — это сработал автосброс нагрузки (125 -> 62,5 -> 41,7
 *    МГц), он в вашем логе сработал дважды. Теперь автосброс ДВУСТОРОННИЙ:
 *      – если просадка повторилась (панель уже опущена) — опускаем ещё на ступень;
 *      – если 2 минуты тихо и холостая батарея не ниже 3,62 В — возвращаем ступень
 *        НАВЕРХ (в логе «ПИТАНИЕ ВЫПРАВИЛОСЬ: возвращаю панель на 125 МГц»);
 *      – после просадки возврат запрещён на 2 минуты, чтобы частота не дёргалась.
 *    И ещё: решение о просадке теперь принимается по ДВУМ замерам подряд (одиночный
 *    выброс АЦП — не просадка). Раньше одного «клюнувшего» отсчёта хватало, чтобы
 *    уронить панель: отсюда и потеря кадров.
 * 1) ТЕМПЕРАТУРА ЧИПА: в стартовом логе и в 's' печатается температура кристалла в
 *    градусах, а если она поднимется выше 85 °C — раз в минуту предупреждение. Раньше
 *    мы печатали милливольты датчика (0,57 В), по которым выходило «~100 °C» — это был
 *    мусор первого отсчёта после переключения канала; теперь датчику дают устояться.
 * 2) БАННЕР ПЕЧАТАЛ НЕ ТУ ВЕРСИЮ: в логе было «v8.9p», хотя внутри работал v8.9q.
 *    Теперь версия одна на весь скетч (GBEMU_BUILD) и печатается ещё и в 's'.
 *
 * ГЛАВНОЕ В ЭТОЙ ВЕРСИИ (8.9q)
 *

 * 0) В ИГРЕ ВО FLASH НЕ ПИШЕМ ВООБЩЕ. В v8.9p я отложил выгрузку чёрного ящика на
 *    «пару секунд, когда питание выправится» — и все пять сбросов в вашем логе
 *    оборвались РОВНО на строке «ящик: выгружаю во flash отметок …», то есть на
 *    стирании сектора. Стирание — это ~50 мс, за них батарея садится ниже порога
 *    внешней схемы, и та сбрасывает чип по RUN. Поэтому:
 *      – в игре во flash не пишем НИЧЕГО (ни чёрный ящик, ни «какая игра»);
 *      – «какая игра» пишется в СПИСКЕ ИГР — в момент выбора, пока эмулятор ещё не
 *        запущен (экран списка статичен, звук молчит) — или при выключении, если
 *        питание в тот момент было просевшим;
 *      – любая запись в flash идёт «тихо»: на время стирания гаснет подсветка и
 *        глушится усилитель (главные потребители). Экран на 0,1–0,6 с темнеет —
 *        это плата за то, что консоль не выключается;
 *      – автосброс нагрузки работает ЗАРАНЕЕ: мягкий порог 3,55 В роняет панель
 *        125 -> 62,5 -> 41,7 МГц (клавиша a — выключить);
 *      – если батарея при включении ниже нормы, панель сразу идёт на 62,5 МГц;
 *      – отчёт о причине сброса больше не валит всё на сторожа: если сброс пришёл по
 *        выводу RUN, так и написано (раньше «перезагрузка от сторожа» печаталась
 *        просто потому, что сторож был заведён — это разные вещи).
 *
 * ГЛАВНОЕ В ЭТОЙ ВЕРСИИ (8.9p)
 *
 * 0) МЯГКИЙ СТАРТ И ЗАЩИТА ОТ ПРОСАДКИ ПИТАНИЯ. По логам с консоли (игры умирали
 *    через ~0,5 с после запуска) видно: сброс приходил ПО ВЫВОДУ RUN, защёлка питания
 *    держалась, а перед смертью ловушка ловила батарею 3,46 В при холостых 3,71 В.
 *    То есть умирает не программа, а питание — ровно в тот момент, когда нагрузка
 *    делает шаг вверх (ядро 100 %, панель 125 МГц, включился звук с усилителем).
 *    Сделано:
 *      – в обработчике просадки БОЛЬШЕ НЕТ записи во flash (было: перебор АЦП +
 *        выгрузка чёрного ящика = стирание и запись сектора на просевшем питании);
 *      – автоматические записи (автосейв, ящик, «какая игра») идут только при живом
 *        питании (порог 3,55 В); явные команды пользователя пишут всегда;
 *      – запуск игры flash не трогает вообще: «какая игра» пишется через 4 с, между
 *        кадрами (romStateTick);
 *      – мягкий старт: 0,4 с эмуляции без панели + вход громкости за 2 с;
 *      – мерка просадки: через 2,5 с после запуска игры в лог уходит «питание после
 *        запуска игры: X В (лучшее) .. Y В (худшее) => просадка Z мВ»;
 *      – автосброс нагрузки при просадке: панель 125 -> 62,5 МГц (клавиша a — вкл/выкл).
 *
 * ГЛАВНОЕ В ЭТОЙ ВЕРСИИ (8.9o)
 *
 * 0) НЕСКОЛЬКО ИГР В КОНСОЛИ (меню ROM'ов). Игры больше не вшиваются в прошивку:
 *    их кладёт в свою область flash Python-упаковщик tools/roms_pack/make_roms_uf2.py
 *    (пользователь запускает его сам, файлы никуда не уходят). Область фиксированная —
 *    0x100000…0x1FD000 (0x100000 — таблица игр, 0x101000 — «какая игра выбрана»,
 *    0x102000 — сами образы) — поэтому она НЕ сдвигается от размера прошивки, а
 *    прошивка её НИКОГДА не пишет: новый скетч не стирает ни игры, ни сейвы.
 *      Экран выбора: при включении (если игр больше одной) и по клавише c, а также
 *      через меню (m) — пункт GAMES. Управление: UP/DOWN — выбор, A — играть, B — назад.
 *      Сейвы SRAM — по игре: до SAVE_BANKS (4) ячеек, каждая узнаётся по CRC32 образа,
 *      так что у каждой игры свой сейв; сейв встроенной игры (rom.h) тоже не теряется.
 *      Износ flash: список игр не пишет во flash вообще, «какая игра» — один сектор и
 *      только при смене игры. Выключение на 3 с по-прежнему: сейв SRAM пишется перед ним.
 *
 * ГЛАВНОЕ В ЭТОЙ ВЕРСИИ (8.9h)
 *
 * 0) ВЫВОД СТРОК ЧЕРЕЗ DMA (главное в 8.9m): ядро больше не ждёт панель. Было ~9 мс
 *    синхронного ожидания на кадр (в логе «из них синхронно 9,0 мс») — из-за этого игра
 *    шла на 75 % темпа и звук «подтормаживал». Теперь строка копируется в буфер и уходит
 *    через DMA, а ядро считает следующий кадр. Клавиша u — сравнить с прежним выводом.
 *
 * 0-0) ПРИЧИНА СМЕРТИ ЧЕРЕЗ 3 СЕКУНДЫ НАЙДЕНА (главное в 8.9k).
 *    Опыт: с выключенным ящиком (v8.9i, DOWN) и с ящиком «только в ОЗУ» (v8.9j, UP)
 *    консоль играет ДОЛГО (в UP — 4600+ кадров, меню, сейвстейты, автосейвы, штатное
 *    выключение). А с записью в ящик во flash — умирает на первом же кадре.
 *    В логе видно точно: запись страницы в НАЧАЛЕ цикла (панель свободна) проходит,
 *    а запись ВНУТРИ кадра (окно панели открыто) — и сразу сброс по RUN.
 *    Вывод: важна не сама запись во flash, а её МЕСТО: внутри открытого окна панели.
 *    Поэтому с v8.9k по умолчанию в игре во flash не пишем вообще (отметки в ОЗУ,
 *    во flash — при выключении), а режим START даёт выгрузку МЕЖДУ кадрами.
 *
 * 0-0) ЧЁРНЫЙ ЯЩИК: кольцо в ОЗУ (v8.9j).
 *    Опыт: с выключенным ящиком (режим DOWN) консоль играет нормально, а с включённым
 *    перезагружается по выводу RUN через доли секунды после начала игры. Ящик был
 *    единственным, кто трогал flash в игре: раз в 0,25 с запись страницы и раз в ~4 с
 *    СТИРАНИЕ СЕКТОРА. Теперь отметки идут в кольцо В ОЗУ, во flash — только страница
 *    без стираний, а всё кольцо уходит во flash при выключении и в отчёте о смерти.
 *    Проверки: UP при включении — ящик только в ОЗУ; A — как раньше (со стираниями).
 *
 * 0-1) ПРИБОР «ГДЕ ПАДАЕТ ПИТАНИЕ». Во всех запусках лог показывает одно и то же:
 *    защёлка питания (GPIO1) держится, снимали питание 0 раз, батарея 3,77 В, а
 *    сброс приходит ПО ВЫВОДУ RUN (HAD_RUN=1) через ~3 с после начала потока кадров.
 *    Значит питание, скорее всего, коротко проседает — мелко для внутреннего порога
 *    чипа (HAD_POR=0), но достаточно внешней схеме, чтобы дёрнуть RUN.
 *    Поэтому: батарея читается В ПРЕРЫВАНИИ ЗВУКА 2 777 раз в секунду (без ожидания
 *    АЦП!), минимум/максимум за 0,25 с и глубочайший провал за сеанс пишутся в каждую
 *    запись чёрного ящика, а при просадке ниже 3,46 В в лог уходит строка
 *    «ПРОСАДКА ПИТАНИЯ». Режим RIGHT при включении — «тихая панель» (SPI 20,8 МГц).
 *
 * ===========================================================================
 * ГЛАВНОЕ В ЭТОЙ ВЕРСИИ
 *
 * 1) ПИТАНИЕ — как в стоковой прошивке. Разобран дамп: сток при выключении
 *    сбрасывает пин GPIO1 (это ключ питания, «защёлка»), а GPIO12 — в 0.
 *    Именно поэтому после прошлой версии консоль «зависала»: xosc_dormant()
 *    останавливал кварц, ядро замирало, но защёлка держала питание.
 *      ВЫКЛЮЧЕНИЕ: зажать START (или MENU) ~1 с → отсчёт 3-2-1 → питание СНИМАЕТСЯ.
 *      ВКЛЮЧЕНИЕ : зажать START ~1 с — как в стоке (защёлка взводится кнопкой).
 *    Скетч первым делом, ещё до Serial, поднимает GPIO1 → питание держится.
 *
 * 2) СЕЙВЫ. Внутренняя память картриджа (SRAM) теперь сохраняется в flash
 *    и восстанавливается при включении — Zelda больше не начинается сначала.
 *    Автосейв раз в 30 с (если игра что-то записала), плюс при сбросе игры,
 *    выключении и по команде 'w'.
 *
 * 3) СКОРОСТЬ. Строка панели уходит прямо в FIFO SPI, ПО БАЙТУ. (В v8.5 строки
 *    грузились 32-битными словами — и терялось 3 байта из 4: FIFO 16-битная, одна
 *    запись = одна запись FIFO, при 8-битных кадрах это ровно один байт. Отсюда
 *    была «четверть картинки, ниже мусор».) Плюс:
 *      • ядро исполняется из ОЗУ (не из flash) — самый большой выигрыш;
 *      • в горячих циклах нет делений;
 *      • режим 30 кадр/с ('f') больше не гонит данные на пропущенных кадрах.
 *    ВАЖНО: Tools → Optimize → «Fastest (-O3)» и CPU Speed → 250 MHz.
 *
 * 4) ПАЛИТРА. 6 палитр ('g'), регулировки на ходу: '[' ']' яркость,
 *    '-' '=' контраст, 'i' инверсия оттенков, 'k' — экран проверки 4 оттенков.
 *
 * 5) ПОЛОСЫ. Экран всегда пишется целиком (240 строк), верх/низ — чёрные.
 * ===========================================================================
 *
 * 6) БЫСТРОЕ МЕНЮ по кнопке MENU (как в стоке!) — яркость, контраст, палитра,
 *    инверсия, сейвстейты (2 слота), сброс, тест звука, выход в игру.
 *    Управление: UP/DOWN — выбор, LEFT/RIGHT — значение, A — выполнить, B — выход.
 *    Удержание START или MENU 3 секунды — выключение (как в стоке, с отсчётом).
 *
 * 7) СЕЙВСТЕЙТЫ: мгновенное сохранение/загрузка в любой момент (2 слота во flash).
 *    Скетч печатает карту flash: сколько занято прошивкой, ROM, сейвами и сколько
 *    остаётся под другие игры (под мульти-ROM).
 *    В v7 исправлена причина «SAVED SLOT 1 -> EMPTY SLOT 1»: pico-sdk требует,
 *    чтобы запись во flash шла со смещения, кратного 256, и длиной, кратной 256.
 *    У нас структура gb_s = 16916 Б, и запись SRAM начиналась со смещения
 *    +20 байт от границы страницы — хвост структуры затирался началом SRAM.
 *    Теперь все записи идут целыми страницами через буфер-сборщик (см. ssSave).
 *
 * 8) ЗВУК. В стоке звук выходит ШИМ-ом на GPIO17 (слайс 0, TOP = 689, тишина —
 *    уровень 344), плюс есть подозрение, что усилитель разрешается пином GP20
 *    (сток опускает его в 0, когда пищит). У нас теперь работает настоящий APU
 *    Game Boy (файл apu_gb.h): 2 прямоугольных канала, волновой, шумовой,
 *    конверты, длина, свип, микшер NR50/NR51. Ядро peanut отдаёт нам регистры
 *    звука через хук ENABLE_SOUND/audio_write, а семплы считаются в прерывании
 *    по таймеру (22222 Гц) — независимо от скорости эмуляции.
 *    В меню: SOUND ON/OFF, VOLUME, AMP (уровень GP20 при включённом звуке).
 *    Клавиша z — проба звука (СПРЯТАНА, v8.9t): одно нажатие только предупреждает,
 *    запуск — повторным z в течение 5 с. Выход — кнопка A/B, любая клавиша терминала
 *    или 20 с без действий; ресет для выхода не нужен.
 *
 * КОМАНДЫ SERIAL (115200):   t тест кнопок   l обучение   p пауза   r сброс
 *   f 30 кадр/с   g палитра   k тест оттенков   i инверсия   [ ] яркость
 *   - = контраст   s статус   w сохранить SRAM   m меню
 *   1 / 2 сохранить сейвстейт в слот 1/2,  3 / 4 загрузить
 *   z z — проба звука (дважды! 6 опытов; выход — A/B или любая клавиша)   v статистика кадра
 *   j тест вывода (0 норма / 1 старый цикл / 2 без цветов / 3 без вывода)
 *   n интерлейс ядра (только опыты: картинка неполная, строк выходит вдвое меньше)
 *   x звук вкл/выкл
 *   b загрузчик BOOTSEL   q ВЫКЛЮЧИТЬ   h справка
 */

#include <Arduino.h>
#include <SPI.h>
#include <stdio.h>

#include "hardware/clocks.h"     // clk_peri: именно он ограничивал частоту SPI панели
#include "hardware/dma.h"        // в нём же приходят DREQ_* (hardware/regs/dreq.h)
#include "hardware/flash.h"
#include "hardware/irq.h"        // v9.3: приоритет прерывания таймера звука
#include "hardware/gpio.h"
#include "hardware/pwm.h"
#include "hardware/adc.h"                        // датчик питания: АЦП, канал 4 (GP29)
#include "hardware/spi.h"
#include "hardware/watchdog.h"   // сторож: если консоль встанет, она перезагрузится сама
#include "pico/time.h"

// Горячие функции вывода кладём в ОЗУ (секция .time_critical* -> .data в линкере
// arduino-pico): выборка команд из flash на каждой строке стоит десятки тактов, а
// строк у нас 216 за кадр. Макрос объявлен ЗДЕСЬ, до автопрототипов Arduino:
// иначе прототипы ниже по файлу не поймут, что это за слово.
#define GB_RAM __attribute__((section(".time_critical.gbfast")))

// ---- звук: свой APU подключаем к ядру (peanut умеет вызывать audio_* ) ----
// Хуки audio_read()/audio_write() объявлены и определены в apu_gb.h (см. конец
// файла). ВАЖНО: до #include "peanut_gb.h" в этом файле не должно быть НИ ОДНОГО
// оператора — ни объявления, ни определения. Arduino IDE перед сборкой вставляет
// автопрототипы всех функций в место первой «настоящей» строки файла, и если это
// окажется выше подключения ядра, сборка падает с
//     error: use of enum 'gb_error_e' without previous declaration.
// (Именно на это вы и наткнулись в первой сборке v7.)
#define APU_GB_PEANUT_HOOKS 1           // apu_gb.h отдаст ядру audio_read/audio_write
#include "apu_gb.h"
#define ENABLE_SOUND 1

// ---- ядро эмулятора ----
#define PEANUT_GB_HIGH_LCD_ACCURACY 0   // 1 точнее, но медленнее
#define GB_CORE_IN_RAM 1                // горячий код ядра — в ОЗУ (см. peanut_gb.h)
#include "peanut_gb.h"
#include "rom.h"                        // ROM_DATA / ROM_SIZE / ROM_MASK

// v9.2: МЕДЛЕННЫЙ БИЛД = БРАК. Проверяем НА СБОРКЕ, а не на консоли: v9.1 тихо
// собрался на 133 МГц с -Os (флаги build_flags проиграли флагам платформы),
// и игра шла на 75 % скорости. Теперь такая сборка падает с понятной ошибкой.
#if !defined(GBEMU_HOST) && (!defined(F_CPU) || F_CPU != 250000000L)
#error "gbemu: нужен CPU 250 МГц (PlatformIO: board_build.f_cpu = 250000000L; Arduino IDE: Tools -> CPU Speed -> 250 MHz)"
#endif
#if !defined(GBEMU_HOST) && defined(__OPTIMIZE_SIZE__)
#error "gbemu: запрещена оптимизация -Os (PlatformIO: build_unflags = -Os + -O3 в build_flags; Arduino IDE: Tools -> Optimize -> Fastest)"
#endif

// ============================================================ сторож и «где встали»
// Зачем: если прошивка где-то встанет (зависший цикл, аварийное исключение), раньше
// это выглядело как «чёрный экран и всё», и консоль оживлялась только выдёргиванием
// батарейки. Теперь работает сторожевой таймер: 4 секунды без «кормления» — консоль
// перезагружается сама (GPIO1 защёлкивается в самом начале setup, питание остаётся).
//
// А чтобы знать, ГДЕ встало, на каждом шаге пишем в scratch-регистры сторожа
// (они сохраняются при перезагрузке): номер фазы, сколько кадров прошло и сколько
// секунд прожили. При следующем старте всё это печатается в лог.
// ВАЖНО: scratch[4] занят самим pico-sdk (его магия для watchdog_enable),
// поэтому используем 0, 1, 2 и 3.
#define PH_BOOT     1
#define PH_LOOP     2
#define PH_CORE     3     // внутри ядра эмулятора (gb_run_frame)
#define PH_DRAW     4     // внутри коллбэка отрисовки строки
#define PH_FINISH   5     // добиваем/ждём панель в конце кадра
#define PH_SAVE     6     // запись SRAM во flash
#define PH_SSAVE    7     // запись сейвстейта
#define PH_UI       8     // отрисовка экрана интерфейса (меню/отсчёт)
#define PH_HOLD     9     // обработка удержания кнопки
#define PH_PROBE    10    // проба звука / обучение кнопок
#define PH_POWER    11    // выключение питания
#define PH_POWERCUT 12    // питание уже снимаем (это НЕ зависание)
#define PH_SERIAL   13
#define PH_STATUS   14    // печать строки статистики
#define PH_TXSYNC   15    // синхронная отправка 8 строк (3840 Б) в SPI панели
#define PH_WINDOW   16    // открытие окна панели (CS/DC)
#define PH_DRAIN    17    // ждём панель (прошлый кадр ещё уезжает)
#define PH_UIWAIT   18    // ждём место в очереди (экран интерфейса)
#define PH_HELP     19    // печать справки/команд
#define PH_SNDISR   20    // внутри прерывания звука
#define PH_KEYS     21    // читаем кнопки
#define PH_BB       22    // пишем в «чёрный ящик» (flash)
#define PH_TRACE    23    // печатаем след кадра
#define PH_GATE     24    // ждём панель перед началом кадра
#define PH_FAULT    25    // аппаратный сбой (HardFault): пойман своим обработчиком
#define PH_STALL    26    // цикл залип, а звук продолжал идти
#define PH_DIP      27    // ловушка питания: просадка на ходу

// Сколько строк следа НЕ напечаталось (USB-буфер был занят) и печать без ожидания.
// Объявлено здесь, потому что нужно и трассе кадра, и чёрному ящику.
static uint32_t txDroppedLines = 0;
static void traceLine(const char *line);

#define WD_MS       4000                        // окно сторожа
#define WD_MAGIC    0x47425A31UL                // "GBZ1" — наши отметки в scratch валидны
#define WD_POWER    0x504F4631UL                // "POF1" — было запрошено снятие питания
// ВАЖНО: если отметка «снимаю питание» стоит, то любая перезагрузка — это выключение,
// а не зависание. Отдельная ячейка (scratch[5]) нужна потому, что если питание почему-то
// НЕ снялось, код идёт дальше и фаза снова становится «начало кадра».

static volatile uint32_t gPhase = PH_BOOT;
static uint32_t gFramesTotal = 0;               // всего кадров с загрузки
static uint32_t gSlowFrames = 0;                // кадров дольше 30 мс

static inline void wdtFeed(void) { watchdog_update(); }
static inline void mark(uint32_t phase) {
  gPhase = phase;
  watchdog_hw->scratch[0] = phase;
  watchdog_hw->scratch[1] = gFramesTotal;
  watchdog_hw->scratch[3] = WD_MAGIC;           // сразу же: отметки валидны (даже если не прожили секунду)
}
static void markTick(void) {                    // раз в секунду: сколько прожили
  watchdog_hw->scratch[2] = millis() / 1000;
}
static inline void wdtTick(void) { wdtFeed(); }

static const char *phaseName(uint32_t p) {
  switch (p) {
    case PH_BOOT:     return "загрузка";
    case PH_LOOP:     return "начало кадра";
    case PH_CORE:     return "ядро эмулятора (gb_run_frame)";
    case PH_DRAW:     return "вывод строки на панель";
    case PH_FINISH:   return "завершение кадра (панель)";
    case PH_SAVE:     return "запись SRAM во flash";
    case PH_SSAVE:    return "запись сейвстейта";
    case PH_UI:       return "экран интерфейса (меню/отсчёт)";
    case PH_HOLD:     return "удержание кнопки";
    case PH_PROBE:    return "проба звука/обучение кнопок";
    case PH_POWER:    return "выключение питания";
    case PH_POWERCUT: return "снятие питания (штатное выключение)";
    case PH_SERIAL:   return "разбор команд с клавиатуры";
    case PH_STATUS:   return "печать статистики";
    case PH_TXSYNC:   return "синхронная отправка 8 строк в SPI панели";
    case PH_WINDOW:   return "открытие окна панели (CS/DC)";
    case PH_DRAIN:    return "ожидание панели (прошлый кадр ещё уезжает)";
    case PH_UIWAIT:   return "ожидание места в очереди (экран интерфейса)";
    case PH_HELP:     return "печать справки/команд";
    case PH_SNDISR:   return "внутри прерывания звука (звук не вернулся!)";
    case PH_KEYS:     return "чтение кнопок";
    case PH_BB:       return "запись в чёрный ящик (flash)";
    case PH_TRACE:    return "печать следа кадра";
    case PH_GATE:     return "ждём панель перед кадром";
    case PH_FAULT:    return "АППАРАТНЫЙ СБОЙ (HardFault)";
    case PH_STALL:    return "ЦИКЛ ЗАЛИП (звук при этом шёл!)";
    case PH_DIP:      return "ПРОСАДКА ПИТАНИЯ (панель/подсветка/звук тянут ток)";
    default:          return "неизвестно";
  }
}

// Причина сброса от самого чипа (нужна уже в отчёте о загрузке, поэтому объявлена
// здесь, а не в блоке свидетелей): VREG_AND_CHIP_RESET->CHIP_RESET по адресу 0x40064008.
//   бит 8  HAD_POR         — сброс от схемы контроля питания (питание пропадало/проседало)
//   бит 16 HAD_RUN         — сброс по выводу RUN
//   бит 20 HAD_PSM_RESTART — сброс из отладочного порта
#ifndef GBEMU_HOST
#define SYS_CHIP_RESET ((uint32_t)(*(volatile uint32_t *)0x40064008u))
#else
extern volatile uint32_t gHostChipReset;      // определяется стендом
#define SYS_CHIP_RESET ((uint32_t)gHostChipReset)
#endif

// отчёт после перезагрузки: печатается в самом начале setup().
// ВАЖНО: печатаем ВСЕГДА и всегда называем причину. Scratch-регистры переживают
// ЛЮБОЙ сброс, но обнуляются, когда питание действительно пропадало — поэтому
// по ним и видно, «консоль выключилась» или «консоль перезагрузилась».
static void bootReport(void) {
  const bool wdt  = watchdog_caused_reboot();
  const bool ours = watchdog_enable_caused_reboot();
  const uint32_t ph  = watchdog_hw->scratch[0];
  const uint32_t fr  = watchdog_hw->scratch[1];
  const uint32_t sec = watchdog_hw->scratch[2];
  const uint32_t mg  = watchdog_hw->scratch[3];
  const uint32_t pcg = watchdog_hw->scratch[7];
  const bool powered = (watchdog_hw->scratch[5] == WD_POWER);

  if (mg == WD_MAGIC) {                        // отметки прошлого запуска целы
    Serial.print(F("последний вздох прошлого запуска: фаза "));
    Serial.print(phaseName(ph));
    Serial.print(F(", кадров "));   Serial.print(fr);
    Serial.print(F(", прожили "));  Serial.print(sec); Serial.print(F(" с"));
    if (pcg) { Serial.print(F(", PC игры 0x")); Serial.print(pcg, HEX); }
    Serial.println();
  }
  if (powered) {
    Serial.println(F("причина перезагрузки: питание снималось ШТАТНО (клавиша q или удержание) — это не зависание."));
  } else if (wdt && !(SYS_CHIP_RESET & (1u << 16))) {
    Serial.println(F("!! ПРОШЛЫЙ ЗАПУСК ЗАВЕРШИЛСЯ ПЕРЕЗАГРУЗКОЙ ОТ СТОРОЖА (значит, прошивка где-то встала)."));
    if (ours) Serial.println(F("   (сторож был включён прошивкой, значит встали именно мы)"));
  } else if (wdt) {
    // v8.9q: ФЛАГ «сторож заведён» — НЕ доказательство, что он сработал. В pico-sdk
    // watchdog_caused_reboot() смотрит на метку, которую сторож ставит при ВКЛЮЧЕНИИ, а
    // чип говорит, что сброс был по выводу RUN. Раньше мы в этом случае врали в логе.
    Serial.println(F("сброс пришёл по выводу RUN (внешняя схема/кнопка); сторож при этом просто был заведён."));
  } else if (mg == WD_MAGIC) {
    Serial.println(F("причина перезагрузки: обычный сброс (кнопка RUN, загрузчик, прошивка) — питание НЕ пропадало."));
  } else {
    // v8.9l: не врём про «выключение». Если чип говорит, что питание НЕ пропадало
    // (HAD_POR=0), а сброс был по RUN/загрузчику — так и скажем: отметки сторожевого
    // домена теряются при сбросе, поэтому «отметок нет» ≠ «питание пропадало».
    const uint32_t cr0 = SYS_CHIP_RESET;
    if (!(cr0 & (1u << 8)) && (cr0 & ((1u << 16) | (1u << 20))))
      Serial.println(F("причина перезагрузки: отметок нет, но HAD_POR=0 — ПИТАНИЕ НЕ ПРОПАДАЛО: сброс по выводу RUN (кнопка/загрузчик/схема), а не выключение."));
    else
      Serial.println(F("причина перезагрузки: отметок нет — похоже на полное выключение (или пропадание питания)."));
  }
  // Что об этом говорит сам чип (независимо от наших отметок)
  {
    const uint32_t cr = SYS_CHIP_RESET;
    const bool por = (cr & (1u << 8)) != 0;      // HAD_POR
    const bool run = (cr & (1u << 16)) != 0;     // HAD_RUN
    const bool psm = (cr & (1u << 20)) != 0;     // HAD_PSM_RESTART
    Serial.print(F("причина сброса из чипа: HAD_POR=")); Serial.print(por ? 1 : 0);
    Serial.print(F(" (питание), HAD_RUN=")); Serial.print(run ? 1 : 0);
    Serial.print(F(" (вывод RUN), HAD_PSM=")); Serial.print(psm ? 1 : 0);
    Serial.println();
    if (por)
      Serial.println(F("   => чип сбросился от схемы контроля питания: питание ДЕЙСТВИТЕЛЬНО проседало или пропадало."));
    else if (run)
      Serial.println(F("   => сброс по выводу RUN (кнопка сброса / загрузчик / внешняя схема)."));
    else if (psm)
      Serial.println(F("   => сброс из отладочного порта (PSM)."));
    else
      Serial.println(F("   => ни питания, ни RUN, ни отладки: похоже на свежее включение без отметок."));
  }
  if (watchdog_hw->scratch[6]) {
    Serial.print(F("   ВНИМАНИЕ: прерывание звука не вернулось. Отметка "));
    Serial.print(watchdog_hw->scratch[6]);
    Serial.println(F(" (1 = вошли в прерывание, 2 = синтез семпла, 3 = запись в ШИМ)"));
  }
  watchdog_hw->scratch[0] = PH_BOOT;
  watchdog_hw->scratch[1] = 0;
  watchdog_hw->scratch[2] = 0;
  watchdog_hw->scratch[3] = 0;
  watchdog_hw->scratch[5] = 0;
  watchdog_hw->scratch[6] = 0;
  watchdog_hw->scratch[7] = 0;
}

// ============================================================ диагностика кадра
// Путь вывода кадра теперь СИНХРОННЫЙ (он проверен на этой консоли в v5-v7), а свой
// канал DMA включается клавишей u как опыт. Причина, почему вывод был «узким местом»,
// оказалась не в коде, а в ЧАСТОТЕ SPI: периферийные часы clk_peri на устройстве были
// 48 МГц, а SPI не может быть быстрее clk_peri/2 → любые просьбы давали ровно 24 МГц.
// 115 КБ кадра при 24 МГц — это 38 мс, отсюда и «кадр с выводом 45.8 мс». Теперь
// clk_peri поднимается до системной (250 МГц), и панель получает 62,5 или 125 МГц.
//
// Переключатели (клавиша j) оставлены для сравнения:
//   drawMode 0 — норма (v8): две точки одним 32-битным словом;
//            1 — старый цикл записи (одиночные 16-битные слова) — для сравнения;
//            2 — строки заливаются одним цветом: стоимость записи БЕЗ поиска
//                пикселей в таблице цветов;
//            3 — коллбэк не делает ничего: панель не обновляется (картинка
//                замирает), зато видно чистую скорость ядра peanut.
// Клавиша j перебирает 0 -> 1 -> 2 -> 3 -> 0.
// (режимы теста вывода убраны в v8.5: путь вывода теперь один, а тест панели — клавиша j)

// ============================================================ железо
#define PIN_SCK    18
#define PIN_MOSI   19
#define PIN_MISO   16
#define PIN_CS      3
#define PIN_DC      2
#define PIN_RST     4
#define PIN_BL      7
#define PIN_AUDIO   17                 // ШИМ-звук (в стоке: pwm_init(17,1,689))

// найдено в дампе: сток при выключении сбрасывает GPIO1 и GPIO12
#define PIN_PWR_HOLD   1               // ключ питания (защёлка) — держим HIGH
#define PIN_EN12      12               // в стоке тоже уходит в 0 при выключении
#define PIN_EN20      20               // в стоке поднимается в 1 при старте
#define PIN_AMP       PIN_EN20         // GP20 — похоже, разрешение усилителя

// ============================================================ звук: состояние
// Из дампа стока: звук выводится ШИМ-ом на GPIO17 (слайс 0, TOP = 689,
// «тишина» = уровень 344), а GP20 сток опускает в 0, когда пищит (похоже,
// это разрешение усилителя). Реализация — ниже, в разделе «ЗВУК: APU + ШИМ».
static volatile uint8_t  soundOn    = 1;
static volatile uint8_t  volPct     = 10;      // громкость эмулятора, % (умолчание v8.9u: было 30)
// Режимы-изоляторы, включаемые кнопкой при включении (см. setup):
static bool liteMode = false;                  // «лёгкий»: подсветка/звук выкл, SPI медленнее
static bool noPanelMode = false;               // «панель не трогаем»: SPI молчит
static bool quietPanel  = false;               // «тихая панель»: SPI 20,8 МГц
// Проба звука дала однозначный ответ: GP20 = LOW -> звук есть, GP20 = HIGH -> тишина.
// Все три опыта с LOW пищали, все три с HIGH молчали. Поэтому уровень только LOW,
// а режим AMP из меню убран (HIGH = просто глухо, выбирать нечего).
// v9.4: ГЛУШИМ УСИЛИТЕЛЬ НА НАСТОЯЩЕЙ ТИШИНЕ (как сток: GP20 = 0 только на время
// звука). А/Б-тесты показали: журчание — НАВОДКА ОТ НАГРУЗКИ (процессор + SPI
// панели), а не звук: при volume 0 оно оставалось, а в меню (игра стоит) пропадало.
// Пока идёт звук — GP20 = LOW; 2 с математической тишины подряд (все каналы
// молчат, DC-блокер срезал постоянку) — HIGH. Включение — вместе с мягким входом
// (gFade): щелчков вкл/выкл нет, в отличие от старого режима «по требованию» с
// его 100 мс и дребезгом. Тихая запись во flash глушит усилитель явно.
#define AMP_MUTE_TICKS  44444                 // 44444 × 45 мкс ≈ 2 с тишины — можно глушить
static volatile uint8_t  gAmpOn     = 0;      // 1 = усилитель включён (GP20 = LOW)
static volatile uint32_t gAmpSil    = 0;      // сколько тиков подряд длится тишина
static volatile uint8_t  soundPause = 0;       // 1 = молчать (меню/пауза/запись flash)
static bool              apuTimerOn = false;
static volatile uint16_t gFade = 256;         // v9.3: плавный вход/выход звука (256 = полная громкость)
static repeating_timer_t apuTmr;
// Темп звука. Игра у нас идёт медленнее настоящей (сейчас ~54 % скорости), а
// звук в v7 считался в реальном времени: ноты играли свои 60-е доли секунды,
// пока игра тянула их почти вдвое дольше — отсюда «мелодии страдают».
// Теперь по умолчанию темп звука следует за эмуляцией: семпл идёт реже ровно во
// столько раз, во сколько раз медленнее идёт игра, и всё (высота, длительности,
// конверты, темп) звучит синхронно с картинкой — как если бы консоль целиком
// работала медленнее. Клавиша y переключает: GAME (синхронно с игрой) / REAL.
static volatile uint8_t  soundSync = 1;
static uint16_t          apuTmrUs  = 45;       // период таймера звука, мкс
static uint32_t          syncEmaFps = 60;      // сглаженная оценка эмулированных кадров/с
static void soundInit(void);
static uint8_t volNow(void);          // v8.9p: громкость с учётом мягкого входа (нужна в прерывании)
static void soundSetOn(uint8_t on);
static void soundSuspend(void);
static void soundResume(void);
// v8.9q: тихая запись во flash — на время стирания гасим подсветку и глушим усилитель
static void quietFlashBegin(void);
static void quietFlashEnd(void);
// Состояние «тихой записи». Сами функции — ниже (рядом с подсветкой), а переменные
// объявлены здесь, потому что их трогает выключение питания, которое выше по файлу.
static bool     gQuietBusy = false;
static bool     gQuietNoLight = false;      // при выключении свет уже погашен — не трогаем
static uint32_t gQuietN = 0, gQuietBack = 0;
static void soundUpdatePause(void);
static void uiClear(uint8_t shade);      // объявлены заранее: нужны ниже по файлу (смена частоты SPI)
static void uiPush(void);
static uint8_t *uiRow(void);             // строка интерфейса в буфере отправки
static void uiRowSend(void);             // отправить её в панель
static void audioHwInit(void);
static void ampApply(void);

#define MEM_W      240
#define MEM_H      240
#define GAME_W     240                 // кадр GB 160x144 при масштабе 1.5x
#define GAME_ROWS  216
#define GAME_TOP   12                  // (240-216)/2
#define VB_STEP    ((GAME_ROWS * 256) / 144)   // 384 = ровно 1.5x, без делений

// v8.9n: ПО УМОЛЧАНИЮ 125 МГц. Опыт на консоли: именно на этой частоте игра идёт
// ровные 60 кадр/с (кадр занимает ~8 мс из 16,7). В стоке было ~100 МГц.
// v9.5: по умолчанию 62,5 МГц — тише шина (меньше наводки на усилитель: журчание
// под музыкой), а кадровый дифф компенсирует скорость трафиком. Клавиша o
// переключает: 62,5 -> 41,7 -> 20,8 -> 125.
#define SPI_HZ     125000000UL
#define FRAME_US   16743UL             // 59.7 кадр/с

// ============================================================ палитры
// Цвета заданы в обычном RGB (8 бит на канал!). Пересчёт в 565-формат делается
// здесь, в 8-битной арифметике — поэтому яркость/контраст реально работают
// (в прошлой версии я считал прямо в 565 и округление съедало весь эффект).
struct PaletteDef { const char *name; uint8_t c[4][3]; };   // c[0] светлый … c[3] тёмный

static const PaletteDef PALS[] = {
  { "BLUE",     { { 56, 73,113}, { 44, 58, 89}, { 34, 43, 66}, { 27, 32, 44} } },  // v9.7: тёмно-синяя под корпус (фото-замер; под контраст 120% по умолчанию)
  { "LINK",     { {150,163,120}, {101,112,80}, { 55, 62, 42}, { 12, 15, 12} } },  // ровные шаги
  { "POCKET",   { {197,206,164}, {139,149,106}, { 74, 80, 57}, { 24, 28, 24} } },
  { "POCKET-D", { {172,181,142}, {120,129, 90}, { 62, 68, 48}, { 18, 22, 18} } },
  { "DMG",      { {155,188, 15}, {139,172, 15}, { 48, 98, 48}, { 15, 56, 15} } },
  { "GRAY",     { {255,255,255}, {171,171,171}, { 84, 84, 84}, {  0,  0,  0} } },
  { "B/W",      { {255,255,255}, {130,130,130}, { 64, 64, 64}, {  0,  0,  0} } },
  { "AMBER",    { {255,204,102}, {209,138, 43}, {138, 75, 18}, { 26, 14,  0} } },
  { "VIVID",    { {197,255, 49}, {140,198, 74}, { 66, 49, 58}, { 33, 28, 33} } },
};
static const int PAL_COUNT = sizeof(PALS) / sizeof(PALS[0]);
static uint8_t palIdx = 0;                    // BLUE — умолчание v9.3 (в цвет корпуса)
static uint8_t bright = 100;                  // яркость 50..150 %
static uint8_t contr  = 120;                  // контраст 50..200 % — умолчание v9.3 (было 140 — многовато)
static bool    invertShades = false;

static uint16_t curPal[4];                    // итоговые цвета (565)
static uint16_t uiColSw[4];                   // то же, но байты уже в порядке отправки

// Таблица «байт пикселя от ядра -> байты цвета для панели».
// ВАЖНО: ядро УЖЕ применило палитру игры (BGP/OBP0/OBP1) — в пикселе лежит
// готовый номер оттенка 0..3, биты 5-4 — только метка слоя (BG/OBJ0/OBJ1).
// Применять палитру второй раз НЕЛЬЗЯ: именно это съедало детали спрайтов
// (при OBP0=0xD0 оттенок 2 уезжал в самый светлый — «пересвеченные» персонажи).
static uint16_t colTab[256];        // оттенок -> цвет 565 (для нечётного пикселя: одна точка)
static uint32_t col32[256];         // тот же цвет, продублированный: две точки одним 32-битным словом

static void rebuildColTab(void) {
  for (int p = 0; p < 256; p++) {
    const uint16_t c = curPal[p & 3];                   // оттенок уже выбран ядром
    colTab[p] = (uint16_t)((c >> 8) | (c << 8));        // байты в порядке отправки
    col32[p]  = (uint32_t)colTab[p] | ((uint32_t)colTab[p] << 16);  // две точки одним словом
  }
}

static inline int clamp8(int v) { return v < 0 ? 0 : (v > 255 ? 255 : v); }

static uint16_t to565(int r, int g, int b) {  // с округлением, а не отбрасыванием
  return (uint16_t)(((r * 31 + 127) / 255) << 11 | ((g * 63 + 127) / 255) << 5 | ((b * 31 + 127) / 255));
}

static void rebuildPalette(void) {
  for (int i = 0; i < 4; i++) {
    const int k = invertShades ? (3 - i) : i;
    int r = PALS[palIdx].c[k][0], g = PALS[palIdx].c[k][1], b = PALS[palIdx].c[k][2];
    r = 128 + ((r - 128) * contr) / 100;      // контраст вокруг середины
    g = 128 + ((g - 128) * contr) / 100;
    b = 128 + ((b - 128) * contr) / 100;
    r = (clamp8(r) * bright + 50) / 100;      // яркость
    g = (clamp8(g) * bright + 50) / 100;
    b = (clamp8(b) * bright + 50) / 100;
    curPal[i]  = to565(clamp8(r), clamp8(g), clamp8(b));
    uiColSw[i] = (uint16_t)((curPal[i] >> 8) | (curPal[i] << 8));
  }
  rebuildColTab();
}

// ============================================================ кнопки (измерено вами)
#define NBTN 9
static const uint8_t BTN_GPIO[NBTN] = { 25,      22,       23,      24,       6,    5,    15,       16,       0 };
static const char   *BTN_NAME[NBTN] = { "UP",   "DOWN",   "LEFT",  "RIGHT",   "A",  "B", "START", "SELECT", "MENU" };
static const uint8_t BTN_JOY[NBTN]  = { JOYPAD_UP, JOYPAD_DOWN, JOYPAD_LEFT, JOYPAD_RIGHT,
                                        JOYPAD_A, JOYPAD_B, JOYPAD_START, JOYPAD_SELECT, 0 };
static uint8_t joyMap[NBTN];

#define IDX_START 6
#define IDX_MENU  8

static uint16_t readMask(void) {
  uint16_t m = 0;
  for (int i = 0; i < NBTN; i++) if (digitalRead(BTN_GPIO[i]) == LOW) m |= (uint16_t)(1u << i);
  return m;
}

// ============================================================ низкий уровень SPI
static inline void csL(void) { digitalWrite(PIN_CS, LOW);  }
static inline void csH(void) { digitalWrite(PIN_CS, HIGH); }
static void wb(uint8_t b) { SPI.transfer(b); }
static void pushBytes(const uint8_t *b, size_t n) { SPI.transfer(b, nullptr, n); }  // ТОЛЬКО так!

static void cmdStart(uint8_t c) { csH(); digitalWrite(PIN_DC, LOW); csL(); wb(c); csH(); }
static void cmdParams(const uint8_t *d, size_t n) { csH(); digitalWrite(PIN_DC, HIGH); csL(); pushBytes(d, n); csH(); }
static void cmd1(uint8_t c) { cmdStart(c); }
static void cmd1p(uint8_t c, uint8_t v) { cmdStart(c); cmdParams(&v, 1); }

static void lcdWindow(int x0, int y0, int x1, int y1) {
  uint8_t b[4];
  cmd1(0x2A); b[0] = x0 >> 8; b[1] = x0; b[2] = x1 >> 8; b[3] = x1; cmdParams(b, 4);
  cmd1(0x2B); b[0] = y0 >> 8; b[1] = y0; b[2] = y1 >> 8; b[3] = y1; cmdParams(b, 4);
  cmd1(0x2C);
}

// v9.7.1: флаги кэша строк — ДО lcdInit (он их сбрасывает в конце)
static bool     rowsValid = false;   // хэшей ещё нет (первый кадр — шлём всё)
static bool     panelInited = false; // панель инициализирована (до lcdInit кадры в неё бессмысленны)
static void lcdInit(void) {
  pinMode(PIN_CS, OUTPUT);  digitalWrite(PIN_CS, HIGH);
  pinMode(PIN_DC, OUTPUT);  digitalWrite(PIN_DC, HIGH);
  pinMode(PIN_RST, OUTPUT); digitalWrite(PIN_RST, HIGH);

  digitalWrite(PIN_RST, HIGH); delay(100);
  digitalWrite(PIN_RST, LOW);  delay(100);
  digitalWrite(PIN_RST, HIGH); delay(200);

  cmd1(0x01); delay(150);
  cmd1(0x11); delay(10);
  cmd1p(0x3A, 0x55); delay(10);
  cmd1p(0x36, 0x60);
  { uint8_t d[4] = {0, 0, 0, 0xF0};    cmd1(0x2A); cmdParams(d, 4); }
  { uint8_t d[4] = {0, 0, 0x01, 0x40}; cmd1(0x2B); cmdParams(d, 4); }
  cmd1(0x21); delay(10);
  cmd1(0x13); delay(10);
  cmd1(0x29); delay(10);
  // v9.7.1: панель (пере)инициализирована — её GRAM это НЕ наш кэш строк
  // (там мог остаться кадр выключения: цифра отсчёта или шум). Кэш недействителен:
  // следующий кадр обязан уйти целиком. Именно из-за пропуска тут строк на экране
  // и оставались следы прошлого кадра до первого полного обновления.
  panelInited = true;
  rowsValid = false;
}

// ============================================================ вывод кадра (прямая запись)
// v8.5: НИКАКИХ очередей и никакого DMA — простая и проверенная схема:
//   1) открываем окно панели и держим CS низким;
//   2) ядро эмулятора отдаёт строку (коллбэк 144 раза) — сразу гоним её в SPI;
//   3) верх/низ экрана и добор строк — чёрные (ровно столько, сколько нужно);
//   4) ждём последний байт, поднимаем CS.
//
// Почему так, а не очередью, как в v8.0-v8.4: очередь из 4 буферов уезжала
// ПОЗЖЕ отрисовки и, если не успевала, строки просто пропускались, а кадр
// досыпался чёрным. Именно это и дало «чёрный экран» на v8.3/v8.4 (в логе
// кадра 2-11 видно: ядро 9,7 мс — строки не рисовались вовсе, а 17,8 мс ушло
// на 240 чёрных строк). Прямая запись так не умеет: строка или ушла, или в
// логе есть строка о сбое.
//
// Про предохранитель. В библиотеке (spi_write_blocking из pico-sdk) ожидание
// места в FIFO БЕЗ ограничения по времени: «шина всегда идёт с известной
// скоростью, значит, передача закончится за известное время». Но если FIFO
// перестанет пустеть (так бывает при неудачной смене частоты), плата замолчит
// навсегда — что мы и видели. Здесь у ожидания есть предел: сработает
// предохранитель, в логе появится строка, а консоль продолжит работать.
#define ROW_BYTES   (GAME_W * 2)       // байт в строке панели (240 точек по 2 байта)
#define TX_GUARD_US 3000UL             // предел ожидания FIFO (одна строка идёт 61 мкс)

static bool     frameOpen = false;      // кадр открыт (можем писать строки)
static uint32_t frameT0 = 0;            // начало кадра
static uint32_t frameUs = 0;            // сколько занял последний кадр
// --- «свидетели смерти» (v8.8) ---
static volatile uint32_t gBeat = 0;          // пульс главного цикла: время последнего витка
static volatile uint32_t gBeatN = 0;         // и число витков
static volatile bool     gBeatArm = false;   // детектор включаем, когда цикл уже идёт
static void faultTriggerNow(void);           // объявлен заранее: нужен из прерывания звука
static volatile bool     gStalled = false;   // залипание уже заметили (второй раз не кричим)
static volatile uint32_t frameLineCore = 0;  // до какой строки кадра дошло ЯДРО
static volatile uint8_t  gLcdOn = 0;         // был ли включён ЖК игры (для разбора смерти)
#define STALL_US 1200000UL                   // 1,2 с без витка цикла = залипло
static uint32_t frameRows = 0;          // строк учтено в этом кадре (отправлено + пропущено)
static uint32_t frameY = 0;             // позиция строки панели в этом кадре (0..240)
static uint32_t txRowAcc = 0;           // суммарное время записей (наша работа)
static uint32_t rowLoopAcc = 0, rowLoopN = 0;   // то же время и число строк — для статистики
static uint32_t spiWaitAcc = 0;                 // сколько ждали панель (в конце кадра и между кадрами)
static uint32_t spiCallAcc = 0, spiCalls = 0;   // запуск передач (для строки статистики)
static uint32_t txRowsOk = 0, txRowsFail = 0;   // строк ушло / не ушло
static uint32_t spiStuck = 0, spiStuckSeen = 0; // предохранитель сработал (счётчик сбрасывается после перезапуска)
static uint32_t spiRestarts = 0;                // сколько раз перезапускали шину за сеанс
static uint32_t txBytes = 0;                    // всего байт в панель
static uint32_t txBytesPrev = 0;                // для подсчёта байт за последний кадр
static uint32_t txBytesFrame = 0;               // сколько байт ушло в панель за последний кадр
static uint32_t gateWaits = 0, gateSkips = 0;   // ждали панель / пропустили кадр
static bool     spiHealthOk = true;             // SPI не перезапускался
static bool     drawThisDbg = false;            // был ли последний кадр с отрисовкой (для чёрного ящика)

// ============================================================ ВЫВОД СТРОК ЧЕРЕЗ DMA (v8.9m)
// Раньше строка уходила в панель СИНХРОННО: ядро по байту ждало место в FIFO и теряло
// на этом ~8-10 мс за кадр (в логе — «из них синхронно 9,0 мс»). Из-за этого игра шла на
// 75 % темпа, и звук «подтормаживал». Теперь строка копируется в буфер и уходит через
// DMA: шина везёт её САМА, а ядро в это время считает следующий кадр.
//
// ПОЧЕМУ ДВА БУФЕРА И ОДИН КАНАЛ. За одну передачу в шине находится ровно одна строка —
// так порядок строк в панели гарантирован при любом раскладе. Пока строка k уезжает, мы
// спокойно собираем строку k+1 во второй буфер, а перед запуском k+1 ждём окончания k.
// Если ядро считает быстрее, чем шина везёт, мы подождём (строка не потеряется), если
// шина быстрее — ожидания нет вовсе.
#define TX_DMA_BUF 2
static bool     txUseDma   = true;           // клавиша 'u' — сравнить с синхронным выводом
static bool     txDmaReady = false;
static int      txDmaCh    = -1;
static dma_channel_config txDmaCfg;
static uint8_t  txDmaBuf[TX_DMA_BUF][ROW_BYTES] __attribute__((aligned(4)));
static int      txDmaIdx   = 0;              // какой буфер заполняем следующим
static bool     txDmaArmed = false;          // в шине есть незавершённая передача
static uint32_t txDmaRows = 0, txDmaWaitAcc = 0, txDmaAborts = 0;

static void txDmaInit(void) {
  if (txDmaCh < 0) {
    txDmaCh = dma_claim_unused_channel(false);
    if (txDmaCh < 0) { txUseDma = false; txDmaReady = false; return; }
  }
  txDmaCfg = dma_channel_get_default_config(txDmaCh);
  channel_config_set_transfer_data_size(&txDmaCfg, DMA_SIZE_8);   // 8 бит на кадр: байт = байт в панель
  channel_config_set_read_increment(&txDmaCfg, true);             // читаем буфер подряд
  channel_config_set_write_increment(&txDmaCfg, false);           // пишем всегда в DR
  channel_config_set_dreq(&txDmaCfg, spi_get_dreq(spi0, true));   // по запросу «передать» от SPI
  channel_config_set_irq_quiet(&txDmaCfg, true);                  // прерывания не нужны
  spi_get_hw(spi0)->dmacr |= 1u;                                  // TXDMAE: шина тянет данные из DMA
  txDmaReady = true;
}

// Ждём завершения передачи — ОГРАНИЧЕННО по времени. Если DMA не кончился, это сбой
// (тот же предохранитель, что и в синхронном пути): сбрасываем канал, считаем потерю и
// говорим в лог. Без этого «вставший» DMA означал бы вечное ожидание.
static bool txDmaWait(uint32_t us) {
  const uint32_t t0 = micros();
  uint32_t spins = 0;
  while (dma_channel_is_busy(txDmaCh)) {
    if ((++spins & 0x3FFu) == 0 && (uint32_t)(micros() - t0) > us) return false;
    tight_loop_contents();
  }
  return true;
}

static void txDmaFail(void) {
  dma_channel_abort(txDmaCh);
  txDmaArmed = false;
  txDmaAborts++; spiStuck++; txRowsFail++;
  spiHealthOk = false;
}

// Одна строка через DMA. Копировать в буфер можно смело: его использовала передача
// ДВЕ назад, а она уже завершилась (мы всегда ждём окончания перед запуском следующей).
static bool txRowDma(const uint8_t *p, size_t n) {
  const uint32_t t0 = micros();
  const int idx = txDmaIdx;
  txDmaIdx ^= 1;
  memcpy(txDmaBuf[idx], p, n);
  if (txDmaArmed) {
    const uint32_t w0 = micros();
    if (!txDmaWait(TX_GUARD_US)) { txDmaFail(); return false; }
    txDmaWaitAcc += micros() - w0;
  }
  dma_channel_configure(txDmaCh, &txDmaCfg, &spi_get_hw(spi0)->dr, txDmaBuf[idx], (uint)n, true);
  txDmaArmed = true;
  txDmaRows++; txRowsOk++; txBytes += n;
  txRowAcc += micros() - t0;
  return true;
}

static inline bool txStuck(void) { return spiStuck != 0; }
static inline const char *txTag(void) { return txStuck() ? "прямой путь (был сбой)" : "прямой путь"; }
static inline const char *txPathName(void) {
  if (txUseDma && txDmaReady) {
    if (txStuck())    return "DMA строк (был сбой!)";
    if (!spiHealthOk) return "DMA строк (SPI перезапущен)";
    return "DMA строк (двойной буфер)";
  }
  if (txStuck())     return "прямая запись (был сбой SPI!)";
  if (!spiHealthOk)  return "прямая запись (SPI перезапущен)";
  return "прямая запись строк (проверенная)";
}

static void txCheckHealth(void);          // объявлен заранее: вызывается из конца кадра

// Одна строка панели: пишем 480 байт прямо в FIFO SPI, ждём место ограниченно.
//
// ВАЖНО И НЕОЧЕВИДНО (на этом v8.5 и потерял картинку). FIFO у SPI на RP2040
// 16-битная, а регистр данных отдаёт ОДНУ запись FIFO на одну операцию записи.
// При 8-битных кадрах (наш случай) сдвигаются только младшие 8 бит записи.
// Поэтому запись 32-битными словами (как было в v8.5) отправляла в панель
// РОВНО ОДИН БАЙТ ИЗ ЧЕТЫРЁХ: до панели доходила каждая четвёртая точка, кадр
// обрывался на четверти экрана, а остальное оставалось старым мусором — снаружи
// это выглядит как «сверху кусок картинки, ниже цветной шум». Проверяется
// арифметикой: кадр укладывался в 13,6 мс, хотя одни только 115 200 байт при
// 62,5 МГц занимают 14,7 мс.
// Поэтому пишем ПО БАЙТУ — ровно так, как это делает проверенный
// spi_write_blocking() из pico-sdk.
static bool txRow(const uint8_t *p, size_t n) {
  if (txUseDma && txDmaReady) return txRowDma(p, n);      // v8.9m: строку увозит DMA
  const uint32_t t0 = micros();
  for (size_t i = 0; i < n; i++) {
    uint32_t spins = 0;
    while (!spi_is_writable(spi0)) {
      // ВАЖНО (здесь была дыра!). Раньше время проверялось по НОМЕРУ БАЙТА — раз в
      // 64 байта. Но если FIFO встанет НА СЕРЕДИНЕ байта, номер не меняется, и
      // проверка не срабатывает никогда: цикл висит вечно, сбой не считается и в
      // лог ничего не пишется. Теперь считаем ОБОРОТЫ ожидания — предохранитель
      // срабатывает всегда, а шина перезапускается сама.
      if ((++spins & 0x1FFu) == 0 && (uint32_t)(micros() - t0) > TX_GUARD_US) {
        spiStuck++; txRowsFail++; return false;
      }
      tight_loop_contents();
    }
    spi_get_hw(spi0)->dr = p[i];     // один байт = одна запись FIFO = один байт в панель
  }
  txRowAcc += micros() - t0;
  txRowsOk++;
  txBytes += n;
  return true;
}

// подождать, пока шина освободится (ограниченно!)
static bool txWaitIdle(uint32_t us) {
  const uint32_t t0 = micros();
  while (spi_is_busy(spi0)) {
    if (micros() - t0 > us) return false;
    tight_loop_contents();
  }
  return true;
}

// ============================================================
// v9.5: КАДРОВЫЙ ДИФФ — шлём только изменившиеся строки.
// Наводка от шины панели пропорциональна трафику: полосы, HUD и статичные зоны
// не меняются кадр от кадра — гнать их в панель каждый раз незачем. Строка
// сравнивается с прошлым кадром по хэшу её ГОТОВЫХ байтов (и палитра, и
// масштаб уже учтены: смена палитры/яркости сама перерисует нужное).
// Пропуски ломают автоинкремент курсора панели, поэтому строки идут СЕРИЯМИ:
// у каждой серии своё окно lcdWindow(0, y0, 239, 239); разрыв — новое окно.
static uint32_t rowHash[MEM_H];     // хэш готовых байтов строки из прошлого кадра
static uint32_t frameSkip = 0;      // пропущено (не менялись) в этом кадре
static uint32_t txRowsSkip = 0;     // всего пропущено за сеанс
static int      runY0 = -1;         // начало открытой серии строк (-1 = серии нет)
static int      runNextY = -1;      // следующая строка, которую ждёт открытая серия

static uint32_t rowHashOf(const uint8_t *p) {
  // буферы строк выровнены, ROW_BYTES кратно 4 — хэш по 32-битным словам
  const uint32_t *w = (const uint32_t *)(const void *)p;
  uint32_t h = 2166136261u;
  for (int i = 0; i < ROW_BYTES / 4; i++) { h ^= w[i]; h *= 16777619u; }
  return h;
}

// закрыть серию строк: дождаться шину и поднять CS
static void runClose(void) {
  if (runY0 < 0) return;
  if (txDmaArmed) {
    const uint32_t w0 = micros();
    if (!txDmaWait(TX_GUARD_US)) txDmaFail(); else txDmaArmed = false;
    txDmaWaitAcc += micros() - w0;
  }
  txWaitIdle(TX_GUARD_US);
  csH();
  runY0 = -1; runNextY = -1;
}

// Одна строка панели на своё место кадра. Неизменившуюся ПРОПУСКАЕМ: место в
// кадре всё равно занято (счётчики идут всегда), панель помнит её сама.
static bool txRowY(const uint8_t *p) {
  const int y = (int)frameY;
  if (y >= MEM_H) return true;
  frameY++; frameRows++;                                   // позиция занята в любом случае
  const uint32_t h = rowHashOf(p);
  const bool changed = !rowsValid || h != rowHash[y];
  rowHash[y] = h;
  if (!changed) { frameSkip++; txRowsSkip++; return true; }
  if (runY0 < 0 || runNextY != y) {                        // разрыв серии или её начало
    runClose();
    lcdWindow(0, y, MEM_W - 1, MEM_H - 1);
    digitalWrite(PIN_DC, HIGH); csL();
    runY0 = y;
  }
  if (!txRow(p, ROW_BYTES)) return false;                  // сбой уже посчитан
  runNextY = y + 1;
  return true;
}

// начать кадр (v9.5: окна панели открываются сериями строк — см. txRowY)
static void frameStart(void) {
  mark(PH_WINDOW);
  frameOpen = true; frameRows = 0; frameY = 0; frameSkip = 0;
  runY0 = -1; runNextY = -1;
  frameT0 = micros();
  mark(PH_DRAW);
}

// чёрные строки в начале/конце кадра и добор до конца экрана
static void rowBl(int n) {
  static const uint8_t zeros[ROW_BYTES] __attribute__((aligned(4))) = {0};
  while (n-- > 0) {
    if (!txRowY(zeros)) return;                            // сбой уже посчитан
  }
}

// закрыть кадр: дождаться последнего байта и поднять CS
static void frameFinish(void) {
  mark(PH_FINISH);
  runClose();                                              // v9.5: закрыть последнюю серию строк
  if (txDmaArmed) {                                        // последняя строка кадра
    const uint32_t w0 = micros();
    if (!txDmaWait(TX_GUARD_US)) txDmaFail(); else txDmaArmed = false;
    txDmaWaitAcc += micros() - w0;
  }
  txWaitIdle(TX_GUARD_US);
  csH();
  rowsValid = true;                                        // v9.5: хэши собраны — дальше кадр в кадр
  frameOpen = false;
  frameUs = micros() - frameT0;
  txBytesFrame = txBytes - txBytesPrev;                // сколько реально ушло в панель
  txBytesPrev = txBytes;
  // Приёмный FIFO мы не читаем (панель ничего не отвечает), поэтому он переполняется.
  // Передаче это не мешает, но флаг переполнения лучше снять — так делает SDK в конце
  // spi_write_blocking(). Заодно подхватываем сбой шины, если он случился.
  uint32_t x = 0;
  while (spi_is_readable(spi0) && x++ < 64) (void)spi_get_hw(spi0)->dr;
  if (spiStuck != spiStuckSeen) txCheckHealth();
}

// Печать строки, которая НИКОГДА не встанет. Serial.print() блокирующий: если
// хост не читает (терминал закрыт, USB не вычерпан), он ждёт бесконечно — и
// прошивка выглядит «зависшей». Здесь: нет места в буфере — строку пропускаем и
// считаем пропуски (их видно в статусе 's' и в записи чёрного ящика).
static void traceLine(const char *line) {
  const int n = (int)strlen(line);
  if (Serial.availableForWrite() >= n + 1) {
    Serial.write((const uint8_t *)line, n);
    Serial.write('\n');
  } else {
    txDroppedLines++;
  }
}

// Проверка здоровья SPI. Раньше на этом месте была смена пути вывода и попытка
// «дожать» DMA. Теперь: если предохранитель сработал — перезапускаем SPI.
// ВАЖНО: при смене частоты arduino-pico делает spi_deinit + spi_init, и если
// между ними в FIFO остался байт, шина может встать навсегда. Поэтому сначала
// ждём тишину (ограниченно!), потом меняем частоту.
static void txCheckHealth(void) {
  if (!txStuck() || spiStuck == spiStuckSeen) return;
  spiStuckSeen = spiStuck;
  Serial.println(F("!! SPI панели встал: FIFO не освободился. Перезапускаю шину, продолжаю работу."));
  Serial.print(F("   потеряно строк ")); Serial.print(txRowsFail);
  Serial.print(F(", кадр ")); Serial.print(gFramesTotal);
  Serial.println(F(" — пришлите эту строку, разберусь."));
  txWaitIdle(TX_GUARD_US);
  SPI.endTransaction();                            // spi_deinit: сброс периферии
  SPI.beginTransaction(SPISettings(SPI_HZ, MSBFIRST, SPI_MODE0));
  {                                                // вычерпать мусор из FIFO
    uint32_t x = 0;
    while (spi_is_readable(spi0) && x++ < 64) (void)spi_get_hw(spi0)->dr;
  }
  spiHealthOk = false;
  spiRestarts++;
  spiStuck = 0; spiStuckSeen = 0;                  // шлейф сбоя не тянем: шина перезапущена
  Serial.println(F("   шина перезапущена (в статусе это видно как «шина перезапускалась»)."));
}

// ============================================================ частота SPI панели
// В дампе стока рядом с адресом SPI0 (0x4003C000) лежит литерал 100 000 000 —
// похоже, панель у стока работала на 100 МГц. Ровно 100 из 250 МГц получить
// нельзя (делитель 2,5 не существует), поэтому набор: 62,5 -> 125 -> 20,8.
// По умолчанию 62,5: этот режим уже проверен на вашей консоли.
static const uint32_t SPI_HZ_TAB[] = { 125000000UL, 62500000UL, 41666667UL, 20833333UL };
// v8.9q: имена РАНЬШЕ были сдвинуты (NAME[0]="62,5" при TAB[0]=125 МГц) — из-за этого
// лог врал: после перехода на 62,5 МГц печаталось «сейчас 125». Теперь имя = своей частоте.
static const char *SPI_HZ_NAME[]    = { "125", "62,5", "41,7", "20,8" };
static uint8_t spiHzIdx = 0;        // v9.7: по умолчанию 125 МГц (ровные 60 кадр/с, как сток); 'o' — цикл, выбор помнится

// Поднять периферийную частоту до системной: SPI не может быть быстрее clk_peri/2,
// а на устройстве clk_peri оказался 48 МГц — поэтому любые просьбы давали ровно 24 МГц.
static void spiRaisePeriClock(void) {
  const uint32_t sys = clock_get_hz(clk_sys);
  Serial.print(F("часы: системная ")); Serial.print(sys / 1000000.0f, 1);
  Serial.print(F(" МГц, периферийная ")); Serial.print(clock_get_hz(clk_peri) / 1000000.0f, 1);
  Serial.println(F(" МГц"));
  if (clock_get_hz(clk_peri) < sys) {
    clock_configure(clk_peri, 0, CLOCKS_CLK_PERI_CTRL_AUXSRC_VALUE_CLK_SYS, sys, sys);
    Serial.print(F("часы: периферийную поднял до ")); Serial.print(clock_get_hz(clk_peri) / 1000000.0f, 1);
    Serial.println(F(" МГц (SPI больше не ограничен 24 МГц)"));
  }
}

// Сменить частоту панели. ВАЖНО: arduino-pico при смене частоты делает
// spi_deinit + spi_init. Если в этот момент в FIFO остался непереданный байт,
// шина может встать навсегда (у нас так и было). Поэтому: сначала ждём тишину
// с ограничением, потом меняем, потом вычерпываем остатки FIFO.
static void spiSetClock(uint32_t hz) {
  const bool idle = txWaitIdle(TX_GUARD_US);
  if (!idle) Serial.println(F("!! панель не успела доработать кадр — на всякий случай всё равно меняю частоту"));
  SPI.endTransaction();
  SPI.beginTransaction(SPISettings(hz, MSBFIRST, SPI_MODE0));   // тут SPI переинициализируется
  { uint32_t x = 0; while (spi_is_readable(spi0) && x++ < 64) (void)spi_get_hw(spi0)->dr; }
  spiStuckSeen = spiStuck;                       // сбои до смены частоты уже отчитаны
  const uint32_t got = spi_get_baudrate(spi0);
  Serial.print(F("SPI панели: просили ")); Serial.print(hz / 1000000.0f, 1);
  Serial.print(F(" МГц, получилось "));    Serial.print(got / 1000000.0f, 1);
  Serial.print(F(" МГц (клавиша o — дальше, сейчас ")); Serial.print(SPI_HZ_NAME[spiHzIdx]); Serial.println(F(")"));
  if (got < hz * 9 / 10)
    Serial.println(F("!! меньше запрошенного: частоту ограничивает clk_peri — см. строку «часы:»"));
  if (panelInited) {
    uiClear(0); uiPush();                      // сразу видно, держит ли панель эту частоту
  }                                            // v9.7.1: до инициализации панели кадр не шлём —
                                               // он «закрывал» кэш строк, и стартовая зачистка
                                               // экрана пропускалась (оставались следы прошлого кадра)
}

// ============================================================ кадровый буфер интерфейса
// интерфейс (меню/тесты/заставка) рисуем байтовыми индексами оттенка 0..3
static uint8_t uiBuf[MEM_W * MEM_H];

// печать строки 3x5 в буфер интерфейса (шрифт 3x5, sc = размер)
struct Glyph { char c; uint8_t rows[5]; };
static const Glyph FONT[] = {
  {'0', {0b111, 0b101, 0b101, 0b101, 0b111}}, {'1', {0b010, 0b110, 0b010, 0b010, 0b111}},
  {'2', {0b111, 0b001, 0b111, 0b100, 0b111}}, {'3', {0b111, 0b001, 0b111, 0b001, 0b111}},
  {'4', {0b101, 0b101, 0b111, 0b001, 0b001}}, {'5', {0b111, 0b100, 0b111, 0b001, 0b111}},
  {'6', {0b111, 0b100, 0b111, 0b101, 0b111}}, {'7', {0b111, 0b001, 0b001, 0b001, 0b001}},
  {'8', {0b111, 0b101, 0b111, 0b101, 0b111}}, {'9', {0b111, 0b101, 0b111, 0b001, 0b111}},
  {'A', {0b111, 0b101, 0b111, 0b101, 0b101}}, {'B', {0b110, 0b101, 0b110, 0b101, 0b110}},
  {'C', {0b111, 0b100, 0b100, 0b100, 0b111}}, {'D', {0b110, 0b101, 0b101, 0b101, 0b110}},
  {'E', {0b111, 0b100, 0b110, 0b100, 0b111}}, {'F', {0b111, 0b100, 0b110, 0b100, 0b100}},
  {'G', {0b111, 0b100, 0b101, 0b101, 0b111}}, {'H', {0b101, 0b101, 0b111, 0b101, 0b101}},
  {'I', {0b111, 0b010, 0b010, 0b010, 0b111}}, {'K', {0b101, 0b101, 0b110, 0b101, 0b101}},
  {'L', {0b100, 0b100, 0b100, 0b100, 0b111}}, {'M', {0b101, 0b111, 0b111, 0b101, 0b101}},
  {'N', {0b101, 0b111, 0b111, 0b111, 0b101}}, {'O', {0b111, 0b101, 0b101, 0b101, 0b111}},
  {'P', {0b111, 0b101, 0b111, 0b100, 0b100}}, {'R', {0b111, 0b101, 0b111, 0b110, 0b101}},
  {'S', {0b111, 0b100, 0b111, 0b001, 0b111}}, {'T', {0b111, 0b010, 0b010, 0b010, 0b010}},
  {'U', {0b101, 0b101, 0b101, 0b101, 0b111}}, {'V', {0b101, 0b101, 0b101, 0b101, 0b010}},
  {'W', {0b101, 0b101, 0b111, 0b111, 0b101}}, {'X', {0b101, 0b101, 0b010, 0b101, 0b101}},
  {'Y', {0b101, 0b101, 0b010, 0b010, 0b010}},
  {' ', {0, 0, 0, 0, 0}}, {'-', {0, 0, 0b111, 0, 0}}, {':', {0, 0b010, 0, 0b010, 0}},
  {'+', {0, 0b010, 0b111, 0b010, 0}}, {'?', {0b111, 0b001, 0b011, 0, 0b010}},
  {'/', {0b001, 0b001, 0b010, 0b100, 0b100}}, {'!', {0b010, 0b010, 0b010, 0, 0b010}},
  {'%', {0b101, 0b001, 0b010, 0b100, 0b101}}, {'=', {0, 0b111, 0, 0b111, 0}},
  // v8.9u: не хватало букв J Q Z (из-за этого ZELDA выглядела как полоски),
  // скобок (SOUND PROBE (6 TESTS)), точки/подчёркивания (имена файлов),
  // запятой (экран оттенков 'k'), звёздочки (маркер текущей игры) и апострофа.
  {'J', {0b001, 0b001, 0b001, 0b101, 0b111}}, {'Q', {0b111, 0b101, 0b101, 0b101, 0b011}},
  {'Z', {0b111, 0b001, 0b010, 0b100, 0b111}},
  {'(', {0b001, 0b010, 0b010, 0b010, 0b001}}, {')', {0b100, 0b010, 0b010, 0b010, 0b100}},
  {'.', {0, 0, 0, 0, 0b010}}, {',', {0, 0, 0, 0b010, 0b100}},
  {'*', {0, 0b101, 0b010, 0b101, 0}}, {'_', {0, 0, 0, 0, 0b111}},
  {'\'', {0b010, 0b010, 0, 0, 0}},
};
static const uint8_t *glyph(char c) {
  if (c >= 'a' && c <= 'z') c -= 32;
  const uint8_t *miss = 0;
  for (unsigned i = 0; i < sizeof(FONT) / sizeof(FONT[0]); i++) {
    if (FONT[i].c == c) return FONT[i].rows;
    if (FONT[i].c == '?') miss = FONT[i].rows;
  }
  // v8.9u: неизвестный знак — '?', а не последний глиф таблицы ('=' раньше
  // превращал каждую Z в полоски и молча прятал проблему).
  return miss ? miss : FONT[0].rows;
}
static void uiClear(uint8_t shade) { memset(uiBuf, shade, sizeof(uiBuf)); }
static void uiText(int x, int y, int sc, const char *s, uint8_t shade) {
  for (; *s; s++) {
    const uint8_t *g = glyph(*s);
    for (int r = 0; r < 5; r++)
      for (int c = 0; c < 3; c++) {
        if (!((g[r] >> (2 - c)) & 1)) continue;
        for (int dy = 0; dy < sc; dy++)
          for (int dx = 0; dx < sc; dx++) {
            int px = x + c * sc + dx, py = y + r * sc + dy;
            if (px >= 0 && py >= 0 && px < MEM_W && py < MEM_H) uiBuf[py * MEM_W + px] = shade;
          }
      }
    x += 4 * sc;
  }
}
static void uiTextCentered(int y, int sc, const char *s, uint8_t shade) {
  int len = 0; for (const char *p = s; *p; p++) len++;
  uiText((MEM_W - len * 4 * sc) / 2, y, sc, s, shade);
}
static void uiRect(int x, int y, int w, int h, uint8_t shade) {
  for (int j = 0; j < h; j++) {
    if (y + j < 0 || y + j >= MEM_H) continue;
    for (int i = 0; i < w; i++) {
      int px = x + i;
      if (px < 0 || px >= MEM_W) continue;
      uiBuf[(y + j) * MEM_W + px] = shade;
    }
  }
}

// отправить весь uiBuf на экран
static void uiPush(void) {
  mark(PH_UI);
  frameStart();
  for (int r = 0; r < MEM_H; r++) {
    const uint8_t *src = &uiBuf[r * MEM_W];
    uint16_t *w = (uint16_t *)uiRow();
    if (!w) break;
    for (int x = 0; x < MEM_W; x++) w[x] = uiColSw[src[x] & 3];
    uiRowSend();
  }
  frameFinish();
}

// -------- диагностика: сколько пикселей каждого слоя и оттенка даёт ядро --------
static int      diagFrames = 0;
static uint32_t diagCnt[4][4];              // [метка слоя][оттенок]

// --- клавиша t: «почему экран чёрный» -------------------------------------
// Печатает каждую 8-ю строку кадра: сколько точек какого слоя пришло от ядра и
// сколько строк панели из неё ушло (з=0 значит НЕ ушло), а раз в 32 строки —
// состояние ЖК-контроллера игры: включён ли он, где луч, какие палитры, где PC.
static void drawDiagLine(struct gb_s *g, const uint8_t *px, int line) {
  if ((line & 7) != 0) return;
  int bg = 0, win = 0, sp = 0;
  for (int i = 0; i < 160; i++) {
    const uint8_t v = px[i];
    if (v & 0x20) sp++;
    else if (v & 0x10) win++;
    else if (v & 0x03) bg++;
  }
  Serial.print(F("стр ")); Serial.print(line);
  Serial.print(F(": л=")); Serial.print(bg);
  Serial.print(F(" о="));  Serial.print(win);
  Serial.print(F(" п="));  Serial.print(sp);
  Serial.print(F(" з="));  Serial.print(frameRows);
  if ((line & 31) == 24) {
    Serial.print(F("  ЖК: LCDC=0x")); Serial.print(g->hram_io[IO_LCDC], HEX);
    Serial.print(F(" STAT=0x"));      Serial.print(g->hram_io[IO_STAT], HEX);
    Serial.print(F(" LY="));          Serial.print((int)g->hram_io[IO_LY]);
    Serial.print(F(" SCY="));         Serial.print((int)g->hram_io[IO_SCY]);
    Serial.print(F(" SCX="));         Serial.print((int)g->hram_io[IO_SCX]);
    Serial.print(F(" BGP=0x"));       Serial.print(g->hram_io[IO_BGP], HEX);
    Serial.print(F(" PC=0x"));        Serial.print((uint32_t)g->cpu_reg.pc.reg, HEX);
  }
  Serial.println();
}

// настоящая скорость шины по факту: Мбит/с
static float rateMbit(uint32_t bytes, uint32_t us) {
  if (!us) return 0.0f;
  return (float)((double)bytes * 8000000.0 / (double)us / 1000000.0);
}

// «Правда о шине»: что реально стоит в регистрах SPI (а не то, что мы просили).
static void printSpiTruth(void) {
  const uint32_t peri = clock_get_hz(clk_peri);
  const uint32_t cpsr = spi_get_hw(spi0)->cpsr;
  const uint32_t cr0  = spi_get_hw(spi0)->cr0;
  const uint32_t scr  = ((cr0 & 0x0000FF00u) >> 8) + 1;   // делитель = SCR+1
  const uint32_t baud = spi_get_baudrate(spi0);
  Serial.print(F("шина: clk_peri ")); Serial.print(peri / 1000000.0f, 1);
  Serial.print(F(" МГц, CPSR ")); Serial.print(cpsr);
  Serial.print(F(", SCR ")); Serial.print(scr);
  Serial.print(F(" -> ")); Serial.print(baud / 1000000.0f, 1);
  Serial.print(F(" МГц; dmacr=0x")); Serial.print(spi_get_hw(spi0)->dmacr, HEX);
  Serial.print(F(", sr=0x")); Serial.println(spi_get_hw(spi0)->sr, HEX);
  Serial.println(F("(8 бит на кадр: одна запись в FIFO = ровно один байт в панель)"));
}

// --- клавиша j: тест самой панели (без эмулятора) --------------------------
// Заливаем экран четырьмя полосами оттенков палитры. Если полосы видно, а игра
// чёрная — значит панель и SPI живы, дело в данных от ядра (тогда клавиша t).
// Если и полос не видно — дело в панели или шине (тогда клавиша e).
static void panelTest(void) {
  Serial.println(F("--- ТЕСТ ПАНЕЛИ (j): четыре полосы оттенков палитры ---"));
  printSpiTruth();
  rowsValid = false;                 // v9.5: диагностика показывает КАЖДУЮ строку (без кадрового диффа)
  frameStart();
  for (int r = 0; r < MEM_H; r++) {
    const uint16_t c = uiColSw[(r * 4) / MEM_H];      // 0..3: полосы от светлого к тёмному
    uint16_t *w = (uint16_t *)uiRow();
    if (!w) break;
    for (int x = 0; x < MEM_W; x++) w[x] = c;
    uiRowSend();
  }
  frameFinish();
  Serial.print(F("отправил ")); Serial.print(frameRows);
  Serial.print(F(" строк, ")); Serial.print(txBytesFrame);
  Serial.print(F(" байт, кадр ")); Serial.print(frameUs / 1000.0f, 1);
  Serial.print(F(" мс = ")); Serial.print(rateMbit(txBytesFrame, frameUs), 2);
  Serial.println(F(" Мбит/с (это и есть настоящая скорость шины)"));
  if (frameRows != MEM_H) Serial.println(F("!! строк ушло не 240 — панель не приняла часть кадра"));
  Serial.println(F("Если полос не видно — панель или шина, клавиша e; если видно — дело в игре."));
}

static void drawDiagStart(void) {
  diagFrames = 1;                            // следующий кадр — с полным разбором
  Serial.println(F("--- ДИАГНОСТИКА КАДРА (клавиша t) ---"));
  Serial.println(F("л/о/п — сколько точек пришло от ядра в фоновом слое, окне и спрайтах,"));
  Serial.println(F("з — сколько строк панели ушло к этому моменту (0 = строки не уходят)."));
  Serial.println(F("ЖК: LCDC (0x91 = экран игры включён), LY — на какой строке луч,"));
  Serial.println(F("BGP — палитра фона (E4 = стандарт), PC — где сейчас процессор игры."));
  Serial.println(F("Итог по всему кадру (оттенки по слоям) печатает клавиша v."));
  Serial.println(F("(если открыто меню — сначала закройте его: разбор идёт по кадрам игры)"));
}

static void diagCount(struct gb_s *g, const uint8_t *pixels) {
  (void)g;
  for (int x = 0; x < 160; x++) diagCnt[(pixels[x] >> 4) & 3][pixels[x] & 3]++;
}

static void diagReport(struct gb_s *g) {
  static const char *lay[4] = { "OBJ0", "OBJ1", "BG", "?" };
  Serial.println(F("--- что отдаёт ядро за кадр (слой x оттенок) ---"));
  for (int l = 0; l < 4; l++) {
    Serial.print(F("  ")); Serial.print(lay[l]); Serial.print(F(":"));
    for (int sh = 0; sh < 4; sh++) { Serial.print(F("  отт")); Serial.print(sh); Serial.print('='); Serial.print(diagCnt[l][sh]); }
    Serial.println();
  }
  Serial.print(F("  палитры игры: BGP=0x")); Serial.print(g->hram_io[0x47], HEX);
  Serial.print(F("  OBP0=0x"));             Serial.print(g->hram_io[0x48], HEX);
  Serial.print(F("  OBP1=0x"));             Serial.println(g->hram_io[0x49], HEX);
  Serial.println(F("  (отт0 — самый светлый; если у OBJ много отт1/отт2, детали есть)"));
  memset(diagCnt, 0, sizeof(diagCnt));
}

// ============================================================ КАРТРИДЖИ (несколько игр)
// Игры лежат НЕ в прошивке, а в отдельной области flash — её кладёт упаковщик
// tools/roms_pack/make_roms_uf2.py (файл games.uf2). Такая раскладка выбрана затем,
// что область игр НЕ зависит от размера прошивки: прошили новую версию — игры и их
// сейвы на месте, и НИ ОДИН байт flash при этом не перезаписывается.
// v9.0: область переехала с 0x100000 на 0x80000 (+512 КБ под игры: прошивка
// ~135 КБ, граница стояла с огромным запасом). Сейвы/стейты — ниже границы.
//
//   0x80000..0x80FFF    таблица игр (заголовок 16 Б + записи RomEntry)
//   0x81000..0x81FFF    «какая игра выбрана последней» (пишет консоль, только при смене)
//   0x82000..0x1FD000   сами игры (образы, каждый выровнен на 4 КиБ), 1516 КБ
//
// Верх области (0x1FD000..0x200000) — область картриджа (SRAM) и чёрный ящик, как было.
#define ROMS_TABLE_OFF   0x80000UL
#define ROMS_STATE_OFF   0x81000UL
#define ROMS_DATA_OFF    0x82000UL
#define ROMS_MAGIC       0x32524D47UL     // "GMR2" (v9.0: область переехала, старые наборы не читаем)
#define ROMS_STATE_MAGIC 0x31545347UL     // "GST1"
#define ROM_NAME_LEN     24
#define ROM_MAX          48

struct RomEntry {                      // 44 байта; раскладка должна совпадать с make_roms_uf2.py
  char     name[ROM_NAME_LEN];         // имя игры (из заголовка образа)
  uint32_t off;                        // смещение образа от начала flash
  uint32_t size;                       // размер образа (степень двойки)
  uint32_t crc;                        // CRC32 образа: ключ сейва SRAM этой игры
  uint32_t sram;                       // размер памяти сохранений (0 — нет)
};

static RomEntry    romList[ROM_MAX];
static int         romCount = 0;       // сколько игр лежит во flash
static int         romCur   = -1;      // какая игра идёт сейчас (-1 — встроенная из rom.h)
static uint32_t    romKib   = 0;       // сколько КиБ занимают игры
static uint32_t    romSramMax = 0;     // самая большая память сохранений среди игр
static int         romMenuSel = 0, romMenuTop = 0;
static uint16_t    romMenuPrev = 0xFFFF;
static char        romMenuMsg[22] = {0};
static int         saveConfirmGame = -1, saveConfirmVictim = -1;   // v9.1: вопрос про вытеснение сейва
static uint32_t    saveConfirmKey = 0;
static bool        romSaved = false;   // сейв текущей игры восстановлен

// откуда ядро читает образ: область картриджей или встроенная игра (rom.h)
static const uint8_t *romBase = ROM_DATA;
static uint32_t romSize = ROM_SIZE;
static uint32_t romMask = ROM_MASK;
static uint32_t romSaveKey = 0;        // ключ сейва: CRC32 образа (0 — встроенная игра)

static uint32_t romFingerprint(void);
static void romScan(void);
static bool romStart(int idx, bool splash);
static void romMenuOpen(void);
static void romMenuDraw(void);
static void romMenuTick(uint16_t mask);
static bool romStateLoad(int *out);
static void romStateSave(int idx);
static void romStateFlushAtExit(void);
static void saveInit(size_t wantBytes, int banks);
static void saveBind(uint32_t key);

// ============================================================ эмулятор
static struct gb_s gb;
static uint8_t     cartRam[32768];
static bool        emuInited = false;
// v8.9p: первые мгновения после смены игры кадры идут в эмулятор, но НЕ в панель.
// Нагрузка поднимается двумя ступенями (сначала звук с эмулятором, потом панель) —
// так просадка питания при запуске игры меньше. Экран в это время показывает заставку.
static uint32_t    panelHoldUntil = 0;
#define PANEL_HOLD_MS 400
static bool        paused = false;
static bool        cartDirty = false;

static uint8_t cb_rom_read(struct gb_s *g, const uint_fast32_t addr) {
  (void)g;
  return romBase[addr & romMask];       // область картриджей или встроенная игра
}
static uint8_t cb_cart_read(struct gb_s *g, const uint_fast32_t addr) {
  (void)g;
  return cartRam[addr & 0x7FFF];
}
static void cb_cart_write(struct gb_s *g, const uint_fast32_t addr, const uint8_t val) {
  (void)g;
  uint32_t a = addr & 0x7FFF;
  if (cartRam[a] != val) { cartRam[a] = val; cartDirty = true; }
}
static void cb_error(struct gb_s *g, const enum gb_error_e err, const uint16_t addr) {
  (void)g;
  Serial.print(F("GB ERROR ")); Serial.print((int)err);
  Serial.print(F(" at 0x")); Serial.println((int)addr, HEX);
}




// строка GB: 160 px -> 240 px, сразу пишем в поток DMA
// статистика коллбэка (для диагностики кадра)
static uint32_t cbAccUs = 0, cbCalls = 0;

// Одна строка панели: собрали — отправили.
// ВАЖНО (нашёл санитайзер на стенде): буфер объявлен uint32_t[], а НЕ uint8_t[].
// Причина — строка собирается 32-битной записью (*(uint32_t*)&buf[i] = цвет).
// Массив uint8_t формально выровнен на 1 байт, и на Cortex-M0+ невыровненная
// 32-битная запись — АППАРАТНЫЙ СБОЙ. Пока везло с адресом; теперь это
// гарантировано типом. Байтовый вид — через приведение, там, где нужно.
static uint32_t tx_rowbuf[ROW_BYTES / 4];

// ============================================================ свидетели смерти (v8.8)
// Регистры ядра M0+. Обращаемся ПО АДРЕСАМ, а не через CMSIS: так этот же код
// собирается и на компьютере — в стенде адреса подменяются переменными стенда
// (сборка стенда идёт с -DGBEMU_HOST).
#ifdef GBEMU_HOST
extern volatile uint32_t gHostVtor;                        // куда записали VTOR (для проверки)
extern const uint32_t *gHostVtorSrc(void);                 // откуда читать «таблицу векторов»
extern void gHostVtorSet(const uint32_t *tab);
extern volatile uint32_t gHostCfsr, gHostHfsr, gHostMmfar, gHostBfar;
extern volatile uint32_t gHostDfsr, gHostAfsr;
extern volatile uint32_t gHostChipReset;
#define SYS_VTOR_GET()  gHostVtorSrc()
#define SYS_VTOR_SET(t) gHostVtorSet(t)
#define SYS_CFSR  ((uint32_t)gHostCfsr)
#define SYS_HFSR  ((uint32_t)gHostHfsr)
#define SYS_MMFAR ((uint32_t)gHostMmfar)
#define SYS_BFAR  ((uint32_t)gHostBfar)
#define SYS_DFSR  ((uint32_t)gHostDfsr)
#define SYS_AFSR  ((uint32_t)gHostAfsr)
#else
// На устройстве — настоящие регистры ядра M0+ (SCB), по адресам: так этот же код
// собирается и на компьютере (в стенде адреса подменяются, см. выше).
#define SYS_VTOR_GET()  ((const uint32_t *)(uintptr_t)(*(volatile uint32_t *)0xE000ED08u))
#define SYS_VTOR_SET(t) (*(volatile uint32_t *)0xE000ED08u = (uint32_t)(uintptr_t)(t))
#define SYS_CFSR  ((uint32_t)(*(volatile uint32_t *)0xE000ED28u))   // SCB->CFSR
#define SYS_HFSR  ((uint32_t)(*(volatile uint32_t *)0xE000ED2Cu))   // SCB->HFSR
#define SYS_MMFAR ((uint32_t)(*(volatile uint32_t *)0xE000ED34u))   // SCB->MMFAR
#define SYS_BFAR  ((uint32_t)(*(volatile uint32_t *)0xE000ED38u))   // SCB->BFAR
#define SYS_DFSR  ((uint32_t)(*(volatile uint32_t *)0xE000ED30u))   // SCB->DFSR
#define SYS_AFSR  ((uint32_t)(*(volatile uint32_t *)0xE000ED3Cu))   // SCB->AFSR
#endif

static void blkWrite(void);                    // объявлен заранее: нужен при смерти
static void blkFlush(bool allowErase);         // сброс кольца ОЗУ во flash (выключение/смерть)
static volatile uint32_t gDieA = 0, gDieB = 0, gDieC = 0, gDieD = 0;   // подробности смерти
static bool gInDieReport = false;              // пишем ящик из отчёта о смерти (тогда звук не трогаем)
static uint32_t gFaultPc = 0, gFaultLr = 0;    // где именно зацепило (для лога)
// Свидетели стека. Кадр исключения испорчен (CFSR=0, HFSR=0) ровно тогда, когда
// сбой случился на УКЛАДКЕ стека — то есть когда указатель стека был плохой.
// Поэтому записываем сам SP, оба указателя (MSP/PSP) и «глубину» стека.
static uint32_t gFaultSp = 0, gFaultMsp = 0, gFaultPsp = 0, gFaultXpsr = 0;
static uint32_t gStackTop = 0;                 // MSP на старте = верх стека
static uint32_t gStackMin = 0;                 // самый глубокий MSP за сеанс
#define STACK_PAINT     512u                   // сколько красить ниже верхушки (для проверки)
static uint32_t gStackPaintLo = 0;             // докуда закрасили

static inline uint32_t readMsp(void) {         // без CMSIS: MRS есть в Thumb-1 на M0+
#ifndef GBEMU_HOST
  uint32_t v; __asm volatile ("mrs %0, msp" : "=r"(v)); return v;
#else
  return 0;
#endif
}
static inline uint32_t readPsp(void) {
#ifndef GBEMU_HOST
  uint32_t v; __asm volatile ("mrs %0, psp" : "=r"(v)); return v;
#else
  return 0;
#endif
}
static inline void stackWitness(void) {        // позвать в глубоких местах
#ifndef GBEMU_HOST
  const uint32_t sp = readMsp() & ~3u;
  if (!gStackMin || sp < gStackMin) gStackMin = sp;
#endif
}
static uint32_t stackUseBytes(void) {          // сколько байт стека ушло за сеанс
  if (!gStackTop || !gStackMin) return 0;
  return (gStackTop > gStackMin) ? (gStackTop - gStackMin) : 0;
}

static const char *faultWhy(uint32_t cfsr, uint32_t hfsr) {
  if (cfsr & (1u << 9))  return "чтение из запретной области (ошибка шины)";
  if (cfsr & (1u << 10)) return "запись в запретную область (ошибка шины)";
  if (cfsr & (1u << 1))  return "обращение по нечётному адресу (M0+ так не умеет)";
  if (cfsr & (1u << 16)) return "непонятная инструкция";
  if (hfsr & (1u << 30)) return "сбой выдан из-за другого сбоя";
  return "неизвестно";
}

// Что печатать в момент смерти
static void printWhere(void) {
  Serial.print(F("   фаза "));         Serial.print(phaseName(gPhase));
  Serial.print(F(", кадр "));         Serial.print(gFramesTotal);
  Serial.print(F(", прожили "));      Serial.print(millis() / 1000); Serial.println(F(" с"));
  Serial.print(F("   игра: PC=0x"));   Serial.print((uint32_t)gb.cpu_reg.pc.reg, HEX);
  Serial.print(F(" SP=0x"));          Serial.print((uint32_t)gb.cpu_reg.sp.reg, HEX);
  Serial.print(F("  строка ЖК "));     Serial.print((unsigned)gb.hram_io[IO_LY]);
  Serial.print(F("  ЖК "));           Serial.print(gLcdOn ? F("включён") : F("ВЫКЛЮЧЕН"));
  Serial.print(F("  строк на панель ")); Serial.print(frameRows);
  Serial.print(F(" (пропущено ")); Serial.print(frameSkip);
  Serial.print(F(")  строк от ядра ")); Serial.println(frameLineCore);
  if (gFaultSp || gFaultMsp || gFaultPsp) {
    Serial.print(F("   стек: SP=0x"));  Serial.print(gFaultSp, HEX);
    Serial.print(F(" MSP=0x"));         Serial.print(gFaultMsp, HEX);
    Serial.print(F(" PSP=0x"));         Serial.print(gFaultPsp, HEX);
    Serial.print(F(" xPSR=0x"));        Serial.println(gFaultXpsr, HEX);
    Serial.print(F("   стек: верх 0x")); Serial.print(gStackTop, HEX);
    Serial.print(F(", ушло "));          Serial.print(stackUseBytes()); Serial.println(F(" байт"));
    if (gFaultXpsr && !(gFaultXpsr & (1u << 24)))
      Serial.println(F("   !! в кадре нет бита Thumb — кадр исключения испорчен: похоже на переполнение стека"));
  }
  Serial.print(F("   SPI: sr=0x"));    Serial.print(spi_get_hw(spi0)->sr, HEX);
  Serial.print(F("  сбоев "));         Serial.print(spiStuck);
  Serial.print(F(", неудачных строк ")); Serial.print(txRowsFail);
  Serial.print(F(", байт всего "));    Serial.println(txBytes);
}

// Смерть: печатаем всё, что знаем, кладём в чёрный ящик и гасим консоль САМИ
// (иначе через 4 с придёт сторож, питание уйдёт — и мы ничего не увидим).
static void dieReport(uint32_t phase, uint32_t a, uint32_t b, uint32_t c, uint32_t d) {
  gDieA = a; gDieB = b; gDieC = c; gDieD = d;
  gInDieReport = true;
  mark(phase);
  Serial.println();
  Serial.println(F("================================================================"));
  Serial.print(F("!!! "));
  if (phase == PH_FAULT) Serial.println(F("АППАРАТНЫЙ СБОЙ (HardFault): печатаю, где и почему."));
  else                   Serial.println(F("ЦИКЛ ЗАЛИП (а прерывание звука шло) — это не сбой, а вечное ожидание."));
  printWhere();
  if (phase == PH_FAULT) {
    Serial.print(F("   причина: ")); Serial.println(faultWhy(a, d));
    Serial.print(F("   CFSR=0x")); Serial.print(a, HEX);
    Serial.print(F(" HFSR=0x"));   Serial.print(d, HEX);
    Serial.print(F(" MMFAR=0x"));  Serial.print(c, HEX);
    Serial.print(F(" BFAR=0x"));   Serial.print(c, HEX); Serial.println();
    Serial.print(F("   адрес сбоя 0x")); Serial.print(b, HEX);
    Serial.print(F(" (LR=0x")); Serial.print(gFaultLr, HEX); Serial.println(F(")"));
    Serial.println(F("   сравните адрес с картой функций из начала лога"));
  }
  blkWrite();                                  // отметка в чёрный ящик (он всё переживёт)
  blkFlush(true);                              // и всё кольцо ОЗУ — во flash (последний шанс)
  Serial.flush(); delay(150);
  Serial.println(F("=== пикну и погашу консоль сама — так вы увидите этот лог ==="));
  pwm_set_gpio_level(PIN_AUDIO, 620);
  mark(PH_POWERCUT);
  watchdog_hw->scratch[5] = WD_POWER;
  Serial.flush(); delay(150);
  digitalWrite(PIN_PWR_HOLD, LOW);
  for (int i = 0; i < 8; i++) { delay(100); wdtFeed(); }
  digitalWrite(PIN_PWR_HOLD, HIGH);            // питание не снялось — остаёмся живы
  mark(phase);
  gInDieReport = false;
  pwm_set_gpio_level(PIN_AUDIO, APU_PWM_IDLE);
  Serial.println(F("=== питание не снялось (GPIO1 не ключ?) — остаюсь в этом состоянии ==="));
  Serial.flush();
}

// ДОКЛАД ИЗ ОБЫЧНОГО ПОТОКА (v8.9d). Здесь и только здесь можно печатать:
// мы уже вернулись из обработчика, прерывания работают, USB выгружает буфер.
// Сюда попадаем и при сбое ядра, и при залипании цикла (см. faultTriggerNow()).
#ifndef GBEMU_HOST
static void __attribute__((noreturn)) faultAftermath(void) {
  stackWitness();
  dieReport(gPhase == PH_STALL ? PH_STALL : PH_FAULT,
            gDieA, gDieB, gDieC, gDieD);          // печать + запись в ящик
  Serial.println(F("=== (этот текст напечатан ИЗ ОБЫЧНОГО ПОТОКА: до вас он доходит) ==="));
  Serial.flush(); delay(200);
  // Пищим, снимаем питание — чтобы лог дошёл и консоль погасла сама.
  pwm_set_gpio_level(PIN_AUDIO, 620);
  mark(PH_POWERCUT);
  watchdog_hw->scratch[5] = WD_POWER;
  Serial.flush(); delay(150);
  digitalWrite(PIN_PWR_HOLD, LOW);
  for (int i = 0; i < 12; i++) { delay(100); wdtFeed(); }
  digitalWrite(PIN_PWR_HOLD, HIGH);               // не снялось — остаёмся живы и кормим сторожа
  pwm_set_gpio_level(PIN_AUDIO, APU_PWM_IDLE);
  Serial.println(F("=== питание не снялось (GPIO1 не ключ?) — остаюсь в этом состоянии, сторож кормлю ==="));
  Serial.flush();
  watchdog_enable(WD_MS, false);
  for (;;) { wdtFeed(); Serial.flush(); tight_loop_contents(); }
}
#endif

// ДЫРА, из-за которой отчётов не было видно: у HardFault приоритет -1, ВЫШЕ всех
// обычных прерываний. Сидя в обработчике, мы блокируем USB — то есть всё, что в нём
// напечатано, физически не может уехать в терминал и пропадает при сбросе сторожем.
// Поэтому обработчик ничего не печатает: он сохраняет состояние, пишет запись в
// чёрный ящик, выключает сторожа и ПОДМЕНЯЕТ адрес возврата в кадре исключения на
// faultAftermath(). Возврат `bx lr` уводит нас в обычный поток, где всё работает.
extern "C" uint32_t __attribute__((used)) gbHardFaultC(uint32_t *frame, uint32_t excReturn) {
  stackWitness();
  gFaultPc = frame[6]; gFaultLr = frame[5];
  gFaultXpsr = frame[7];
  gFaultSp = (uint32_t)(uintptr_t)frame;          // SP на входе = адрес кадра
#ifndef GBEMU_HOST
  gFaultMsp = readMsp(); gFaultPsp = readPsp();
  // Залипание приходит сюда «по умыслу» (см. faultTriggerNow) — и тогда подробности
  // сбоя НЕ затирают подробности залипания, ведь сбоя как такового нет.
  if (gPhase != PH_STALL) {
    gDieA = SYS_CFSR; gDieB = gFaultPc;
    gDieC = (SYS_CFSR & (1u << 10)) ? SYS_BFAR : SYS_MMFAR;
    gDieD = SYS_HFSR;
  }
  // Снять бит ENABLE (бит 30) сторожа АТОМАРНЫМ CLR-алиасом (+0x3000). Так не нужно
  // ни hw_clear_bits(), ни риск задеть поле TIME обычной «читай-пиши».
  *(volatile uint32_t *)((uintptr_t)&watchdog_hw->ctrl + 0x3000u) = 0x40000000u;  // сторож выкл
  (void)excReturn;                                // возвращаем свою константу: уходим в поток
  blkWrite();                                     // запись в ящик — ДО печати
  frame[6] = ((uint32_t)(uintptr_t)&faultAftermath) | 1u;    // вернёмся сюда (бит Thumb)
  // Возвращаемся В ПОТОК с MSP: 0xFFFFFFF9. Так доклад печатается при включённых
  // прерываниях, даже если сбой случился внутри прерывания звука.
  return 0xFFFFFFF9u;
#else
  (void)excReturn;
  gDieA = SYS_CFSR; gDieB = gFaultPc;
  gDieC = (SYS_CFSR & (1u << 10)) ? SYS_BFAR : SYS_MMFAR;
  gDieD = SYS_HFSR;
  dieReport(PH_FAULT, gDieA, gDieB, gDieC, gDieD);
  return excReturn;
#endif
}
// Вход в обработчик. Кадр исключения (R0..R3, R12, LR, PC, xPSR) процессор кладёт в
// стек, и SP в этот момент — указатель на него; прочитать его из C нельзя. Поэтому
// здесь две инструкции ассемблера, и ТОЛЬКО такие, какие умеет Thumb-1 (Cortex-M0+):
//   mov r0, sp   — указатель на кадр в первый аргумент
//   bl  gbHardFaultC — вызов (bl в Thumb всегда есть; он же несёт бит Thumb сам)
// Чего здесь НЕЛЬЗЯ (на этом и упала сборка): orr r1, r1, #1 — «ORR с числом» в
// Thumb-1 не существует (ошибка ассемблера «unshifted register required»), а широкое
// ветвление b.w на M0+ тоже недоступно (дальность b.n всего ±2 КБ).
// Если ваш компилятор и к этому отнесётся плохо — поставьте FAULT_TRAP_ASM 0: тогда
// вектор указывает прямо на C-функцию (в логе не будет PC сбоя, причина и регистры
// CFSR/HFSR/BFAR останутся), и ассемблера в сборке не будет вовсе.
#define FAULT_TRAP_ASM 1
#ifndef GBEMU_HOST
#if FAULT_TRAP_ASM
extern "C" void __attribute__((naked)) gbHardFaultEntry(void) {
  // r0 = кадр исключения (SP), r1 = EXC_RETURN (куда возвращаться),
  // gbHardFaultC возвращает EXC_RETURN (подменённый на «в поток»), bx r0 уносит нас
  // туда. Только Thumb-1-инструкции: mov/bl/bx — всё это на M0+ есть всегда.
  __asm volatile ("mov r0, sp\n\tmov r1, lr\n\tbl gbHardFaultC\n\tbx r0\n");
}
#define FAULT_VECTOR_TARGET ((uint32_t)(uintptr_t)&gbHardFaultEntry)
#else
extern "C" void __attribute__((used)) gbHardFaultNoFrame(void) {
  gFaultPc = 0; gFaultLr = 0;                   // кадр стека недоступен без ассемблера
  dieReport(PH_FAULT, SYS_CFSR, 0,
            (SYS_CFSR & (1u << 10)) ? SYS_BFAR : SYS_MMFAR, SYS_HFSR);
  for (;;) { wdtFeed(); tight_loop_contents(); }
}
#define FAULT_VECTOR_TARGET ((uint32_t)(uintptr_t)&gbHardFaultNoFrame)
#endif
#else
extern "C" void gbHardFaultEntry(void) { }      // на компьютере вход не нужен
#define FAULT_VECTOR_TARGET ((uint32_t)(uintptr_t)&gbHardFaultEntry)
#endif
static uint32_t gVecSave[64] __attribute__((aligned(512)));

// Ставим ловушку: копируем таблицу векторов в ОЗУ и подменяем в ней HardFault.
// Без этого сбой на M0+ — молчаливое зависание (вектор ведёт на инструкцию BKPT).
static void faultTrapInstall(void) {
  const uint32_t *src = SYS_VTOR_GET();
  for (int i = 0; i < 64; i++) gVecSave[i] = src[i];
  gVecSave[3] = FAULT_VECTOR_TARGET | 1u;                        // HardFault (бит Thumb обязателен)
  gVecSave[2] = gVecSave[3];                                     // NMI — тем же путём
  SYS_VTOR_SET(gVecSave);
}

void loop(void);                                // объявлен заранее: печатаем её адрес в карте
static void GB_RAM cb_lcd_line(struct gb_s *g, const uint8_t *pixels, const uint_fast8_t line) {
  frameLineCore = line;                        // свидетель: до этой строки ядро дошло
  if (!frameOpen) return;                      // кадр не открыт (пропущен или был занят) — панель не трогаем
  mark(PH_DRAW);
  cbCalls++;
  if (diagFrames) { diagCount(g, pixels); drawDiagLine(g, pixels, (int)line); }

  // 160 точек игры -> 240 точек панели (как в v8: две точки дважды и одна один раз).
  // ВАЖНО (нашли санитайзером): раньше это делалось «32-битной записью по ходу», но
  // 6 байт на итерацию (два пикселя + один) НЕ кратны 4 — и каждая вторая запись
  // попадала на адрес, не кратный 4. На Cortex-M0+ невыровненная 32-битная запись —
  // АППАРАТНЫЙ СБОЙ, к тому же это неопределённое поведение в C.
  // Теперь шаг 4 пикселя игры = 6 пикселей панели = ровно 3 слова по 4 байта:
  //   [p0 p0] [p1 p2] [p2 p3]  — все три записи строго выровнены.
  uint32_t *w = tx_rowbuf;
  for (int sx = 0; sx < 160; sx += 4) {
    const uint16_t c0 = colTab[pixels[sx]],     c1 = colTab[pixels[sx + 1]];
    const uint16_t c2 = colTab[pixels[sx + 2]], c3 = colTab[pixels[sx + 3]];
    *w++ = (uint32_t)c0 | ((uint32_t)c0 << 16);
    *w++ = (uint32_t)c1 | ((uint32_t)c2 << 16);
    *w++ = (uint32_t)c2 | ((uint32_t)c3 << 16);
  }

  // одна строка игры = 1..3 строки панели (1,5x: 216 строк на 144) — шлём каждую
  const int y0 = (line * VB_STEP) >> 8;
  const int y1 = (((line + 1) * VB_STEP) >> 8) - 1;
  const uint32_t c0 = micros();
  for (int y = y0; y <= y1; y++) {
    if (frameY >= MEM_H) break;
    if (!txRowY((const uint8_t *)tx_rowbuf)) return;       // сбой SPI уже посчитан и назван в логе
  }
  const uint32_t c1 = micros();
  cbAccUs += c1 - c0;
  rowLoopAcc += c1 - c0;
  rowLoopN++;
}

// --- строки интерфейса (меню, тесты, заставка) ---
// Тот же путь: собрали строку в буфер — сразу отправили. Никаких «влезло/не влезло».
static uint8_t uiRowBuf[ROW_BYTES] __attribute__((aligned(4)));   // выравнивание: см. tx_rowbuf
static uint8_t *uiRow(void) { return frameOpen ? uiRowBuf : nullptr; }
static void uiRowSend(void) {
  if (!frameOpen) return;
  txRowY(uiRowBuf);                                        // v9.5: с диффом — неизменившаяся строка молчит
}

// ============================================================ сохранения (flash)
extern char __flash_binary_end;              // конец образа (ставит линкер)
static uintptr_t flashBase = 0x10000000UL;   // начало flash (в тесте на хосте подменяется)
static uintptr_t flashEnd = 0;               // абсолютный адрес конца образа
#define FLASH_TOTAL   0x200000UL
#define FLASH_RESERVE 0x1000UL               // последний сектор — служебный (EEPROM ядра)
// Два последних сектора (8 КиБ) занимает «чёрный ящик» (см. ниже): 32 записи по
// 256 байт, поэтому область сейвов и сейвстейтов заканчивается перед ними.
#define BLK_SECTOR    0x1000UL
#define BLK_SECTORS   2
#define FLASH_LIMIT   (FLASH_TOTAL - FLASH_RESERVE - BLK_SECTOR * BLK_SECTORS)
#define SAVE_MAGIC 0x314C4153UL             // "SAL1"
#define SAVE_HDR   256                      // заголовок занимает первую страницу
// v8.9o: в первую страницу добавлены клеймо игры и «поколение» ячейки:
//   0: magic, 4: длина, 8: свёртка данных, 12: ~свёртка,
//   16: CRC32 образа (ключ игры), 20: ~ключ, 24: поколение (для выбора старой ячейки)
#define SAVE_HDR_KEY 16
#define SAVE_HDR_SEQ 24
#define SAVE_BANKS   4                      // ячеек под сейвы SRAM (по одной на игру)

static uint32_t saveOff = 0;                 // смещение ТЕКУЩЕЙ ячейки от начала flash
static int      saveLen = 0;                 // размер одной ячейки (кратно 4096)
static int      saveData = 0;                // объём сохраняемых данных (<= sizeof(cartRam))
static uint32_t saveHash = 0;
static int      bankCount = 0;               // сколько ячеек выделено (1..SAVE_BANKS)
static uint32_t bankOff[SAVE_BANKS] = {0};   // их смещения
static int      saveBank = -1;               // какая ячейка у текущей игры
static uint32_t saveGameCrc = 0;             // ключ игры, которой принадлежит ячейка
static uint32_t saveSeqMax = 0;              // «поколение» записей: по нему выбираем старую ячейку
static bool     saveActive = false;          // у ЭТОЙ игры есть память сохранений (иначе писать нечего)
static uint32_t lastSaveMs = 0;
// ИЗНОС FLASH (v8.9l): считаем стирания секторов — у flash ресурс ~100 000 на сектор.
// Пишем мало и по делу: сейвы — только изменившиеся сектора, ящик — только переиспользуемые.
static uint32_t saveErases = 0;              // стираний секторов под сейвы SRAM
static uint32_t ssErases   = 0;              // стираний секторов под сейвстейты

// ============================================================ ПРИБОР: питание (АЦП)
// В стоковой прошивке АЦП используется: сначала инициализация блока (сброс, затем в
// регистр управления пишется 1 = «включить», то есть канал 0 = GPIO26), а потом
// чтение: пишется 4 (START_ONCE = «начать одно преобразование»), ожидание бита
// «готово» и чтение результата. То есть датчик питания у стока — канал 0 (GP26).
//   ВАЖНО: в RP2040 каналы АЦП 0..3 — это GP26..GP29, а канал 4 — ВНУТРЕННИЙ
//   термодатчик (не вывод платы!).
// Читаем три источника сразу — так по одному логу видно, где что:
//   • канал 0 (GP26) — как в стоке: это и считаем датчиком питания;
//   • канал 3 (GP29) — «как на Pico» (там сюда заведён VSYS через делитель 1:3);
//   • канал 4 — термодатчик: он всегда есть, поэтому служит самопроверкой АЦП
//     (должно быть около 700-800 мВ и расти, если плата греется).
#define PIN_BATT_A    26                // GP26 — канал 0 (в стоке читался он; у нас ВИСИТ)
#define PIN_BATT_B    29                // GP29 — канал 3: ПО ЗАМЕРАМ ЭТО И ЕСТЬ БАТАРЕЯ
#define ADC_CH_A      0
#define ADC_CH_B      3

// ЛОВУШКА ПРОСАДКИ. Батарея (A3) читается прямо в прерывании звука — 2 777 раз в
// секунду (каждый 8-й тик таймера 45 мкс). Это нужно потому, что просадка питания
// длится миллисекунды, и увидеть её опросом раз в запись чёрного ящика невозможно.
// Значения (в отсчётах АЦП, 4095 = 3,3 В на выводе, то есть 6,6 В батареи при 1:2):
//   gDipMin   — минимум за текущее окно (окно закрывается записью в чёрный ящик)
//   gDipMax   — максимум за окно
//   gDipWorst — самый глубокий провал за весь сеанс
static volatile uint16_t gDipMin = 4095, gDipMax = 0, gDipWorst = 4095;
static volatile uint8_t  gAdcTick = 0;
static volatile bool     gDipWarn = false;         // просадку надо напечатать из цикла
static volatile bool     gAdcSweep = false;        // идёт перебор каналов (не мешать!)
static volatile uint8_t  gDipSkip  = 0;           // пропустить один отсчёт (после перебора каналов)
static volatile uint8_t  gDipLowRun = 0;          // v8.9r: сколько замеров ПОДРЯД ниже порога
static volatile uint32_t gDipRunStartMs = 0;      // v8.9t: с какого момента идёт низкий участок
static volatile uint16_t gDipRunMin = 4095;       // v8.9t: его минимум
static uint32_t          gDipEvents = 0;           // сколько раз ловили просадку
static uint32_t          gGuardDefers = 0;         // сколько автозаписей во flash отложено
static uint32_t          gDipLastMs = 0;
#define DIP_WARN_RAW   2150                        // ~3,46 В на батарее (норма 3,77 В)
// v8.9t: что вообще можно считать «просадкой».
//   DIP_PLAUSIBLE_RAW — 2,0 В. При таком питании 3,3-В регулятор и сам чип давно бы
//     выключились, значит отсчёт — грязь от переключения канала АЦП. Раньше такая
//     «просадка до 1,12 В» попадала в отчёт и в статистику.
//   DIP_RUN_MS — низкий участок короче 10 мс просадкой не считается: настоящая
//     просадка под нагрузкой держится десятки миллисекунд, а выброс от переключения
//     канала — 1–2 отсчёта (доли миллисекунды).
#define DIP_PLAUSIBLE_RAW 1240                     // ~2,0 В: ниже — не батарея, а помеха
#define DIP_RUN_MS        10                       // мс: столько должен длиться низкий участок
#define DIP_COOLDOWN_MS 2000
// v8.9p: ниже этого значения АВТОМАТИЧЕСКИЕ записи во flash откладываются. Смысл:
// запись во flash — это всплеск тока и остановка выборки кода; делать её на
// просевшем питании нельзя (именно так консоль умирала в v8.9j: запись в ящик и
// сброс по RUN). Явные команды пользователя (w, сейвстейты, выключение) пишут всегда.
#define BATT_GUARD_RAW 2200                        // ~3,55 В на батарее
#define SAG_WINDOW_MS  2500                        // сколько меряем просадку после запуска игры

// МЕРКА ПРОСАДКИ: минимум и максимум батареи за окно после запуска игры. Печатается
// один раз — по ней видно, насколько питание «клюёт» под нагрузкой (и виновато ли оно).
static volatile uint16_t gSagMin = 4095, gSagMax = 0;
static uint32_t          gSagT0 = 0;
static bool              gSagDone = true;
// ============================================================ подсветка (яркость экрана)
// v9.2: потолков яркости БОЛЬШЕ НЕТ (ни по заряду, ни при просадке — батареей
// яркость не трогаем вообще). На экран всегда идёт lightUser (крутилка LIGHT).
// Переменные lightCap/lightShed оставлены равными 255, чтобы не трогать lightApply.
static uint8_t backlight  = 255;               // применённое значение (0..255)
static uint8_t lightUser  = 255;               // крутилка пользователя
static uint8_t lightCap   = 255;               // v9.2: всегда 255 (потолок удалён)
static uint8_t lightShed  = 255;               // v9.2: всегда 255 (автосброс удалён)
static void lightApply(void) {
  uint8_t m = lightUser;
  if (lightCap < m) m = lightCap;
  if (lightShed < m) m = lightShed;
  backlight = m;
  analogWrite(PIN_BL, backlight);
}
static void setBacklight(int v) {              // крутилка пользователя
  if (v < 0) v = 0;
  if (v > 255) v = 255;
  lightUser = (uint8_t)v;
  lightApply();
}
static void lightRaw(int v) {                  // мимо всех потолков (проба звука)
  if (v < 0) v = 0;
  if (v > 255) v = 255;
  backlight = (uint8_t)v;
  analogWrite(PIN_BL, backlight);
}

// v9.2: АВТОСБРОС НАГРУЗКИ УДАЛЁН (ниже — пустые заглушки shedLoad/shedTick,
// оставленные ради прерывания ловушки; дальше — история для памяти).
static bool              gShedAuto = true;
static uint32_t          gShedLastMs = 0;
// ОПЫТ v8.9p, УБРАННЫЙ В v8.9q. Я отложил выгрузку чёрного ящика на «пару секунд после
// просадки, когда питание выправится». Итог: сброс по RUN пришёлся РОВНО на эту выгрузку —
// в логе все пять смертей оборвались на строке «ящик: выгружаю во flash отметок …».
// Значит, запись во flash в игре опасна не «в момент просадки», а вообще: стирание
// сектора — это ~50 мс, за которые батарея уходит ниже порога внешней схемы. Поэтому
// в игре во flash НЕ ПИШЕМ ВООБЩЕ, а след уходит при выключении (экран там уже погашен).
// Что осталось полезного — АВТОСБРОС НАГРУЗКИ, но теперь он работает ЗАРАНЕЕ, по
// мягкому порогу. v8.9s: ступень ровно одна (125 -> 62,5 МГц) с проверкой пользы —
// до 41,7 МГц прошивка сама не опускается никогда.
static volatile bool     gShedAsk = false;         // прерывание просит сбросить нагрузку
static uint8_t           gShedSteps = 0;           // на сколько ступеней нагрузка опущена
static uint32_t          gShedUps = 0;             // сколько раз яркость возвращали наверх
static bool              gShedUseless = false;     // v8.9s: проверено — тут снижение яркости не помогает
static uint32_t          gShedCheckMs = 0;         // v8.9s: когда проверить пользу ступени
static uint32_t          gDipAtShed = 0;           // v8.9s: сколько просадок было при снижении
#define SHED_WARN_RAW   2200                       // ~3,55 В: отсюда уже роняем нагрузку
#define SHED_COOLDOWN_MS 10000                     // не чаще раза в 10 с
// v8.9s: опустив яркость, НАДО проверить, помогло ли это питанию. Через 45 с смотрим,
// сколько просадок случилось ПОСЛЕ снижения: если их всё равно много, причина не в
// яркости — возвращаем её и больше подсветку не трогаем (v8.9y: раньше речь шла о панели).
#define SHED_CHECK_MS   45000UL
#define SHED_CHECK_DIPS 3
#define WEAK_BATT_RAW   2170                       // v8.9x: ~3,50 В (было 2260 = 3,64 — срабатывало на норме 3,61 В)
// v8.9r: ВОЗВРАТ НАГРУЗКИ НАВЕРХ. Без него автосброс — дорога в одну сторону: яркость
// упала и там осталась навсегда. Теперь: если 2 минуты тихо (ни просадок, ни шагов)
// и холостая батарея не ниже 3,50 В — возвращаем яркость. После просадки возврат
// запрещён на 2 минуты (иначе дёргалось бы). v8.9y: раньше речь шла о частоте панели.
#define SHED_QUIET_MS    120000UL                  // сколько тишины нужно для возврата
#define SHED_RESTORE_RAW WEAK_BATT_RAW                      // v8.9y: 3,50 В (было 3,62 — при норме 3,61 возврат не наступал)
static uint32_t          gShedHealthyMs = 0;       // с какого момента питание выглядит здоровым
static uint32_t          gShedBlockMs = 0;         // до этого времени возврат запрещён

// Опустить нагрузку. v8.9y: СКОРОСТЬ ИГРЫ НЕ ТРОГАЕМ (панель всегда на выбранной
// частоте) — временно опускаем яркость подсветки, главного потребителя, до 50 %.
// Через 45 с проверяем пользу: не помогло — возвращаем и больше не трогаем (см. shedTick).
static void shedLoad(bool afterDip) {
  // v9.2: АВТОСБРОС ЯРКОСТИ УДАЛЁН — батареей яркость не трогаем вообще
  // (ни потолков, ни временных 50 %). Функция оставлена пустой, чтобы не трогать
  // прерывание ловушки и главный цикл: они по-прежнему ставят/сбрасывают флаг.
  (void)afterDip;
  (void)gShedAuto; (void)gShedSteps; (void)gShedUps; (void)gShedUseless;
  (void)gShedLastMs; (void)gShedHealthyMs; (void)gShedBlockMs;
  (void)gShedCheckMs; (void)gDipAtShed;
}

#define ADC_CH_TEMP   4                 // внутренний термодатчик (не вывод!)
#define BATT_SAMPLES  8                 // усредняем: у АЦП шум в младших битах

// ВАЖНО (грабли Arduino IDE): IDE сама вставляет прототипы всех функций в начало
// скетча, поэтому функция НЕ МОЖЕТ возвращать тип, объявленный в этом же файле
// (иначе: «'AdcSrc' does not name a type»). Поэтому никаких собственных структур в
// подписях — только простые переменные и обычные типы.
static uint16_t battARaw, battANoise;   // GP26 — отсчёты и «дрожание» (в стоке канал 0)
static uint16_t battBRaw;               // GP29 — отсчёты (на Pico здесь VSYS/3)
static uint16_t battTRaw;               // внутренний термодатчик — самопроверка АЦП
static uint32_t battAMv, battBMv, battTMv;   // те же значения в милливольтах
static uint32_t battTrip;               // самое низкое значение на GP26 за сеанс
static bool     battOk;                 // датчик «шевелится» (не прибит к краю и не шумит)
// СТОРОЖ ПИТАНИЯ: все четыре внешних канала АЦП (GP26..GP29) и их значения НА СТАРТЕ.
// По падению относительно старта видно, садится ли питание перед смертью консоли.
static uint16_t battCh[4];              // отсчёты каналов 0..3 прямо сейчас
static uint16_t battChBoot[4] = {0,0,0,0};   // и в момент включения (для сравнения)
static bool     battChBootDone = false;

// Средний отсчёт по каналу + (необязательно) разброс. Возвращает обычный uint16_t,
// поэтому прототип от Arduino IDE собирается без вопросов.
static uint16_t battAdcAvg(uint ch, uint16_t *noiseOut) {
  uint32_t sum = 0; uint16_t mn = 4095, mx = 0;
  adc_select_input(ch);
  for (int i = 0; i < BATT_SAMPLES; i++) {
    const uint16_t v = (uint16_t)(adc_read() & 0x0FFFu);
    sum += v; if (v < mn) mn = v; if (v > mx) mx = v;
  }
  if (noiseOut) *noiseOut = (uint16_t)(mx - mn);
  return (uint16_t)(sum / BATT_SAMPLES);
}

static void battInit(void) {
  adc_init();                          // включает и сбрасывает блок АЦП (как сток)
  adc_gpio_init(PIN_BATT_A);           // GP26 — в аналоговый режим
  adc_gpio_init(PIN_BATT_B);           // GP29 — тоже (если не используется платой)
  battARaw = battBRaw = battTRaw = 0;
  battAMv = battBMv = battTMv = battTrip = 0;
  battANoise = 0; battOk = false;
}

static void battPrintBattery(void);      // объявлен заранее: печатается из прибора питания

// v8.9p: «питание в норме» — можно ли трогать flash автоматически (автосейв, ящик,
// «какая игра»). Явные команды пользователя эту проверку не проходят: они пишут всегда.
static uint32_t gGuardMsgMs = 0;
static bool battGuardOk(void) {
  if (!battChBootDone || battBRaw == 0) return true;    // ещё не мерили — не мешаем
  if (gDipWarn) return false;                           // просадка только что была
  if (battBRaw < BATT_GUARD_RAW) {
    if ((uint32_t)(millis() - gGuardMsgMs) > 30000) {    // в лог — не чаще раза в 30 с
      gGuardMsgMs = millis(); gGuardDefers++;
      Serial.print(F("запись во flash отложена: батарея "));
      Serial.print((uint32_t)battBRaw * 2u * 3300u / 4096u / 1000.0f, 2);
      Serial.print(F(" В (порог "));
      Serial.print(BATT_GUARD_RAW * 2u * 3300u / 4096u / 1000.0f, 2);
      Serial.println(F(" В) — сначала заряд; сейвы уйдут при выключении"));
    }
    return false;
  }
  return true;
}
static void battRead(void) {
  // На время перебора каналов ловушка просадки молчит: иначе прерывание звука
  // переставит АЦП на свой канал и значения чужих каналов смешаются.
  gAdcSweep = true;
  for (int i = 0; i < 4; i++) battCh[i] = battAdcAvg((uint)i, (i == 0) ? &battANoise : NULL);
  if (!battChBootDone) { for (int i = 0; i < 4; i++) battChBoot[i] = battCh[i]; battChBootDone = true; }
  battARaw  = battCh[0];
  battBRaw  = battCh[3];
  battTRaw  = battAdcAvg(ADC_CH_TEMP, NULL);
  battAMv   = (uint32_t)battARaw * 3300u / 4096u;
  battBMv   = (uint32_t)battBRaw * 3300u / 4096u;
  battTMv   = (uint32_t)battTRaw * 3300u / 4096u;
  if (!battTrip || battAMv < battTrip) battTrip = battAMv;
  // «живой» датчик: значение не прибито к краям и не скачет как сумасшедшее
  battOk = (battARaw > 20 && battARaw < 4070 && battANoise <= 120);
  // Перебор закончен. Первый отсчёт ловушки после него мог достаться чужому каналу
  // (результат в АЦП остался от термодатчика) — просим пропустить его, а не портить
  // окно мусором: минимум/максимум за прошедшее окно должны дойти до чёрного ящика.
  gDipSkip = 4; gAdcSweep = false;   // v8.9t: пропускаем 4 отсчёта (одного не хватало — после
                                     // перебора каналов АЦП «догоняет» ещё пару миллисекунд)
}

// ============================================================ ТЕМПЕРАТУРА ЧИПА (v8.9r)
// Единственная реальная опасность разгона до 250 МГц — перегрев кристалла. У RP2040
// датчик встроенный; формула из даташита: T = 27 - (V - 0,706)/0,001721 (V — с датчика).
// ВАЖНО: первое значение после переключения канала — мусор (именно из-за него мы раньше
// печатали 0,57 В, что по формуле давало «~100 °C» — это был не нагрев, а грязь первого
// отсчёта). Поэтому читаем дважды с паузой и берём второе.
// v8.9t: ЧЕСТНЫЙ НАГРЕВ ВМЕСТО ВРАНЬЯ ДАТЧИКА.
// Датчик этой платы даёт 0,566 В сразу после включения. По формуле даташита это 108 °C,
// но за секунду после подачи питания кристалл нагреться до 108 °C не может — значит у
// датчика смещение (типовая беда RP2040). Поэтому:
//   – запоминаем САМЫЙ ХОЛОДНЫЙ замер сеанса (обычно при включении) как «базу»;
//   – нагре = (база - текущий)/1,721 мВ на градус: это и есть реальный рост температуры;
//   – абсолютную цифру показываем только для справки и всегда с оговоркой.
static uint16_t tempBaseMv = 0;           // база = самый холодный замер этого сеанса

static int tempReadMv(int *riseC) {
  gAdcSweep = true;                       // ловушка просадки молчит, пока мы лезем в АЦП
  (void)battAdcAvg(ADC_CH_TEMP, NULL);    // «разогревочное» значение — выбрасываем
  delayMicroseconds(1500);                // датчику нужно устояться
  const uint32_t mv = (uint32_t)battAdcAvg(ADC_CH_TEMP, NULL) * 3300u / 4096u;
  gAdcSweep = false;
  if (!mv) return 0;                      // не читается
  if (!tempBaseMv || mv < tempBaseMv) tempBaseMv = (uint16_t)mv;   // холоднее не станет
  if (riseC) {
    int r = (int)((((int)tempBaseMv - (int)mv) / 1.721f) + 0.5f);  // мВ -> °C
    if (r < 0) r = 0;                    // «холоднее базы» не бывает: это шум датчика
    *riseC = r;
  }
  return (int)mv;
}

static int tempDegC(void) {               // справочная «абсолютная» оценка (датчику не верить)
  const int mv = tempReadMv(NULL);
  if (!mv) return 999;
  const int t = (int)(27.0f - ((float)mv - 706.0f) / 1.721f + 0.5f);
  if (t < -30 || t > 150) return 999;
  return t;
}

// Предупреждение о перегреве: считаем по НАГРЕВУ относительно базы, а не по врущему
// абсолютному значению. Порог +55 °C: если чип греется на столько выше комнатной
// температуры — это уже повод сбавить нагрузку (или поставить переключатель ядра).
#define TEMP_RISE_WARN 55

// Переменная «сколько замеров подряд ниже порога» и сама функция возврата частоты
// объявлены НИЖЕ по файлу (после чтения батареи): тут ещё нет battBRaw.
// v8.9r: возврат яркости НАВЕРХ, когда питание опять в порядке. Вызывается каждый цикл
// (это дешёво: только сравнения), поэтому в игре возврат случается сразу, как стало тихо.
static void shedTick(void) {
  // v9.2: пусто (см. shedLoad выше) — вызывать можно, ничего не делает.
}

static void battPrint(void) {
  Serial.print(F("сторож питания — все каналы АЦП (GP26..GP29): "));
  for (int i = 0; i < 4; i++) {
    Serial.print(F("A")); Serial.print(i); Serial.print(F("=")); Serial.print(battCh[i]);
    Serial.print(F(" (")); Serial.print((uint32_t)battCh[i] * 3300u / 4096u); Serial.print(F(" мВ)"));
    if (i < 3) Serial.print(F("  "));
  }
  Serial.println();
  {
    int rise = 0;
    const int mv = tempReadMv(&rise);
    Serial.print(F("   термодатчик (внутренний) = ")); Serial.print(mv ? mv : battTMv); Serial.print(F(" мВ"));
    if (!mv) Serial.print(F("  (не читается)"));
    else {
      const int tc = tempDegC();
      Serial.print(F("  нагрев +")); Serial.print(rise); Serial.print(F(" °C к базовому ("));
      Serial.print(tempBaseMv); Serial.print(F(" мВ)"));
      if (tc < 999 && tc >= 90) Serial.print(F("  — абсолютная цифра врёт, см. подсказку ниже"));
    }
  }
  Serial.print(F("   дрожание A0 = ")); Serial.print(battANoise); Serial.println();
  Serial.println(F("   подсказка: A3 (GP29) — батарея через делитель 1:2 (замерено: 3,76 В при полной); A0 (GP26) висит."));
  Serial.println(F("   температура: датчик этой платы врёт (у него смещение ~140 мВ: сразу после"));
  Serial.println(F("   включения он показывает 0,57 В, что по формуле = 108 °C). Следим за РОСТОМ:"));
  Serial.println(F("   база — самый холодный замер сеанса, предупреждение придёт при +55 °C к ней."));
  battPrintBattery();
  if (battANoise > 200)
    Serial.println(F("   (A0 (GP26) сильно дрожит — он ни к чему не подключён; батарею читаем с A3)"));
  if (battBRaw < 100)
    Serial.println(F("   (канал A3 молчит — если у вас батарея читается иначе, ориентируемся на динамику каналов)"));
  else if (battBMv * 2 < 3300)
    Serial.println(F("!! БАТАРЕЯ НИЗКО (меньше 3,3 В). Если консоль выключается сама — зарядите и повторите."));
}

// Батарея: по замерам это канал 3 (GP29) через делитель 1:2 (2332 отсч. = 1878 мВ ->
// 3,76 В — ровно заряженный литий). Печатаем в вольтах и предупреждаем, только если
// напряжение реально упало.
// Один замер батареи (A3) для ловушки просадки — вызывается из прерывания звука.
// Работает БЕЗ ОЖИДАНИЯ: просим одно преобразование и читаем ПРЕДЫДУЩИЙ результат
// (так же читает сток). Ждать готовности в прерывании нельзя: не ответит АЦП — консоль
// залипнет, и снаружи это будет неотличимо от нынешней смерти через 3 секунды.
// Отсчёт отстаёт на одно преобразование (0,36 мс при обычном темпе звука) — неважно.
static void dipSample(void) {
  // Читаем-изменяем-пишем: не затираем чужие биты (EN, включение термодатчика),
  // а только переключаем канал и просим одно преобразование.
  uint32_t cs = adc_hw->cs;
  cs &= ~(7u << ADC_CS_AINSEL_LSB);
  cs |= ((uint32_t)ADC_CH_B << ADC_CS_AINSEL_LSB) | ADC_CS_EN_BITS | ADC_CS_START_ONCE_BITS;
  adc_hw->cs = cs;
  if (gDipSkip) { gDipSkip--; return; }      // после перебора каналов: в АЦП ещё чужой канал
  const uint16_t v = (uint16_t)(adc_hw->result & 0x0FFFu);
  // v8.9t: заведомая помеха — не данные. Ниже 2,0 В на батарее этот чип работать не может,
  // значит отсчёт пришёл от переключения канала (раньше из-за него в отчёте о смерти
  // появлялись «провалы до 1,1 В» и «просадка 2583 мВ» при живой батарее).
  if (v < DIP_PLAUSIBLE_RAW) return;
  if (v < gDipMin)   gDipMin = v;            // окно закрывается записью в чёрный ящик
  if (v > gDipMax)   gDipMax = v;
  if (v < gDipWorst) gDipWorst = v;          // самый глубокий провал за сеанс
  if (!gSagDone) {                           // v8.9p: окно «как питание живёт после запуска игры»
    if (v < gSagMin) gSagMin = v;
    if (v > gSagMax) gSagMax = v;
  }
  // Ниже порога — просим главный цикл напечатать: печатать из прерывания нельзя
  // (пока мы в прерывании, USB не выгружается).
  // v8.9t: решение принимаем по ДЛИТЕЛЬНОСТИ низкого участка (>= 10 мс), а не по числу
  // «низких» отсчётов. Одиночный выброс АЦП (шум, переключение канала) — ещё не просадка;
  // из-за таких выбросов панель опускалась без нужды, и вы видели «производительность
  // упала» и «просадку до 1,12 В» на живой батарее. Настоящая просадка под нагрузкой
  // держится десятки мс — её мы так не пропустим.
  if (v < SHED_WARN_RAW) {
    if (!gDipRunStartMs) gDipRunStartMs = millis() ? millis() : 1u;
    if (v < gDipRunMin) gDipRunMin = v;
    gDipLowRun = (uint8_t)((gDipLowRun < 250) ? gDipLowRun + 1 : 250);
  } else {
    gDipRunStartMs = 0; gDipRunMin = 4095;
    gDipLowRun = 0;
  }
  const bool sure = (gDipRunStartMs != 0)
                 && ((uint32_t)(millis() - gDipRunStartMs) >= DIP_RUN_MS);
  if (sure && gDipRunMin < DIP_WARN_RAW && !gDipWarn && (uint32_t)(millis() - gDipLastMs) > DIP_COOLDOWN_MS) {
    gDipWarn = true; gDipLastMs = millis();
  }
  // ЗАРАНЕЕ просим сбросить нагрузку — по мягкому порогу. Ждать обрыва поздно: внешняя
  // схема сбрасывает чип раньше, чем мы успеем что-то сделать.
  // Печатать отсюда нельзя (мы в прерывании), поэтому только флаг — печатает цикл.
  if (sure && gShedAuto && !gShedAsk
      && (uint32_t)(millis() - gShedLastMs) > SHED_COOLDOWN_MS) gShedAsk = true;
}

static void battPrintBattery(void) {
  const uint32_t mv = battBMv * 2;                 // делитель 1:2
  Serial.print(F("батарея: A3=")); Serial.print(battBRaw);
  Serial.print(F(" -> "));         Serial.print(battBMv); Serial.print(F(" мВ -> "));
  Serial.print(mv / 1000.0f, 2);   Serial.print(F(" В (делитель 1:2)"));
  if (mv >= 4000) Serial.print(F("  — полная"));
  else if (mv >= 3600) Serial.print(F("  — норма"));
  else if (mv >= 3300) Serial.print(F("  — разряжается"));
  else                 Serial.print(F("  — НИЗКО, пора заряжать"));
  Serial.println();
}

// v8.9u: ИНДИКАТОР БАТАРЕИ НА ЭКРАНЕ. Раньше напряжение было видно только
// в serial. Читаем ТОЛЬКО канал 3 (GP29/A3) — тот же, что ловушка просадки
// в прерывании звука, поэтому гонки с прерыванием нет в принципе: оба читают
// один канал, «чужой» отсчёт нам не страшен, канал не переключаем и gDipSkip
// не трогаем.
// v8.9w: шкала иконки, мВ. Полная по замерам ЭТОЙ платы — 3,61..3,76 В, поэтому
// 100 % = 3620 (было 3800 — свежая батарея казалась полупустой). Больше —
// clamp в 100 %, так что и 3,76, и 4,1 с зарядки покажут полную корректно.
#define BATT_UI_FULL_MV  3620
#define BATT_UI_EMPTY_MV 3300   // пусто и LOW (как в serial: «меньше 3,3 В»)
static uint16_t battUiRaw(void) {
  if (!battChBootDone) return 0;   // АЦП ещё не настроен (самый ранний setup) — молчим
  return battAdcAvg(ADC_CH_B, NULL);
}
// милливольты батареи (делитель 1:2) из отсчётов; 0 — нет данных
static uint32_t battUiMv(uint16_t raw) {
  if (raw < 100) return 0;
  return (uint32_t)raw * 2u * 3300u / 4096u;
}
// v8.9x: СГЛАЖИВАНИЕ. Шина батареи гуляет ±100 мВ (в логе: A3 2188..2312),
 // а мгновенный замер раз в секунду ловил случайную фазу — иконка скакала
 // снизу доверху. EMA с tau ~8 с; нет данных — возвращаем что было.

static uint32_t battUiEma = 0;          // сглаженные милливольты (0 = замеров ещё не было)
static uint32_t battUiMvSmooth(void) {
  const uint32_t mv = battUiMv(battUiRaw());
  if (!mv) return battUiEma;
  if (!battUiEma) battUiEma = mv;       // первый замер — сразу
  else battUiEma = (uint32_t)((int32_t)battUiEma + ((int32_t)mv - (int32_t)battUiEma) / 8);

  return battUiEma;
}
// уровень 0..4 по СГЛАЖЕННЫМ милливольтам, с гистерезисом 25 мВ.
// Сегменты по 80 мВ: 0: <=3300, 1: 3301..3380, 2: 3381..3460, 3: 3461..3540, 4: >=3541.
static int8_t battLvlShown = -1;        // показанный уровень (-1 = ещё не показывали)
static int battUiLevel(uint32_t mv) {
  int raw;
  if (mv <= BATT_UI_EMPTY_MV) raw = 0;
  else { raw = (int)((mv - BATT_UI_EMPTY_MV + 79) / 80); if (raw > 4) raw = 4; }
  if (battLvlShown < 0 || battLvlShown > 4) { battLvlShown = (int8_t)raw; return raw; }
  if (raw == battLvlShown) return raw;
  // граница между нижним из двух уровней и следующим: EMPTY + lo*80 + 1
  const int lo = (raw < battLvlShown) ? raw : battLvlShown;
  const uint32_t edge = BATT_UI_EMPTY_MV + (uint32_t)lo * 80 + 1;
  if (raw > battLvlShown) { if (mv >= edge + 25) battLvlShown = (int8_t)raw; }
  else if (mv < edge - 25) battLvlShown = (int8_t)raw;
  return battLvlShown;
}
// v9.2: потолок яркости по заряду УДАЛЁН (см. выше) — функция стёрта целиком.
// "3.68V" или "--" — только целочисленная математика (float в snprintf не тянем)
static void battUiText(char *dst, size_t n, uint32_t mv) {
  if (!mv) snprintf(dst, n, "--");
  // v8.9v: разряжена — дописываем LOW (влезает: "3.12V LOW" = 9 знаков)
  else if (mv < 3300) snprintf(dst, n, "%u.%02uV LOW", (unsigned)(mv / 1000), (unsigned)((mv % 1000) / 10));
  else snprintf(dst, n, "%u.%02uV", (unsigned)(mv / 1000), (unsigned)((mv % 1000) / 10));
}
// иконка батареи 22x10: рамка + носик + 4 сегмента (v8.9x: была сплошная заливка
 // от мгновенного замера — прыгала; теперь уровень сглажен и с гистерезисом).
 // mv — СГЛАЖЕННЫЕ милливольты (battUiMvSmooth).
static void battUiIcon(int x, int y, uint32_t mv) {
  uiRect(x, y, 20, 1, 3); uiRect(x, y + 9, 20, 1, 3);
  uiRect(x, y, 1, 10, 3); uiRect(x + 19, y, 1, 10, 3);
  uiRect(x + 20, y + 3, 2, 4, 3);                       // носик
  const int lvl = battUiLevel(mv);
  for (int s = 0; s < lvl; s++)
    uiRect(x + 2 + s * 4, y + 2, 3, 6, 3);              // сегменты 3 px + 1 px зазор
}

// v8.9v: батарея в шапке (иконка + вольты), блок прижат вправо к MEM_W-6.
// y — верх блока (высота 10 px).
static void battUiHeader(int y) {
  const uint32_t mv = battUiMvSmooth();   // v8.9x: сглаженные (не прыгают)
  char vb[12]; battUiText(vb, sizeof(vb), mv);
  const int vlen = !mv ? 2 : (mv < 3300 ? 9 : 5);
  const int tw = vlen * 4 * 2, iw = 22, gap = 6;
  const int x1 = MEM_W - 6;
  battUiIcon(x1 - tw - gap - iw, y, mv);
  uiText(x1 - tw, y, 2, vb, 2);
}

// v8.9v: ИНДИКАТОР БАТАРЕИ В ИГРЕ — живёт в нижней чёрной полосе
// (строки 229..238), игровые пиксели не трогаем вообще.
// Замер — не чаще раза в секунду (АЦП дёргать каждый кадр незачем).
static uint32_t battHudMv = 0;
static uint32_t battHudNextMs = 0;
static uint16_t battHudFg = 0xFFFFu;   // цвет индикатора в порядке отправки
static void battHudSample(void) {
  const uint32_t now = millis();
  if ((int32_t)(now - battHudNextMs) < 0) return;
  battHudNextMs = now + 1000;
  battHudMv = battUiMvSmooth();   // v8.9x: сглаженные (не прыгают)
  // v8.9w: цвет — приглушённый светлый цвет ТЕКУЩЕЙ палитры (30 %): под каждую
  // игру свой оттенок, из картинки не выбивается. Разряд — красным.
  if (battHudMv && battHudMv < 3300)
    battHudFg = (uint16_t)((0xF800u >> 8) | (0xF800u << 8));   // красный в порядке отправки
  else {
    const uint16_t c = curPal[0];
    uint16_t r = (uint16_t)((((c >> 11) & 31) * 3 + 5) / 10);
    uint16_t g = (uint16_t)((((c >> 5) & 63) * 3 + 5) / 10);
    uint16_t b = (uint16_t)(((c & 31) * 3 + 5) / 10);
    if (r < 2 && g < 4 && b < 2) { r = 9; g = 18; b = 9; }   // инверсия: был бы чёрный на чёрном
    const uint16_t dim = (uint16_t)((r << 11) | (g << 5) | b);
    battHudFg = (uint16_t)((dim >> 8) | (dim << 8));
  }
}
// одна строка индикатора (r = 0..9): собираем в общий строковый буфер tx_rowbuf.
// txRow копирует данные синхронно (memcpy в DMA-буфер), поэтому буфером можно
// пользоваться тут же — ровно так делает cb_lcd_line для строк игры.
// v8.9x: иконка 22x8 (была 22x10 вплотную к картинке): в полосе 12 строк
// сверху и снизу по 2 px чёрного. Только иконка, 4 сегмента.
static void battHudRow(int r) {
  uint16_t *w = (uint16_t *)tx_rowbuf;
  for (int x = 0; x < MEM_W; x++) w[x] = 0;   // фон полосы — чёрный
  const uint16_t fg = battHudFg;
  const int ix = MEM_W - 6 - 22;              // иконка прижата вправо
  if (r == 0 || r == 7) { for (int x = 0; x < 20; x++) w[ix + x] = fg; }
  else { w[ix] = fg; w[ix + 19] = fg; }
  if (r >= 2 && r <= 5) { w[ix + 20] = fg; w[ix + 21] = fg; }   // носик
  if (r >= 2 && r <= 5) {
    const int lvl = battUiLevel(battHudMv);
    for (int s = 0; s < lvl; s++)
      for (int x = 0; x < 3; x++) w[ix + 2 + s * 4 + x] = fg;
  }
}
// низ кадра: чёрные строки + индикатор батареи в нижней полосе.
// Полоса — 12 строк (228..239); индикатор 8 строк (230..237) + отступы (v8.9x).
static void rowBlTail(int n) {
  battHudSample();                                  // раз в секунду обновит вольты
  if (n < 12) { rowBl(n); return; }                 // короткий кадр — просто чёрное
  rowBl(n - 12);
  rowBl(2);                                         // 228..229: отступ от картинки
  for (int r = 0; r < 8; r++) {                     // 230..237: индикатор
    battHudRow(r);
    if (!txRowY((const uint8_t *)tx_rowbuf)) return;
  }
  rowBl(2);                                         // 238..239
}

// Сравнение с замером при включении: садится ли что-нибудь.
static void battCompare(void) {
  for (int i = 0; i < 4; i++) {
    if (battChBoot[i] < 100) continue;                    // канал «пустой» — не о чем говорить
    if (battCh[i] * 100u < (uint32_t)battChBoot[i] * 85u) {
      Serial.print(F("!! канал A")); Serial.print(i); Serial.print(F(" просел: было "));
      Serial.print(battChBoot[i]); Serial.print(F(", стало ")); Serial.print(battCh[i]);
      Serial.println(F(" — похоже на разряд или просадку питания"));
    }
  }
}

// ============================================================ «чёрный ящик» во flash
// Пишем в отдельный кусок flash (ДВА сектора = 32 записи по 256 байт) фазу, номер
// кадра, сколько прожили, состояние шины и PC игры. Кусок не боится ни
// перезагрузки, ни исчезновения питания — по нему видно, что было в момент смерти.
//
// ИСПРАВЛЕНО в v8.7: номер записи раньше начинался с нуля в каждом запуске, и
// «самая свежая» запись могла оказаться старой записью прошлого сеанса (в вашем
// логе стенд так и показал чужую запись — «кадров 0, а байт 230400»). Теперь при
// загрузке ящик очищается целиком, и нумерация внутри запуска сквозная.
//
// ЛОВУШКА ДЛЯ ЗАВИСАНИЯ: первые BLK_TRAP кадров пишем ДВЕ записи на кадр — перед
// ядром и после. Два сектора специально затем, чтобы ни одно СТИРАНИЕ сектора не
// попало в эти первые полсекунды (стирание занимает десятки миллисекунд и
// подвешивает игру — раньше оно как раз и случалось на 10-12-м кадре).
// Дальше пишем редко: 0,5 с первые 10 секунд, потом раз в 5 с.
#define BLK_OFF       (FLASH_TOTAL - FLASH_RESERVE - BLK_SECTOR * BLK_SECTORS)
#define BLK_MAGIC     0x314B4C42UL             // "BLK1"
#define BLK_PAGES     16                       // страниц по 256 байт в секторе
#define BLK_SLOTS     (BLK_PAGES * BLK_SECTORS)
#define BLK_FIELD     53                       // слов в записи (212 байт из 256)
                                               // v8.9r: было 52, добавилось поле о частоте панели
#define BLK_TRAP      12                       // кадров «следа» (по две записи на кадр)

static bool     blkOn = true;
static uint32_t blkLastMs = 0, blkWrites = 0, blkSeq = 0, blkWipes = 0, blkErases = 0;
static uint32_t gPowerCutBy = 0;               // сколько раз прошивка сама снимала питание
static int      blkNewestSlot = -1;            // где лежит самая свежая запись
static uint8_t  blkFree[BLK_SECTORS];          // сколько страниц ещё свободно в секторе

// Смещение записи с номером seq: секторы по кругу, внутри сектора — по страницам
static inline uint32_t blkSlotOff(uint32_t seq) {
  const uint32_t sec  = (seq / BLK_PAGES) % BLK_SECTORS;
  const uint32_t page = seq % BLK_PAGES;
  return BLK_OFF + sec * BLK_SECTOR + page * 256u;
}

// Разбор того, что осталось от прошлого запуска: где самая свежая запись
static uint32_t blkFlashOps = 0, blkFlashUs = 0, blkLastOpUs = 0, blkLastOpMs = 0;
static bool     blkLogFlash = false;            // первые 20 с печатать каждую операцию flash

// Полная очистка ящика при загрузке (в setup, до игры — там стирание безвредно):
// после этого ЛЮБАЯ запись в ящике относится к этому запуску, старое не «прикинется»
// свежим, и в первые полсекунды работы стирать уже не придётся.
// ---- v8.9j: ВО ВРЕМЯ ИГРЫ FLASH НЕ ТРОГАЕМ -----------------------------------
// Опыт на консоли: с выключенным ящиком (режим DOWN) игра идёт нормально, а с
// включённым — перезагрузка по выводу RUN через доли секунды после начала игры.
// Единственное, что ящик делал: ЛЕЗ В FLASH ВО ВРЕМЯ ИГРЫ — раз в 0,25 с запись
// страницы и раз в ~4 с СТИРАНИЕ СЕКТОРА (сотни миллисекунд с выключенным доступом
// к flash, плюс всплеск тока). Теперь:
//   * отметки идут в КОЛЬЦО В ОЗУ (быстро, без flash);
//   * во flash уходит страница отметки, если в кольце ящика есть место, и БЕЗ СТИРАНИЙ;
//   * всё кольцо ОЗУ сбрасывается во flash при ВЫКЛЮЧЕНИИ и в отчёте о смерти.
#define BLK_RAM_N     16                        // сколько отметок держим в ОЗУ
static uint32_t blkRam[BLK_RAM_N][BLK_FIELD];
static uint32_t blkRamHead = 0, blkRamN = 0;
// ВАЖНО (v8.9k): по умолчанию во время ИГРЫ во flash не пишем вообще ничего — отметки
// копятся в кольце ОЗУ и уходят во flash при выключении / в отчёте о смерти.
// Причина: опыт показал, что смерть приходит от flash-операции ВНУТРИ кадра (окно панели
// открыто), а операции между кадрами (автосейв, сейвстейт) безопасны.
static bool     blkSafeFlush = false;           // режим START: выгружать кольцо между кадрами
static bool     blkEraseInPlay = false;         // режим A: как раньше — со стираниями (контроль)
static bool     blkRingFull = false;            // во flash больше нет места под отметки
static uint32_t blkTotal = 0, blkFlushed = 0;   // сколько отметок сделано / уже ушло во flash
static uint32_t blkLastFlushMs = 0;             // когда последний раз выгружали

static void blkPushRam(const uint32_t *v) {
  memcpy(blkRam[blkRamHead], v, BLK_FIELD * sizeof(uint32_t));
  blkRamHead = (blkRamHead + 1) % BLK_RAM_N;
  if (blkRamN < BLK_RAM_N) blkRamN++;
}

// Собрать запись. Отдельно от записи — потому что она нужна и кольцу ОЗУ, и flash.
static void blkPrepare(uint32_t *v) {
  memset(v, 0, BLK_FIELD * sizeof(uint32_t));
  v[0]  = BLK_MAGIC;
  v[1]  = gPhase;
  v[2]  = gFramesTotal;
  v[3]  = millis() / 1000;
  v[4]  = watchdog_hw->scratch[6];       // отметка прерывания звука (0 = в норме)
  v[5]  = txRowsFail; v[6] = spiStuck; v[7] = gateSkips;
  v[8]  = frameUs;
  v[9]  = (uint32_t)gb.cpu_reg.pc.reg;   // ГДЕ была игра: по этому видно зависание в ядре
  v[10] = (uint32_t)gb.cpu_reg.sp.reg;
  v[11] = frameRows; v[12] = txBytesFrame;
  v[13] = drawThisDbg ? 1u : 0u;
  v[14] = millis(); v[15] = txBytes;
  v[16] = blkSeq;                        // сквозной номер записи
  v[17] = spi_get_hw(spi0)->sr;          // что говорит шина прямо сейчас
  v[18] = spiRestarts;
  v[19] = txDroppedLines;                // сколько строк следа не напечаталось
  v[20] = gDieA; v[21] = gDieB; v[22] = gDieC; v[23] = gDieD;   // подробности смерти
  v[24] = battARaw;                       // питание в момент записи (GP26, как в стоке)
  v[25] = watchdog_get_count();           // сколько МКС оставалось до сброса сторожем
  v[26] = battAMv;                        // то же в милливольтах
  v[27] = battANoise | ((uint32_t)battBRaw << 16);     // дрожание + значение GP29
  v[28] = gFaultSp;                       // SP на входе в обработчик сбоя
  v[29] = gFaultMsp;                      // MSP сбоя
  v[30] = gFaultPsp;                      // PSP сбоя
  v[31] = gFaultXpsr;                     // xPSR из кадра исключения (бит 24 = Thumb)
  v[32] = stackUseBytes();                // сколько байт стека ушло за сеанс
  v[33] = gStackTop;                      // верх стека (MSP на старте)
  v[34] = SYS_DFSR;                       // регистр debug-сбоя
  v[35] = SYS_AFSR;                       // регистр внешнего сбоя
  v[36] = ((uint32_t)battCh[0] << 16) | battCh[1];      // АЦП: GP26 и GP27 в момент записи
  v[37] = ((uint32_t)battCh[2] << 16) | battCh[3];      // АЦП: GP28 и GP29
  v[38] = gPowerCutBy;                    // сколько раз НАША прошивка снимала питание
  v[39] = (uint32_t)digitalRead(PIN_PWR_HOLD);          // состояние ключа питания прямо сейчас
  v[40] = (uint32_t)digitalRead(PIN_EN12);              // и EN12 (сток гасит его при выключении)
  v[41] = battChBoot[0] | ((uint32_t)battChBoot[3] << 16);   // что было на АЦП при включении
  // v8.9p: в это поле теперь упаковано три вещи — залипание (бит 0), сколько раз
  // ловили просадку питания (биты 1..16) и сколько автоматических записей во flash
  // из-за этого отложено (биты 17..31). По ним после смерти видно, было ли питание.
  v[42] = (gStalled ? 1u : 0u) | ((gDipEvents & 0xFFFFu) << 1) | ((gGuardDefers & 0x7FFFu) << 17);
  v[52] = (uint32_t)(spiHzIdx & 0xFFu) | ((uint32_t)(gShedSteps & 0xFFu) << 8)
        | ((uint32_t)(gShedUps & 0xFFFFu) << 16);         // v8.9r: на какой частоте панель и сколько шагов
  v[43] = gInDieReport ? 1u : 0u;         // запись делается из доклада о смерти?
  v[44] = SYS_CHIP_RESET;                 // причина сброса от чипа (HAD_POR и прочее)
  v[45] = gDipMin;                        // питание: минимум за окно (≈0,25 с) — просадка!
  v[46] = gDipMax;                        // питание: максимум за окно
  v[47] = gDipWorst;                      // самый глубокий провал за сеанс
  gDipMin = 4095; gDipMax = 0;            // окно закрыто: начинаем новое
  v[48] = blkErases;                      // сколько раз СТИРАЛИ flash за сеанс
  v[49] = blkWrites;                       // сколько отметок сделано
  v[50] = blkFlashOps;                     // операций с flash (запись+стирание)
  v[51] = blkLastOpUs;                     // сколько заняла последняя операция (мкс)
}

// Запись одной страницы во flash. Обратите внимание: здесь НЕТ стирания — только запись,
// и только если страница ещё чистая (это проверяют вызывающие).
static void blkProgramPage(uint32_t off, const uint32_t *v) {
  uint8_t page[256];
  memset(page, 0xFF, sizeof(page));
  memcpy(page, v, BLK_FIELD * sizeof(uint32_t));
  const uint32_t t0 = micros();
  flash_range_program(off, page, 256);
  const uint32_t dt = micros() - t0;
  blkFlashOps++; blkFlashUs += dt; blkLastOpUs = dt; blkLastOpMs = millis();
  if (blkLogFlash && !gInDieReport) {
    Serial.print(F("флеш: запись страницы №")); Serial.print((off - BLK_OFF) / 256);
    Serial.print(F(", заняло ")); Serial.print(dt); Serial.println(F(" мкс"));
  }
}

// Одна отметка. ПО УМОЛЧАНИЮ во flash не пишем вовсе: отметка идёт в кольцо ОЗУ,
// а во flash её отправит выгрузка — при выключении, в отчёте о смерти или (режим START)
// между кадрами. В игре пишем только в контрольном режиме A — чтобы видеть разницу.
// Занят ли слот (в нём уже лежит запись)?
static bool blkSlotUsed(uint32_t idx) {
  const uint32_t *q = (const uint32_t *)(flashBase + blkSlotOff(idx % BLK_SLOTS));
  return q[0] == BLK_MAGIC;
}

// Освободить слот: если он занят — стираем ВЕСЬ сектор, в котором он лежит (это
// единственный способ записать в него снова). Так стирание происходит не при каждом
// включении, а только когда кольцо слотов действительно вернулось к занятому месту.
// Возвращает false, если стирать нельзя (тогда запись не делаем).
static bool blkEnsureSlot(uint32_t idx, bool allowErase) {
  if (!blkSlotUsed(idx)) return true;
  if (!allowErase) return false;
  const uint32_t sec = (idx / BLK_PAGES) % BLK_SECTORS;   // сектор по кругу (номер слота растёт)
  const uint32_t base = BLK_OFF + sec * BLK_SECTOR;
  const uint32_t t0 = micros();
  flash_range_erase(base, BLK_SECTOR);
  blkErases++; blkFree[sec] = BLK_PAGES;
  blkFlashOps++; blkLastOpUs = micros() - t0; blkLastOpMs = millis(); blkFlashUs += blkLastOpUs;
  if (blkLogFlash) {
    Serial.print(F("флеш: СТИРАНИЕ сектора №")); Serial.print(sec);
    Serial.print(F(", заняло ")); Serial.print(blkLastOpUs); Serial.println(F(" мкс"));
  }
  return true;
}

static void blkInit(void) {
  blkNewestSlot = -1; blkSeq = 0;
  uint32_t best = 0; bool have = false;
  uint32_t used[BLK_SECTORS] = {0, 0};
  for (uint32_t s = 0; s < BLK_SLOTS; s++) {
    const uint32_t *p = (const uint32_t *)(flashBase + blkSlotOff(s));
    if (p[0] != BLK_MAGIC) continue;
    used[s / BLK_PAGES]++;
    if (!have || p[16] >= best) { best = p[16]; blkNewestSlot = (int)s; have = true; }
  }
  blkSeq = have ? (best + 1) : 0;
  // v8.9l: НИЧЕГО НЕ СТИРАЕМ при включении. Свободные слоты используем как есть,
  // а занятые освобождаются стиранием только когда до них дойдёт очередь.
  for (uint32_t i = 0; i < BLK_SECTORS; i++) blkFree[i] = BLK_PAGES - used[i];
  blkRingFull = (blkFree[0] == 0 && blkFree[1] == 0);
}

static void blkWrite(void) {
  if (!blkOn) return;
  // Счётчики и время отметки — ВСЕГДА, даже когда во flash не пишем: по blkLastMs
  // работает расписание дежурства (иначе дежурство «залипло бы» и писало каждый кадр).
  blkLastMs = millis(); blkWrites++; blkTotal++;
  const uint32_t phSave = gPhase;
  uint32_t v[BLK_FIELD];
  blkPrepare(v);
  blkPushRam(v);
  if (!blkEraseInPlay) { mark(phSave); return; }   // ОСНОВНОЙ режим: во flash не лезем
  // (в контрольном режиме A полное кольцо не помеха: занятый слот освобождаем стиранием)
  const uint32_t off = blkSlotOff(blkSeq);
  const uint32_t sec = (blkSeq / BLK_PAGES) % BLK_SECTORS;
  if (!blkEnsureSlot(blkSeq, blkEraseInPlay)) {
    blkRingFull = true;
    Serial.println(F("ящик: возвращаться к занятым слотам нельзя — дальше пишу только в ОЗУ"));
    return;
  }
  mark(PH_BB);
  if (!gInDieReport) soundSuspend();       // чтобы запись не щёлкнула в динамике
  blkProgramPage(off, v);
  if (!gInDieReport) soundResume();
  blkFree[sec]--;
  blkNewestSlot = (int)(blkSeq % BLK_SLOTS);
  blkSeq++;
  blkFlushed++;                        // эта отметка теперь и во flash
  mark(phSave);                        // вернуть фазу как было (раньше её портили)
}

// Выгрузка НОВЫХ отметок из кольца ОЗУ во flash. Вызывается ВНЕ кадра: при выключении,
// в отчёте о смерти и (режим START) между кадрами — там это безопасно (так же пишет
// автосейв, и он ни разу не сбил консоль).
// allowErase: разрешено ли стирать сектор (при выключении — да, в игре — нет).
static void blkFlushGuarded(void);        // v8.9p: выгрузка ящика только при живом питании

static void blkFlush(bool allowErase) {
  if (!blkOn || blkFlushed >= blkTotal) return;
  if (blkTotal - blkFlushed > BLK_RAM_N) blkFlushed = blkTotal - BLK_RAM_N;   // старое уже потеряно
  const uint32_t n = blkTotal - blkFlushed;
  if (!gInDieReport) { Serial.print(F("ящик: выгружаю во flash отметок ")); Serial.print(n); Serial.println(F("...")); }
  if (!gInDieReport) quietFlashBegin();     // v8.9q: глушим звук и гасим свет на время записи
  for (uint32_t i = 0; i < n; i++) {
    const uint32_t idx = (blkRamHead + BLK_RAM_N - n + i) % BLK_RAM_N;   // от старых к новым
    const uint32_t off = blkSlotOff(blkSeq);
    const uint32_t sec = (blkSeq / BLK_PAGES) % BLK_SECTORS;
    if (!blkEnsureSlot(blkSeq, allowErase)) break;
    uint32_t v[BLK_FIELD];
    memcpy(v, blkRam[idx], sizeof(v));
    v[16] = blkSeq;                       // в flash запись получает свой сквозной номер
    blkProgramPage(off, v);
    blkFree[sec]--;
    blkNewestSlot = (int)(blkSeq % BLK_SLOTS);
    blkSeq++; blkFlushed++;
  }
  if (!gInDieReport) quietFlashEnd();
  blkLastFlushMs = millis();
}

// Безопасная точка: вызывается в начале цикла, когда панель между кадрами свободна.
// Работает только в режиме START и только если панель действительно молчит.
// Выгрузка ящика из автоматики (раз в 5 с в режиме START): только при живом питании.
static void blkFlushGuarded(void) {
  if (!battGuardOk()) return;
  blkFlush(true);
}

static void blkSafeTick(void) {
  if (!blkOn || !blkSafeFlush || blkEraseInPlay) return;
  if (blkFlushed >= blkTotal) return;
  if (spi_is_busy(spi0)) return;                       // панель ещё занята — отложим
  if ((uint32_t)(millis() - blkLastFlushMs) < 5000UL) return;
  blkFlushGuarded();          // v8.9p: при просевшем питании выгрузку откладываем
}

static void blkWipe(void) {
  if (!blkOn) return;
  noInterrupts();
  for (uint32_t s = 0; s < BLK_SECTORS; s++)
    flash_range_erase(BLK_OFF + s * BLK_SECTOR, BLK_SECTOR);
  interrupts();
  blkWipes++; blkErases += BLK_SECTORS;
  for (uint32_t i = 0; i < BLK_SECTORS; i++) blkFree[i] = BLK_PAGES;   // оба сектора пусты
  blkSeq = 0; blkNewestSlot = -1; blkRingFull = false;
  blkTotal = 0; blkFlushed = 0; blkRamN = 0; blkLastFlushMs = millis();
}



// Частота записей: первые 10 с — раз в 0,5 с, дальше раз в 5 с.
// Дежурство: пока консоль молодая — пишем ЧАСТО (0,25 с), чтобы смерть оставила
// след с точностью до четверти секунды. Дальше реже (5 с), чтобы не пилить flash.
static void blkTick(void) {
  if (!blkOn) return;
  const uint32_t gap = (millis() < 60000UL) ? 250UL : 5000UL;
  if ((millis() - blkLastMs) >= gap) { battRead(); blkWrite(); }
}

// ЛОВУШКА: первые кадры — запись в ящик на каждый кадр (по две на кадр).
static inline void blkTrap(void) {
  if (blkOn && gFramesTotal <= BLK_TRAP) blkWrite();
}

static void blkRead(void) {
  if (blkNewestSlot < 0) {
    Serial.println(F("--- чёрный ящик: записей от прошлого запуска нет ---"));
    return;
  }
  const uint32_t *p = (const uint32_t *)(flashBase + blkSlotOff((uint32_t)blkNewestSlot));
  Serial.println(F("--- чёрный ящик (запись из прошлого запуска) ---"));
  Serial.print(F("   запись №")); Serial.print(p[16]);
  Serial.print(F(" (слот ")); Serial.print(blkNewestSlot);
  Serial.print(F(" из ")); Serial.print(BLK_SLOTS); Serial.println(F(")"));
  Serial.print(F("   фаза: "));            Serial.print(phaseName(p[1]));
  Serial.print(F(", кадров "));            Serial.print(p[2]);
  Serial.print(F(", прожили "));           Serial.print(p[3]); Serial.print(F(" с (запись в "));
  Serial.print(p[14] / 1000);              Serial.println(F(" с)"));
  Serial.print(F("   в игре: PC=0x"));     Serial.print(p[9], HEX);
  Serial.print(F(" SP=0x"));               Serial.print(p[10], HEX);
  Serial.print(F("   кадр "));             Serial.print(p[8] / 1000.0f, 1); Serial.print(F(" мс, строк "));
  Serial.print(p[11]);                     Serial.print(F(", байт в панель ")); Serial.println(p[12]);
  Serial.print(F("   не ушло строк "));    Serial.print(p[5]);
  Serial.print(F(", сбоев SPI "));         Serial.print(p[6]);
  Serial.print(F(", пропущено кадров "));  Serial.print(p[7]);
  Serial.print(F(", звук (0=норма) "));    Serial.print(p[4]);
  Serial.print(F(", байт всего "));        Serial.println(p[15]);
  // v8.9r: на какой частоте была панель и сколько раз нагрузку роняли/возвращали.
  // v8.9t: в записи СТАРОГО формата (до v8.9r) этого поля не было — там лежит 0xFFFFFFFF,
  // и раньше в лог печаталось «панель: МГц, ступеней вниз 255, возвратов 65535».
  {
    const uint32_t hz = p[52];
    if (hz == 0xFFFFFFFFu || (hz & 0xFFu) >= (sizeof(SPI_HZ_NAME) / sizeof(SPI_HZ_NAME[0]))) {
      Serial.println(F("   панель: в этой записи частота не сохранялась (запись старого формата)"));
    } else {
      Serial.print(F("   панель: ")); Serial.print(SPI_HZ_NAME[hz & 0xFFu]); Serial.print(F(" МГц"));
      Serial.print(F(", ступеней вниз ")); Serial.print((hz >> 8) & 0xFFu);
      Serial.print(F(", возвратов наверх ")); Serial.println((hz >> 16) & 0xFFFFu);
    }
  }
  Serial.print(F("   шина: sr=0x"));       Serial.print(p[17], HEX);
  Serial.print(F(", перезапусков "));      Serial.print(p[18]);
  Serial.print(F(", строк следа не напечатано ")); Serial.println(p[19]);
  // v8.9p: сколько раз за сеанс ловили просадку питания и сколько автозаписей отложили
  Serial.print(F("   просадок питания за сеанс: ")); Serial.print((p[42] >> 1) & 0xFFFFu);
  Serial.print(F(", отложенных автозаписей во flash: ")); Serial.println((p[42] >> 17) & 0x7FFFu);
  if (p[20] || p[21] || p[22] || p[23]) {
    Serial.print(F("   подробности: 0x")); Serial.print(p[20], HEX);
    Serial.print(F(", 0x")); Serial.print(p[21], HEX);
    Serial.print(F(", 0x")); Serial.print(p[22], HEX);
    Serial.print(F(", 0x")); Serial.println(p[23], HEX);
  }
  if (p[1] == PH_FAULT) Serial.println(F("   (это АППАРАТНЫЙ СБОЙ: см. причину и адрес выше)"));
  if (p[1] == PH_STALL) Serial.println(F("   (это ЗАЛИПАНИЕ: цикл встал, звук продолжал идти)"));
  Serial.print(F("   питание: GP26 "));  Serial.print(p[24]);
  Serial.print(F(" отсч. = "));     Serial.print(p[26]);
  Serial.print(F(" мВ (дрожание ")); Serial.print(p[27] & 0xFFFFu);
  Serial.print(F(", GP29 "));       Serial.print(p[27] >> 16); Serial.print(F(")"));
  Serial.print(F(", сторожу оставалось ")); Serial.print(p[25] / 1000); Serial.println(F(" мс"));
  // v8.9e: если запись сделана новой прошивкой — разбираем состояние питания.
  if (p[36] != 0xFFFFFFFFu) {
    Serial.print(F("   сторож питания в последней записи: A0=")); Serial.print(p[36] >> 16);
    Serial.print(F(" A1=")); Serial.print(p[36] & 0xFFFFu);
    Serial.print(F(" A2=")); Serial.print(p[37] >> 16);
    Serial.print(F(" A3=")); Serial.print(p[37] & 0xFFFFu);
    Serial.print(F("   ключ питания (GPIO1)=")); Serial.print(p[39] ? F("высокий (держим)") : F("НИЗКИЙ"));
    Serial.print(F("  EN12=")); Serial.print(p[40] ? F("высокий") : F("низкий"));
    Serial.println();
    if (p[41] != 0xFFFFFFFFu) {
      Serial.print(F("   при включении было: A0=")); Serial.print(p[41] & 0xFFFFu);
      Serial.print(F(" A3=")); Serial.print(p[41] >> 16);
      Serial.print(F("  ->  к моменту записи: A0=")); Serial.print(p[36] >> 16);
      Serial.print(F(" A3=")); Serial.println(p[37] & 0xFFFFu);
    }
    if (p[45] != 0xFFFFFFFFu && p[45] != 4095u) {
    Serial.print(F("   питание в записи: минимум за 0,25 с = ")); Serial.print(p[45]);
    Serial.print(F(" (максимум ")); Serial.print(p[46]);
    Serial.print(F(", самый глубокий провал за сеанс ")); Serial.print(p[47]);
    Serial.println(F(")"));
    Serial.print(F("   если минимум сильно ниже нормы (")); Serial.print(battBRaw);
    Serial.println(F(") — питание просаживается прямо перед смертью"));
  }
  Serial.print(F("   наша прошивка снимала питание ")); Serial.print(p[38]); Serial.println(F(" раз(а) за тот запуск"));
  if (p[49] != 0xFFFFFFFFu) {
    Serial.print(F("   операций с flash за тот запуск: ")); Serial.print(p[50]);
    Serial.print(F(" (отметок ")); Serial.print(p[49]);
    Serial.print(F(", стираний ")); Serial.print(p[48]);
    Serial.print(F("), последняя заняла ")); Serial.print(p[51]); Serial.println(F(" мкс"));
  }
    if (p[1] != PH_POWERCUT && p[1] != PH_FAULT && p[1] != PH_STALL)
      Serial.println(F("   ВЫВОД: записи о снятии питания НЕТ — значит питание ушло не по нашей вине"));
    if (p[1] != PH_POWERCUT && p[1] != PH_FAULT && p[1] != PH_STALL)
      Serial.println(F("          (смотрите выше числа АЦП: садилось ли питание перед смертью)"));
  }
  if ((p[28] || p[29] || p[30] || p[31]) && p[28] != 0xFFFFFFFFu)
    Serial.println(F("   стек: указатели были записаны — смотрите строку «стек» ниже"));
  if (p[1] == PH_POWERCUT) Serial.println(F("   (это было ШТАТНОЕ выключение, а не зависание)"));
}

static uint32_t fnv1a(const uint8_t *p, int n) {
  uint32_t h = 2166136261u;
  while (n--) { h ^= *p++; h *= 16777619u; }
  return h;
}

// ============================================================ v9.7: НАСТРОЙКИ ПЕРЕЖИВАЮТ ВЫКЛЮЧЕНИЕ
// Последний сектор flash (0x1FF000) был зарезервирован под «EEPROM ядра», но не
// занят — держим там настройки пользователя. Пишем при штатном выключении,
// читаем в самом начале загрузки.
#define SET_OFF     (FLASH_TOTAL - FLASH_RESERVE)   // последний сектор flash
#define SET_MAGIC   0x31544553UL                    // "SET1"

static void settingsLoad(void) {
  const uint8_t *p = (const uint8_t *)(flashBase + SET_OFF);
  uint32_t magic = 0, crc = 0;
  memcpy(&magic, p, 4); memcpy(&crc, p + 16, 4);
  if (magic != SET_MAGIC) {
    Serial.println(F("настроек во flash нет — работаем как задумано по умолчанию"));
    return;
  }
  if (crc != fnv1a(p, 16)) {
    Serial.println(F("настройки во flash повреждены — беру значения по умолчанию"));
    return;
  }
  lightUser = p[8]; bright = p[9]; contr = p[10]; volPct = p[11];
  palIdx = p[12]; invertShades = p[13] != 0; soundOn = p[14] != 0; spiHzIdx = p[15];
  // зажимаем в допустимых пределах (файл мог записаться другой версией)
  if (bright < 50 || bright > 150) bright = 100;
  if (contr  < 50 || contr  > 200) contr  = 120;
  if (volPct > 10) volPct = 10;                       // мягкий лимит громкости (v9.7)
  if (palIdx >= PAL_COUNT) palIdx = 0;
  if (spiHzIdx >= (int)(sizeof(SPI_HZ_TAB) / sizeof(SPI_HZ_TAB[0]))) spiHzIdx = 0;
  Serial.println(F("настройки восстановлены из flash (свет/яркость/контраст/громкость/палитра)"));
}

// v9.7.2: запись во flash — как и все остальные писатели: «тихо» (свет/звук/
// усилитель прочь) и с ВЫКЛЮЧЕННЫМИ прерываниями. Прерывание звука само сидит в
// ОЗУ, но зовёт код из flash, а на время стирания flash выключен из шины — без
// защиты чип падал (консоль «перезагружалась» вместо выключения), сектор уже был
// стёрт, и настройки пропадали. Ещё и сверяем запись: если не подтвердилась —
// пробуем ещё раз.
static bool settingsWrite(const uint8_t *page) {
  quietFlashBegin();
  noInterrupts();
  flash_range_erase(SET_OFF, BLK_SECTOR);        // свой сектор, сейвы не трогает
  flash_range_program(SET_OFF, page, 256);
  interrupts();
  quietFlashEnd();
  return memcmp((const void *)(flashBase + SET_OFF), page, 20) == 0;
}

static void settingsStore(void) {
  uint8_t page[256];
  memset(page, 0xFF, sizeof(page));
  uint32_t v = SET_MAGIC; memcpy(page, &v, 4);
  v = 1; memcpy(page + 4, &v, 4);
  page[8]  = lightUser;   page[9]  = bright;    page[10] = contr;
  page[11] = volPct;      page[12] = palIdx;    page[13] = invertShades ? 1 : 0;
  page[14] = soundOn ? 1 : 0;                    page[15] = spiHzIdx;
  v = fnv1a(page, 16); memcpy(page + 16, &v, 4);
  if (!settingsWrite(page)) {
    Serial.println(F("!! запись настроек не подтвердилась — пробую ещё раз"));
    (void)settingsWrite(page);
  }
  Serial.println(F("настройки записаны во flash"));
}

// настройки в ОЗУ отличаются от того, что лежит во flash?
static bool settingsDirty(void) {
  const uint8_t *p = (const uint8_t *)(flashBase + SET_OFF);
  uint32_t magic = 0, crc = 0;
  memcpy(&magic, p, 4); memcpy(&crc, p + 16, 4);
  if (magic != SET_MAGIC || crc != fnv1a(p, 16)) return true;   // пусто или бито
  return p[8] != lightUser || p[9] != bright || p[10] != contr || p[11] != volPct
      || p[12] != palIdx || p[13] != (invertShades ? 1 : 0)
      || p[14] != (soundOn ? 1 : 0) || p[15] != spiHzIdx;
}

static void saveInit(size_t wantBytes, int banks) {
  if (!flashEnd) flashEnd = (uintptr_t)&__flash_binary_end;
  uintptr_t end = (flashEnd + 4095u) & ~(uintptr_t)4095u;
  if (end < flashBase) end = flashBase;
  const uint32_t usedOff = (uint32_t)(end - flashBase);
  // ВАЖНО: место считаем как данные + заголовок, иначе последние 256 байт
  // сохранения не влезали (нашёл и исправил).
  // ВАЖНО: pico-sdk требует, чтобы flash_range_erase() стирал ЦЕЛЫМИ секторами
  // (4096 байт). Поэтому размер области всегда кратен 4096: иначе для картриджа
  // с 32 КиБ SRAM получалось 33024 байта (не кратно сектору) — стирание уезжало.
  size_t need = wantBytes + SAVE_HDR;
  if (need > sizeof(cartRam) + SAVE_HDR) need = sizeof(cartRam) + SAVE_HDR;
  const int want = (int)((need + 4095u) & ~(size_t)4095u);
  // Верхняя граница: при залитом наборе игр — НИЖЕ области картриджей (ROMS_TABLE_OFF, с v9.0 это 0x80000),
  // чтобы сейвы и сейвстейты её никогда не тронули.
  const uint32_t limit = romCount ? ROMS_TABLE_OFF : FLASH_LIMIT;
  if (banks < 1) banks = 1;
  if (banks > SAVE_BANKS) banks = SAVE_BANKS;
  while (banks > 1 && (uint32_t)want * (uint32_t)banks > (limit - usedOff)) banks--;
  if (usedOff + (uint32_t)want > limit) {           // места нет вообще
    saveLen = 0; saveData = 0; bankCount = 0;
    Serial.println(F("Сейвы: НЕТ МЕСТА во flash (образ почти 2 МБ) — сохранение выключено"));
    return;
  }
  if ((uint32_t)want * (uint32_t)banks > (limit - usedOff)) banks = 1;
  bankCount = banks;
  saveLen  = want;
  saveData = want - SAVE_HDR;
  if (saveData > (int)sizeof(cartRam)) saveData = (int)sizeof(cartRam);
  uint32_t maxSeq = 0;
  for (int i = 0; i < bankCount; i++) {
    bankOff[i] = usedOff + (uint32_t)want * (uint32_t)i;
    const uint8_t *p = (const uint8_t *)(flashBase + bankOff[i]);
    uint32_t magic = 0, seq = 0;
    memcpy(&magic, p, 4); memcpy(&seq, p + SAVE_HDR_SEQ, 4);
    if (magic == SAVE_MAGIC && seq != 0xFFFFFFFFu && seq > maxSeq) maxSeq = seq;
  }
  saveSeqMax = maxSeq;
  saveBank = -1; saveHash = 0; saveOff = bankOff[0];
  Serial.print(F("Сейвы: "));
  Serial.print(bankCount); Serial.print(F(" ячеек по "));
  Serial.print(saveLen / 1024); Serial.print(F(" КиБ (данные "));
  Serial.print(saveData / 1024); Serial.print(F(" КиБ), flash 0x"));
  Serial.print((uint32_t)(flashBase + bankOff[0]), HEX);
  Serial.print(F("..0x")); Serial.print((uint32_t)(flashBase + bankOff[bankCount - 1] + (uint32_t)want - 1), HEX);
  Serial.println();
}

// v8.9o: у каждой игры из списка — СВОЯ ячейка. Ячейка узнаётся по клейму (CRC32
// образа); если своей нет, берём пустую или самую давно не писавшуюся.
// «Безымянные» ячейки прежних версий (16 байт заголовка = 0xFF) считаем сейвом
// встроенной игры и бережём до последнего — иначе Zelda из rom.h потеряла бы сейв.
static void saveBind(uint32_t key) {
  saveGameCrc = key; saveHash = 0; saveBank = -1;
  if (!saveLen || bankCount <= 0) return;
  int found = -1, victim = 0;
  uint32_t best = 0xFFFFFFFFu;
  for (int i = 0; i < bankCount; i++) {
    const uint8_t *p = (const uint8_t *)(flashBase + bankOff[i]);
    uint32_t magic = 0, len = 0, k = 0, nk = 0, seq = 0xFFFFFFFFu;
    memcpy(&magic, p, 4); memcpy(&len, p + 4, 4);
    memcpy(&k, p + SAVE_HDR_KEY, 4); memcpy(&nk, p + SAVE_HDR_KEY + 4, 4);
    memcpy(&seq, p + SAVE_HDR_SEQ, 4);
    bool legacy = false;
    if (k == 0xFFFFFFFFu) { k = 0; nk = 0xFFFFFFFFu; legacy = true; }   // ячейка прежних версий
    if (magic == SAVE_MAGIC && len == (uint32_t)saveLen && k == key && nk == ~key) {
      if (found < 0) found = i;
      continue;
    }
    uint32_t rank;
    if (magic != SAVE_MAGIC)                rank = 0u;                 // пустая — берём первой
    else if (legacy)                        rank = 0xFFFFFFFEu;        // «безымянная» — в самый конец
    else {
      if (seq > 0xFFFFFFFDu) seq = 0xFFFFFFFDu;
      rank = 1u + (0xFFFFFFFDu - seq);                                 // чем старше, тем раньше
    }
    if (rank < best) { best = rank; victim = i; }
  }
  saveBank = (found >= 0) ? found : victim;
  saveOff  = bankOff[saveBank];
  Serial.print(F("сейвы: ячейка ")); Serial.print(saveBank + 1); Serial.print(F(" из "));
  Serial.print(bankCount);
  Serial.println(found >= 0 ? F(" — сейв этой игры на месте")
                            : F(" — свободная (у этой игры сейва ещё нет)"));
}

static bool saveLoad(void) {
  if (!saveLen) return false;
  const uint8_t *p = (const uint8_t *)(flashBase + saveOff);
  uint32_t magic, len, hash;
  memcpy(&magic, p, 4); memcpy(&len, p + 4, 4); memcpy(&hash, p + 8, 4);
  if (magic != SAVE_MAGIC || (int)len != saveLen) return false;
  if (saveData <= 0 || saveData > (int)sizeof(cartRam)) return false;
  // v8.9o: в ячейке может лежать сейв ДРУГОЙ игры — такой грузить нельзя (ячейки
  // разные!). Ячейки прежних версий (клейма нет) считаем сейвом встроенной игры.
  uint32_t k = 0, nk = 0;
  memcpy(&k, p + SAVE_HDR_KEY, 4); memcpy(&nk, p + SAVE_HDR_KEY + 4, 4);
  if (k == 0xFFFFFFFFu) { k = 0; nk = 0xFFFFFFFFu; }
  if (k != saveGameCrc || nk != ~saveGameCrc) return false;
  memcpy(cartRam, p + SAVE_HDR, (size_t)saveData);
  if (fnv1a(cartRam, saveData) != hash) return false;
  saveHash = hash; cartDirty = false;
  return true;
}

// pico-sdk требует, чтобы flash_range_program() получал смещение, кратное 256,
// и длину, кратную 256. Поэтому и SRAM-сейв пишем целыми страницами одним
// потоком: первая страница — заголовок, дальше подряд идёт картриджная RAM.
static uint8_t  savePage[256];
static uint32_t savePageOff = 0;
static size_t   savePageFill = 0;

static void savePageWrite(void) {
  wdtFeed();                                  // страница пишется ~1 мс, но кормим на всякий случай
  if (savePageFill < 256) memset(savePage + savePageFill, 0xFF, 256 - savePageFill);
  flash_range_program(savePageOff, savePage, 256);
  savePageOff += 256;
  savePageFill = 0;
}

static void saveStreamBegin(uint32_t off) { savePageOff = off & ~(uint32_t)0xFF; savePageFill = 0; }

static void saveStream(const uint8_t *src, size_t n) {
  while (n) {
    const size_t room = 256 - savePageFill;
    const size_t take = n < room ? n : room;
    memcpy(savePage + savePageFill, src, take);
    savePageFill += take; src += take; n -= take;
    if (savePageFill == 256) savePageWrite();
  }
}

static void saveStreamEnd(void) { if (savePageFill) savePageWrite(); }

static void saveStore(bool verbose) {
  if (!saveLen)     { if (verbose) Serial.println(F("Сохранение недоступно (нет места во flash).")); return; }
  if (!saveActive)  { if (verbose) Serial.println(F("У этой игры нет памяти сохранений — сохранять нечего.")); return; }
  const int dataLen = saveData;
  const uint32_t h = fnv1a(cartRam, dataLen);
  if (!verbose && h == saveHash && !cartDirty) return;

  uint8_t hdr[SAVE_HDR];
  memset(hdr, 0xFF, sizeof(hdr));
  uint32_t magic = SAVE_MAGIC, len = saveLen, hash = h, neg = ~h;
  memcpy(hdr, &magic, 4); memcpy(hdr + 4, &len, 4); memcpy(hdr + 8, &hash, 4); memcpy(hdr + 12, &neg, 4);
  // v8.9o: клеймо игры (CRC32 образа) и поколение записи — по ним ячейка узнаётся,
  // когда игр несколько, и понятно, какую переиспользовать.
  uint32_t key = saveGameCrc, nkey = ~saveGameCrc;
  memcpy(hdr + SAVE_HDR_KEY, &key, 4); memcpy(hdr + SAVE_HDR_KEY + 4, &nkey, 4);
  // Поколение сперва ставим то, что уже лежит в ячейке: тогда сравнение с flash
  // честное и «нечего писать» остаётся «нечего писать». Новое поколение — только
  // если запись правда пошла.
  uint32_t cellSeq = 0;
  memcpy(&cellSeq, (const void *)(flashBase + saveOff + SAVE_HDR_SEQ), 4);
  if (cellSeq == 0xFFFFFFFFu) cellSeq = 0;
  if (cellSeq > saveSeqMax) saveSeqMax = cellSeq;
  memcpy(hdr + SAVE_HDR_SEQ, &cellSeq, 4);

  // БЕРЕЖЁМ FLASH (v8.9o): сперва только СМОТРИМ, есть ли что писать. Если во flash
  // уже ровно то же самое (игра SRAM не меняла), не стираем и не пишем НИЧЕГО.
  {
    const uint32_t nSec = ((uint32_t)saveLen + 4095u) / 4096u;
    bool anyDiff = false;
    for (uint32_t sec = 0; sec < nSec && !anyDiff; sec++) {
      const uint32_t base = sec * 4096u;
      const uint8_t *f = (const uint8_t *)(flashBase + saveOff + base);
      for (uint32_t k = 0; k < 4096u; k++) {
        const uint32_t i = base + k;
        uint8_t want;
        if (i < SAVE_HDR)                        want = hdr[i];
        else if ((int)(i - SAVE_HDR) < dataLen)  want = cartRam[i - SAVE_HDR];
        else                                     want = 0xFF;
        if (want != f[k]) { anyDiff = true; break; }
      }
    }
    if (!anyDiff) {
      saveHash = h; cartDirty = false; lastSaveMs = millis();
      mark(PH_LOOP);
      if (verbose) Serial.println(F("Сохранено: писать нечего — во flash уже всё так (ни стираний, ни записей)"));
      return;
    }
  }
  { const uint32_t seq = ++saveSeqMax; memcpy(hdr + SAVE_HDR_SEQ, &seq, 4); }

  const uint32_t t0 = millis();
  mark(PH_SAVE);
  Serial.print(F("пишу SRAM во flash (")); Serial.print(dataLen / 1024); Serial.print(F(" КиБ)..."));
  Serial.flush();
  quietFlashBegin();                    // v8.9q: тихая запись (свет гаснет, звук молчит)
  noInterrupts();
  // БЕРЕЖЁМ FLASH (v8.9l): совсем не обязательно стирать всю область заново, если игра
  // поменяла пару байт. Сравниваем нужный образ с тем, что лежит во flash, и трогаем
  // только изменившиеся сектора (4 КиБ). Обычно это 1 сектор из 3.
  {
    // байт №i собираемой записи (первые 16 байт — заголовок, дальше SRAM игры)
    struct { const uint8_t *hdr; const int len; } _ss = { hdr, dataLen };
    const uint32_t nSec = ((uint32_t)saveLen + 4095u) / 4096u;
    for (uint32_t sec = 0; sec < nSec; sec++) {
      const uint32_t base = sec * 4096u;
      const uint8_t *f = (const uint8_t *)(flashBase + saveOff + base);
      bool diff = false;
      for (uint32_t k = 0; k < 4096u; k++) {
        const uint32_t i = base + k;
        uint8_t want;
        if (i < SAVE_HDR)              want = _ss.hdr[i];
        else if ((int)(i - SAVE_HDR) < _ss.len) want = cartRam[i - SAVE_HDR];
        else                            want = 0xFF;
        if (want != f[k]) { diff = true; break; }
      }
      if (!diff) continue;                      // сектор не изменился — не стираем и не пишем
      flash_range_erase(saveOff + base, 4096u);
      saveErases++;
      for (uint32_t pg = 0; pg < 16u; pg++) {   // и записываем его страницы заново
        for (uint32_t k = 0; k < 256u; k++) {
          const uint32_t i = base + pg * 256u + k;
          uint8_t want;
          if (i < SAVE_HDR)              want = _ss.hdr[i];
          else if ((int)(i - SAVE_HDR) < _ss.len) want = cartRam[i - SAVE_HDR];
          else                            want = 0xFF;
          savePage[k] = want;
        }
        flash_range_program(saveOff + base + pg * 256u, savePage, 256);
      }
    }
  }
  interrupts();
  quietFlashEnd();

  saveHash = h; cartDirty = false; lastSaveMs = millis();
  mark(PH_LOOP);
  if (verbose) {
    Serial.print(F("Сохранено: ")); Serial.print(dataLen / 1024);
    Serial.print(F(" КиБ за ")); Serial.print(millis() - t0); Serial.println(F(" мс"));
  } else {
    Serial.print(F("автосейв ")); Serial.print(dataLen / 1024); Serial.print(F(" КиБ ("));
    Serial.print(millis() - t0); Serial.println(F(" мс)"));
  }
}

// Версия сборки: одна на весь скетч (баннер, 's' — чтобы в логах не было путаницы).
#define GBEMU_BUILD "v9.7.2"

// (подсветка переехала выше, перед автосбросом нагрузки — v8.9y)

// ============================================================ питание (как в стоке)
static void powerOff(void) {
  mark(PH_POWER);
  Serial.println(F("=== ВЫКЛЮЧЕНИЕ: снимаю ключ питания (GPIO1), как сток ==="));
  Serial.flush(); delay(30);                  // даём USB договорить (в журнале это важно)
  // v8.9q: ПОРЯДОК ВАЖЕН. Сначала гасим панель, подсветку и EN12 (это главные потребители),
  // и только потом пишем во flash. Раньше было наоборот: сначала запись, потом экран —
  // и стирание сектора шло на полной нагрузке. Именно так консоль и сбрасывалась по RUN.
  cmd1(0x28); cmd1(0x10);                     // DISPOFF, SLPIN
  analogWrite(PIN_BL, 0); digitalWrite(PIN_BL, LOW);
  digitalWrite(PIN_EN12, LOW);                // сток делает так же
  gQuietNoLight = true;                       // свет уже погашен — «тихая запись» его не трогает
  delay(30);
  Serial.println(F("=== экран погашен: сохраняю SRAM и отметки, затем снимаю питание ==="));
  saveStore(false);                           // сохраняем SRAM (пишется с выключенными прерываниями)
  romStateFlushAtExit();                      // и «какая игра», если она ждала лучшего питания
  settingsStore();                            // v9.7: настройки пользователя — тоже во flash
  Serial.flush(); delay(30);
  mark(PH_POWERCUT);                          // отметка «это штатное выключение»
  gPowerCutBy++;
  Serial.print(F("СНИМАЮ ПИТАНИЕ (это делает наша прошивка), раз №")); Serial.println(gPowerCutBy);
  Serial.println(F("   если после этого консоль выключилась — это НЕ сбой: так и задумано."));
  battRead(); blkWrite();                     // след в ящике ДО снятия питания
  blkFlush(true);                             // и ВСЁ кольцо ОЗУ — во flash: тут спешить некуда
  Serial.flush();
  watchdog_hw->scratch[5] = WD_POWER;         // её не затирает возврат из powerOff (если питание не снялось)
  for (int i = 0; i < 3; i++) { delay(20); wdtFeed(); }
  digitalWrite(PIN_PWR_HOLD, LOW);            // ключ питания -> питание снимается

  for (int i = 0; i < 8; i++) { delay(100); wdtFeed(); }   // ждём разряда питания
  // Если мы всё ещё живы — GPIO1 здесь не ключ питания: аккуратно возвращаемся.
  digitalWrite(PIN_PWR_HOLD, HIGH);
  digitalWrite(PIN_EN12, HIGH);
  gQuietNoLight = false;
  mark(PH_LOOP);
  Serial.print(F("SPI: ")); Serial.print(spi_get_baudrate(spi0) / 1000000.0f, 1); Serial.println(F(" МГц"));
  lcdInit();
  analogWrite(PIN_BL, backlight);   // v8.9u: родная яркость, а не 200
  Serial.println(F("!! Питание не снялось — вернул всё назад (GPIO1 у вас не ключ?)."));
}

static void printSaveState(void) {
  if (!saveLen) { Serial.println(F("сейвы: выключены (нет места)")); return; }
  Serial.print(F("сейв: ")); Serial.print(saveData / 1024); Serial.print(F(" КиБ, "));
  Serial.print(cartDirty ? F("есть несохранённое; ") : F("актуален; "));
  if (lastSaveMs) { Serial.print(F("последняя запись ")); Serial.print((millis() - lastSaveMs) / 1000); Serial.print(F(" с назад")); }
  else Serial.print(F("ещё не записывался"));
  Serial.println();
}

// ============================================================ состояние интерфейса
enum UiMode { UI_GAME, UI_TEST, UI_LEARN, UI_NOROM, UI_SHADES, UI_SPLASH, UI_MENU, UI_TONE, UI_ROMS };

// предварительные объявления (определения — ниже, они используются в Serial и loop)
static void menuOpen(void);
static void menuTick(uint16_t mask);
// v8.9t: проба звука спрятана за двойным нажатием z, и у неё всегда есть выход.
// Переменные нужны уже в обработчике клавиш (выше по файлу), поэтому объявляем здесь.
static uint32_t probeArmMs = 0;          // когда нажали z первый раз
static uint32_t probeLastMs = 0;         // последнее действие (для авто-выхода через 20 с)
static void toneStart(void);
static void toneStop(void);
static void toneTick(uint16_t mask);
static bool ssSave(int slot);
static bool ssLoad(int slot);
static void printFlashMap(void);
static void printSlotState(void);
static UiMode  ui = UI_GAME;
static char    romTitle[17] = {0};
static uint8_t splashLeft = 0;
static bool splashNeutral = false;   // v8.9v: заставка без названия игры (впереди список)

static void drawNoRom(void) {
  uiClear(0);
  uiTextCentered(24,  5, "NO GAME", 3);
  uiTextCentered(70,  3, "PUT GAMES INTO FLASH:", 2);
  uiTextCentered(92,  3, "python make_roms_uf2.py", 2);
  uiTextCentered(110, 3, "GAME1.GB GAME2.GB ...", 2);
  uiTextCentered(132, 3, "AND FLASH GAMES.UF2", 2);
  uiTextCentered(160, 2, "OR EMBED ONE: MAKE_ROM_HEADER.PY", 1);
  uiTextCentered(185, 3, "T - TEST KEYS", 1);
  uiTextCentered(205, 3, "L - LEARN KEYS", 1);
  uiPush();
}

static void drawButtonScreen(const char *head, uint16_t mask, const char *prompt) {
  uiClear(0);
  uiTextCentered(14, 4, head, 3);
  if (prompt) uiTextCentered(50, 4, prompt, 1);
  int x = 10;
  for (int i = 0; i < NBTN; i++) {
    if (!(mask & (1u << i))) continue;
    char num[4]; uint8_t gp = BTN_GPIO[i];
    if (gp >= 10) { num[0] = '0' + gp / 10; num[1] = '0' + gp % 10; num[2] = 0; }
    else { num[0] = '0' + gp; num[1] = 0; }
    uiText(x, 100, 5, num, 2);
    x += (gp >= 10 ? 2 : 1) * 4 * 5 + 10;
    if (x > MEM_W - 50) break;
  }
  for (int i = 0; i < NBTN; i++) {
    int bx = 12 + i * 24;
    uiRect(bx, 186, 18, 16, (mask & (1u << i)) ? 3 : 1);
  }
  uiPush();
}

// экран проверки 4 оттенков панели
static void drawShades(void) {
  char b[24];
  uiClear(0);
  snprintf(b, sizeof(b), "PAL %s", PALS[palIdx].name);
  uiTextCentered(8, 3, b, 3);
  for (int i = 0; i < 4; i++) {
    uiRect(20, 40 + i * 44, 120, 40, (uint8_t)i);
    snprintf(b, sizeof(b), "%d  %d,%d,%d", i, (curPal[i] >> 11 & 31) * 255 / 31,
             (curPal[i] >> 5 & 63) * 255 / 63, (curPal[i] & 31) * 255 / 31);
    uiText(150, 52 + i * 44, 3, b, 3);
  }
  snprintf(b, sizeof(b), "BRI %d%%  CON %d%%", bright, contr);
  uiTextCentered(222, 2, b, 3);
  uiPush();
}

static void drawSplash(void) {
  char b[24];
  wdtFeed();                                   // и в setup кормим сторожа (раньше не кормили)
  uiClear(0);
  uiTextCentered(30,  5, "GAME BOY", 2);
  if (splashNeutral) uiTextCentered(86, 3, "SELECT GAME", 3);   // v8.9v: на старте игру ещё не выбрали
  else uiTextCentered(86, 3, romTitle, 3);
  snprintf(b, sizeof(b), "PAL %s", PALS[palIdx].name);
  uiTextCentered(118, 3, b, 1);
  // v8.9v: SAVES: AUTO убрано (лишнее); "3S" читалось как "35" (S и 5 в шрифте
  // 3x5 одинаковые) — секунды тоже убраны.
  uiTextCentered(150, 2, "MENU = OPTIONS", 2);
  uiTextCentered(168, 2, "HOLD START = OFF", 2);
  { // батарея: текст + иконка, по центру
    const uint32_t mv = battUiMvSmooth();   // v8.9x: сглаженные (не прыгают)
    char vb[12]; battUiText(vb, sizeof(vb), mv);
    char bl[16]; snprintf(bl, sizeof(bl), "BAT %s", vb);
    const int vlen = !mv ? 2 : (mv < 3300 ? 9 : 5);    // длина vb без strlen
    const int tw = (4 + vlen) * 4 * 2, iw = 22, gap = 8;
    const int x0 = (MEM_W - tw - gap - iw) / 2, y0 = 190;
    uiText(x0, y0, 2, bl, 2);
    battUiIcon(x0 + tw + gap, y0, mv);
  }
  if (!splashNeutral && romCount > 1) uiTextCentered(212, 2, "MENU GAMES = CHANGE GAME", 1);
  uiPush();
}

static void drawPowerCountdown(int n) {
  char b[2]; b[0] = '0' + n; b[1] = 0;
  uiClear(0);
  uiTextCentered(40,  4, "POWER OFF", 3);
  uiTextCentered(95, 10, b, 3);
  uiTextCentered(180, 2, "RELEASE = CANCEL", 2);
  uiPush();
}

// ============================================================ обучение кнопок
static int      learnStep = 0;
static uint16_t learnPrev = 0;
static uint32_t learnT0 = 0;

static void learnPrompt(void) {
  char buf[16];
  snprintf(buf, sizeof(buf), "%d / 9", learnStep + 1);
  uiClear(0);
  uiTextCentered(30,  4, "LEARN", 3);
  uiTextCentered(90,  5, BTN_NAME[learnStep], 1);
  uiTextCentered(155, 3, buf, 2);
  uiTextCentered(180, 2, "PRESS AND RELEASE  (X = EXIT)", 2);
  uiPush();
  Serial.print(F("Нажмите и отпустите: ")); Serial.println(BTN_NAME[learnStep]);
}

static void reportMapping(void) {
  Serial.println(F("--- готово. Вставьте это в скетч (BTN_GPIO / BTN_NAME): ---"));
  Serial.print(F("static const uint8_t BTN_GPIO[NBTN] = {"));
  for (int i = 0; i < NBTN; i++) { Serial.print(' '); Serial.print(BTN_GPIO[i]); Serial.print(i < NBTN - 1 ? ',' : ' '); }
  Serial.println(F("};"));
  Serial.print(F("static const char   *BTN_NAME[NBTN] = {"));
  for (int i = 0; i < NBTN; i++) { Serial.print(F(" \"")); Serial.print(BTN_NAME[i]); Serial.print(i < NBTN - 1 ? F("\",") : F("\" ")); }
  Serial.println(F("};"));
}

static void learnTick(uint16_t mask) {
  if (mask && !learnPrev) {
    int idx = -1;
    for (int i = 0; i < NBTN; i++) if (mask & (1u << i)) { idx = i; break; }
    if (idx >= 0) {
      Serial.print(F("  GPIO")); Serial.print(BTN_GPIO[idx]);
      Serial.print(F(" = ")); Serial.println(BTN_NAME[learnStep]);
      joyMap[idx] = BTN_JOY[learnStep];
      learnStep++;
      if (learnStep >= NBTN) { reportMapping(); ui = UI_GAME; learnPrev = 0; return; }
      learnT0 = millis();
      learnPrompt();
    }
  }
  learnPrev = mask;
  if (millis() - learnT0 > 15000) { learnT0 = millis(); learnPrompt(); }
}

// ============================================================ статистика
static uint32_t statFrames = 0, statT0 = 0, statFps = 0;
// Раздельная статистика: кадры с прорисовкой и пропущенные (в режиме 30 кадр/с).
// Если «с прорисовкой» намного дороже — упираемся в SPI панели; если разница
// маленькая — упираемся в сам эмулятор.
static uint32_t statDrawUs = 0, statDrawN = 0, statSkipUs = 0, statSkipN = 0;
static uint32_t statSpiWaitUs = 0;
static uint32_t avgDrawUs = 0, avgSkipUs = 0, avgWaitUs = 0;
static uint32_t statCoreUs = 0, statCoreN = 0;      // время ядра на кадрах с выводом
static uint32_t avgCoreUs = 0, avgCbUs = 0, avgSpiUs = 0, avgCbCalls = 0, avgSpiCalls = 0;
static uint32_t avgRowUs = 0, avgRowsW = 0, avgRowsL = 0, avgDmaBad = 0, avgIrqUs = 0, avgIrqN = 0;
static uint32_t avgDmaRows = 0, avgDmaWaitUs = 0;   // v8.9m: строк через DMA и ожидание канала
static uint32_t avgSpiSyncUs = 0;
static uint32_t statEmuUs = 0, statAllUs = 0; static uint16_t statN = 0;
static uint32_t avgEmuUs = 0, avgAllUs = 0, avgCbUsPer = 0;

static void printCorePlace(void) {
  const uintptr_t a = (uintptr_t)&gb_run_frame;
  Serial.print(F("ядро эмулятора: "));
  if (a >= 0x20000000UL) Serial.println(F("в ОЗУ — быстро"));
  else Serial.println(F("во FLASH — медленно! поставьте Tools -> Optimize -> Fastest (-O3)"));
}

static void printStatus(void) {
  Serial.print(F("сборка ")); Serial.print(F(GBEMU_BUILD)); Serial.print(F("  "));
  Serial.print(F("fps="));        Serial.print(statFps);
  Serial.print(F(" ("));          Serial.print((uint32_t)((uint64_t)statFps * 100 / 60)); Serial.print(F("% скорости игры)"));
  if (spiHzIdx) {                                  // частота выбрана вручную (o) или режимом
    Serial.print(F("  панель ")); Serial.print(SPI_HZ_NAME[spiHzIdx]); Serial.print(F(" МГц"));
  }
  Serial.print(F("  эмуляция=")); Serial.print(avgEmuUs); Serial.print(F(" мкс"));
  Serial.print(F("  кадр="));     Serial.print(avgAllUs); Serial.print(F(" мкс"));
  Serial.print(F("  цель="));     Serial.print(FRAME_US); Serial.print(F(" мкс"));
  Serial.println();
  Serial.print(F("   игра: ")); Serial.print(romTitle);
  Serial.print(F(" ("));
  if (romCur >= 0) { Serial.print(F("картридж ")); Serial.print(romCur + 1); Serial.print(F(" из ")); Serial.print(romCount); }
  else Serial.print(F("встроенная rom.h"));
  Serial.print(F("), ключ сейва 0x")); Serial.print(romFingerprint(), HEX);
  if (saveLen) { Serial.print(F(", ячейка ")); Serial.print(saveBank + 1); Serial.print(F("/")); Serial.print(bankCount); }
  Serial.println();
  Serial.print(F("   кадр с выводом "));  Serial.print(avgDrawUs / 1000.0f, 1);
  Serial.print(F(" мс = ядро "));         Serial.print(avgCoreUs / 1000.0f, 1);
  Serial.print(F(" (в нём наш вывод "));  Serial.print(avgCbUs / 1000.0f, 1);
  Serial.print(F(" мс = "));              Serial.print(avgCbUsPer); Serial.print(F(" мкс/вызов"));
  Serial.print(F("), остальное "));       Serial.print((avgDrawUs - avgCoreUs) / 1000.0f, 1);
  Serial.print(F(", вызовов/кадр "));     Serial.print(avgCbCalls);
  Serial.print(F(", ожидание SPI "));     Serial.print(avgWaitUs / 1000.0f, 1);
  Serial.print(F(" мс, отправка "));       Serial.print(avgSpiUs / 1000.0f, 2);
  Serial.print(F(" мс ("));                Serial.print(avgSpiCalls); Serial.print(F("/кадр)"));
  if (txUseDma && txDmaReady) {
    Serial.print(F(", вывод DMA ")); Serial.print(avgDmaRows);
    Serial.print(F("/кадр, ожидание DMA ")); Serial.print(avgDmaWaitUs);
    Serial.print(F(" мкс/кадр"));
    if (txDmaAborts) { Serial.print(F(" (сбросов канала ")); Serial.print(txDmaAborts); Serial.print(F(")")); }
  } else if (avgSpiSyncUs) {
    Serial.print(F(", из них синхронно ")); Serial.print(avgSpiSyncUs / 1000.0f, 1); Serial.print(F(" мс"));
  }

  Serial.println();
  Serial.print(F("   строки: запись "));   Serial.print(avgRowUs); Serial.print(F(" мкс/строка"));
  Serial.print(F(", отдано "));            Serial.print(avgRowsW); Serial.print(F("/кадр"));
  Serial.print(F(", не влезло "));         Serial.print(avgRowsL);
  Serial.print(F(", сбоев SPI "));         Serial.print(avgDmaBad);
  Serial.print(F(", кадров всего "));      Serial.print(gFramesTotal);
  Serial.print(F(", медленных "));         Serial.print(gSlowFrames);
  Serial.print(F(", вывод "));             Serial.print(txPathName());
  Serial.print(F(" @ "));                  Serial.print(spi_get_baudrate(spi0) / 1000000.0f, 1); Serial.print(F(" МГц"));

  Serial.print(F(", звук-прерывание "));   Serial.print(avgIrqUs); Serial.print(F(" мкс x "));
  Serial.print(avgIrqN); Serial.print(F(" шт/с"));
  Serial.print(F(", SPI "));               Serial.print(spi_get_baudrate(spi0) / 1000000.0f, 1); Serial.print(F(" МГц"));
  if (gateSkips) { Serial.print(F(", пропущено кадров панелью ")); Serial.print(gateSkips); }
  if (gGuardDefers) { Serial.print(F(", автозаписей отложено (питание) ")); Serial.print(gGuardDefers); }
  if (spiRestarts) { Serial.print(F(", перезапусков шины ")); Serial.print(spiRestarts); }
  Serial.print(F(", просадка за сеанс мин ")); Serial.print(gDipWorst);
  Serial.print(F(" / сработала "));           Serial.print(gDipEvents); Serial.print(F(" раз"));
  { int rise = 0;
    const int mv = tempReadMv(&rise);
    Serial.print(F(", нагрев чипа +")); Serial.print(rise); Serial.print(F(" °C"));
    if (mv) { Serial.print(F(" (датчик ")); Serial.print(mv); Serial.print(F(" мВ, база "));
              Serial.print(tempBaseMv); Serial.print(F(" мВ — абсолютной цифре не верим)")); }
    else Serial.print(F(" (датчик не читается)")); }
  Serial.print(F(", питание A0="));         Serial.print(battCh[0]);
  Serial.print(F(" A3="));                   Serial.print(battCh[3]);
  Serial.print(F(", сторожу оставалось "));  Serial.print(watchdog_get_count() / 1000); Serial.print(F(" мс"));
  Serial.print(F(", чёрный ящик "));
  if (!blkOn) Serial.print(F("выкл"));
  else if (blkEraseInPlay) Serial.print(F("как раньше (пишет в игре)"));
  else if (blkSafeFlush) Serial.print(F("ОЗУ + выгрузка между кадрами"));
  else Serial.print(F("только в ОЗУ (во flash — при выключении)"));
  Serial.print(F(" (отметок "));             Serial.print(blkTotal);
  Serial.print(F(", во flash "));            Serial.print(blkFlushed);
  Serial.print(F(", стираний "));            Serial.print(blkErases);
  Serial.print(F(", операций с flash "));    Serial.print(blkFlashOps);
  if (blkRingFull) Serial.print(F(", кольцо ящика полно"));
  Serial.print(F(")"));
  Serial.println();
  Serial.print(F("   износ flash: сейвы ")); Serial.print(saveErases);
  Serial.print(F(" стираний секторов, сейвстейты ")); Serial.print(ssErases);
  Serial.print(F(", ящик ")); Serial.print(blkErases);
  Serial.print(F(" (ресурс сектора ~100000 стираний; сейвы пишем только изменившимися секторами, автосейв раз в 2 мин)"));
  if (txDroppedLines) { Serial.print(F(", строк следа пропущено ")); Serial.print(txDroppedLines); }
  Serial.println();
  Serial.print(F("  CPU="));      Serial.print(F_CPU / 1000000U); Serial.print(F(" МГц"));
  Serial.print(F("  палитра="));  Serial.print(PALS[palIdx].name);

  if (emuInited && gb.direct.interlace) Serial.print(F("  [интерлейс]"));
  if (paused) Serial.print(F("  [ПАУЗА]"));
  if (emuInited && gb.direct.frame_skip) Serial.print(F("  [30 fps]"));
  if (cartDirty) Serial.print(F("  [есть несохранённое]"));
  Serial.print(F("  звук=")); Serial.print(soundOn ? volPct : 0);
  if (!soundOn) Serial.print(F("%(выкл)"));
  else {
    Serial.print(F("%"));
    Serial.print(F(" AMP=LOW"));
    Serial.print(F(" темп=")); Serial.print(soundSync ? F("GAME(") : F("REAL("));
    Serial.print(apuTmrUs); Serial.print(F(" мкс)"));
  }
  Serial.print(F("  ядро=")); Serial.print(((uintptr_t)&gb_run_frame >= 0x20000000UL) ? F("ОЗУ") : F("FLASH"));
  if (emuInited) {
    Serial.print(F("  BGP=")); Serial.print(gb.hram_io[0x47], HEX);
    Serial.print(F(" OBP0=")); Serial.print(gb.hram_io[0x48], HEX);
    Serial.print(F(" OBP1=")); Serial.print(gb.hram_io[0x49], HEX);
  }
  Serial.println();
}

// применить изменение палитры и сообщить о нём
static void palChanged(void) {
  rebuildPalette();                          // перестраивает и таблицу цветов
  Serial.print(F("палитра ")); Serial.print(PALS[palIdx].name);
  Serial.print(F("   яркость ")); Serial.print(bright);
  Serial.print(F("%   контраст ")); Serial.print(contr);
  Serial.print(F("%   оттенки: "));
  for (int i = 0; i < 4; i++) {
    uint16_t c = curPal[i];
    Serial.print(F("rgb(")); Serial.print((c >> 11 & 31) * 255 / 31);
    Serial.print(',');       Serial.print((c >> 5 & 63) * 255 / 63);
    Serial.print(',');       Serial.print((c & 31) * 255 / 31);
    Serial.print(F(") "));
  }
  Serial.println();
  if (ui == UI_SHADES) drawShades();
  else if (ui == UI_SPLASH) drawSplash();
}

static void printHelp(void) {
  mark(PH_HELP);
  Serial.println(F("--- команды (115200) ---"));
  Serial.println(F("  t  тест кнопок            l  обучение кнопок (выход — x)"));
  Serial.println(F("  n  разбор кадра: что отдаёт ядро и уходят ли строки в панель"));
  Serial.println(F("  j  тест панели: четыре полосы оттенков (без эмулятора)"));
  Serial.println(F("  p  пауза                  r  сброс игры (+сохранение)"));
  Serial.println(F("  f  режим 30 кадр/с        s  статус"));
  Serial.println(F("  g  следующая палитра      k  экран проверки 4 оттенков"));
  Serial.println(F("  i  инверсия оттенков      w  сохранить сейв сейчас"));
  Serial.println(F("  v  статистика кадра: сколько пикселей каждого оттенка и слоя"));
  Serial.println(F("  x  звук вкл/выкл          (громкость — в меню, клавиша m)"));
  Serial.println(F("  y  темп звука: за игрой (по умолчанию) / реальное время"));
  Serial.println(F("  o  частота SPI панели: 62,5 -> 125 -> 41,7 -> 20,8 МГц (в стоке было ~100)"));
  Serial.println(F("  d  чёрный ящик: писать состояние во flash (по умолчанию включён)"));
  Serial.println(F("  e  переинициализировать шину и экран (если картинка пропала, а лог идёт)"));
  Serial.println(F("  u  вывод строк: DMA (быстро, для 60 fps и звука) / синхронно (как было)"));
  Serial.println(F("  m  меню (яркость/палитра/сейвстейты)"));
  Serial.println(F("  c  СПИСОК ИГР во flash: выбор другой игры на ходу (у каждой свой сейв SRAM)"));
  Serial.println(F("  a  (удалено в v9.2: яркость батареей не трогаем)"));
  Serial.println(F("  1 2 сохранить сейвстейт,  3 4 загрузить"));
  Serial.println(F("  z z  проба звука: 6 опытов (СПРЯТАНА — нужны два нажатия; выход — A/B)"));
  Serial.println(F("  [ ]  яркость 50..150 %    - =  контраст 50..200 %"));
  Serial.println(F("  b  режим загрузчика       q  ВЫКЛЮЧИТЬ (как сток: снять ключ питания)"));
  Serial.println(F("  h  эта справка"));
  Serial.println(F("Кнопки: удержание START или MENU 3 секунды — выключение (отсчёт 3-2-1)."));
  Serial.println(F("Усилитель: GP20 = LOW на время звука, после 2 с тишины глушится (v9.4; AMP в меню убран)"));
  Serial.println(F("Питание: батарея читается с A3 (GP29) через делитель 1:2."));
  Serial.println(F("Износ flash: сейвы SRAM пишутся только изменившимися секторами (автосейв раз в 2 мин),"));
  Serial.println(F("   ящик стирает сектор только при возврате кольца к занятому слоту. Счётчики — в 's'."));
  Serial.println(F("Питание: если консоль выключилась САМА — в логе не будет записи «СНИМАЮ ПИТАНИЕ»,"));
  Serial.println(F("   а в чёрном ящике будет видно напряжение за 0,25 с до смерти (сторож питания)."));
  Serial.println(F("Режимы при ВКЛЮЧЕНИИ (зажать кнопку): SELECT — без звука; B — лёгкий (без подсветки и звука,"));
  Serial.println(F("   SPI 41,7 МГц); RIGHT — тихая панель (SPI 20,8 МГц); DOWN — без чёрного ящика;"));
  Serial.println(F("   START — умный ящик (выгрузка во flash между кадрами); A — ящик как раньше (со стираниями);"));
  Serial.println(F("   LEFT — панель не трогаем (только эмуляция)."));
  Serial.println(F("Ящик: в игре во flash не пишем; отметки — в ОЗУ (16 последних), во flash уходят"));
  Serial.println(F("   при выключении и в отчёте о смерти. Режимы при включении: START — выгружать")); 
  Serial.println(F("   ещё и между кадрами; A — как раньше (контроль: так консоль выключалась)."));
  Serial.println(F("Просадка питания: ловушка читает батарею 2777 раз в секунду и скажет в лог,"));
  Serial.println(F("   если питание клюнуло (см. строку «ПРОСАДКА ПИТАНИЯ» и статистику 's')."));
}

// ============================================================ Serial
static void handleSerial(void) {
  mark(PH_SERIAL);
  while (Serial.available()) {
    int c = Serial.read();
    if (c == '\n' || c == '\r') continue;

    if (ui == UI_LEARN) {
      if (c == 'x' || c == 'X') { ui = emuInited ? UI_GAME : UI_NOROM; Serial.println(F("Обучение прервано.")); if (!emuInited) drawNoRom(); }
      continue;
    }
    if (ui == UI_TONE) { toneStop(); continue; }      // любая клавиша останавливает тест
    switch (c) {
      case 't': case 'T':
        ui = (ui == UI_TEST) ? UI_GAME : UI_TEST;
        Serial.println(ui == UI_TEST ? F("ТЕСТ КНОПОК: номера GPIO на экране и в Serial.")
                                     : F("Назад в игру."));
        if (ui == UI_TEST) drawButtonScreen("TEST", readMask(), "GPIO NUMBERS");
        break;
      case 'l': case 'L':
        if (!emuInited) { Serial.println(F("Сначала вставьте ROM (rom.h) и пересоберите.")); break; }
        ui = UI_LEARN; learnStep = 0; learnPrev = 0; learnT0 = millis(); paused = false;
        Serial.println(F("=== ОБУЧЕНИЕ (fps не печатается, выход — x) ==="));
        learnPrompt();
        break;
      case 'a': case 'A':
        Serial.println(F("автосброс яркости удалён в v9.2: батареей яркость не трогаем никогда."));
        break;
      case 'c': case 'C':
        if (romCount) romMenuOpen();                 // список игр: выбор и запуск на ходу
        else Serial.println(F("Списка игр нет: соберите make_roms_uf2.py и залейте games.uf2."));
        break;
      case 'p': case 'P':
        paused = !paused;
        Serial.println(paused ? F("ПАУЗА.") : F("Продолжаем."));
        break;
      case 'r': case 'R':
        if (emuInited) { saveStore(false); gb_reset(&gb); gb.direct.joypad = 0xFF; Serial.println(F("Сброс игры.")); }
        break;
      case 'f': case 'F':
        if (emuInited) {
          gb.direct.frame_skip = !gb.direct.frame_skip;
          Serial.println(gb.direct.frame_skip ? F("Режим 30 кадр/с (логика остаётся 60 Гц).")
                                              : F("Полные 60 кадр/с."));
        }
        break;
      case 'g': case 'G':
        palIdx = (uint8_t)((palIdx + 1) % PAL_COUNT);
        palChanged();
        break;
      case 'k': case 'K':
        ui = (ui == UI_SHADES) ? UI_GAME : UI_SHADES;
        if (ui == UI_SHADES) drawShades();
        break;
      case 'i': case 'I':
        invertShades = !invertShades;
        Serial.println(invertShades ? F("Оттенки инвертированы.") : F("Оттенки как обычно."));
        palChanged();
        break;
      case '[': bright = (bright > 50) ? bright - 5 : 50;  palChanged(); break;
      case ']': bright = (bright < 150) ? bright + 5 : 150; palChanged(); break;
      case '-': contr  = (contr > 50)  ? contr - 10 : 50;   palChanged(); break;
      case '=': contr  = (contr < 200) ? contr + 10 : 200;  palChanged(); break;
      case 'm': case 'M':
        if (emuInited && ui != UI_MENU) menuOpen();
        break;
      case '1': if (emuInited) { Serial.println(ssSave(0) ? F("Сейвстейт 1 сохранён.") : F("Слот недоступен.")); } break;
      case '2': if (emuInited) { Serial.println(ssSave(1) ? F("Сейвстейт 2 сохранён.") : F("Слот недоступен.")); } break;
      case '3': if (emuInited) { Serial.println(ssLoad(0) ? F("Сейвстейт 1 загружен.") : F("Слот 1 пуст/от другой игры.")); } break;
      case '4': if (emuInited) { Serial.println(ssLoad(1) ? F("Сейвстейт 2 загружен.") : F("Слот 2 пуст/от другой игры.")); } break;
      case 'z': case 'Z':                              // v8.9t: проба спрятана за двойным нажатием
        if (probeArmMs && (uint32_t)(millis() - probeArmMs) < 5000UL) {
          probeArmMs = 0;
          toneStart();                                 // проба звука работает и без ROM
        } else {
          probeArmMs = millis() ? millis() : 1u;
          Serial.println(F("проба звука СПРЯТАНА: нажмите z ещё раз в течение 5 секунд, чтобы запустить."));
          Serial.println(F("   (громкие опыты со звуком; выход — кнопка A или B, любая клавиша,"));
          Serial.println(F("    либо 20 с без действий: проба конечная, ресет для выхода не нужен)"));
        }
        break;
      case 'j': case 'J':                      // тест панели: залить экран оттенками
        panelTest();
        break;
      case 'n': case 'N':                      // диагностика: что отдаёт ядро и уходят ли строки
        drawDiagStart();
        break;
      case 'd': case 'D':                      // чёрный ящик (запись состояния во flash)
        blkOn = !blkOn;
        Serial.print(F("чёрный ящик во flash: ")); Serial.println(blkOn ? F("включён") : F("выключен"));
        if (blkOn) { blkWrite(); Serial.println(F("сделал первую запись (клавиша d — выключить).")); }
        else Serial.println(F("записей было ")), Serial.println(blkWrites);
        break;
      case 'u': case 'U':                      // вывод строк: DMA / синхронно (сравнить)
        if (txUseDma) {
          if (txDmaArmed) { txDmaWait(TX_GUARD_US); txDmaArmed = false; }
          txUseDma = false;
          Serial.println(F("вывод: СИНХРОННАЯ запись строк (как было раньше) — сравните fps и звук."));
        } else {
          txUseDma = true; txDmaInit();
          Serial.println(txDmaReady
            ? F("вывод: DMA (строка уезжает сама, ядро считает дальше) — сравните fps и звук.")
            : F("DMA недоступен — остаюсь на синхронной записи."));
        }
        break;

      case 'e': case 'E':                      // починить шину и панель, если картинка пропала
        Serial.println(F("переинициализирую шину и панель (яркость и палитра не меняются)..."));
        txWaitIdle(TX_GUARD_US);
        SPI.endTransaction();
        SPI.beginTransaction(SPISettings(SPI_HZ, MSBFIRST, SPI_MODE0));
        { uint32_t x = 0; while (spi_is_readable(spi0) && x++ < 64) (void)spi_get_hw(spi0)->dr; }
        txDmaArmed = false;                    // шину перезапускали: старых передач нет
        txDmaInit();                           // и канал DMA привязываем заново
        lcdInit();                             // сброс + снятие спящего режима, окно — на весь экран
        Serial.print(F("частота SPI сейчас ")); Serial.print(spi_get_baudrate(spi0) / 1000000.0f, 1);
        Serial.println(F(" МГц (клавиша o — переключить)"));
        uiClear(0); uiPush();
        Serial.println(F("панель инициализирована заново (картинка не вернулась — сообщите)."));
        break;
      case 'o': case 'O':                      // частота SPI панели
        spiHzIdx = (uint8_t)((spiHzIdx + 1) % (sizeof(SPI_HZ_TAB) / sizeof(SPI_HZ_TAB[0])));
        spiSetClock(SPI_HZ_TAB[spiHzIdx]);
        break;
      case 'y': case 'Y':                      // темп звука: за игрой или реальное время
        soundSync = !soundSync;
        Serial.print(F("темп звука: "));
        Serial.print(soundSync ? F("GAME — синхронно с игрой (медленнее, если игра тормозит)")
                               : F("REAL — всегда реальное время"));
        Serial.println();
        break;
      case 'x': case 'X':
        soundSetOn(!soundOn);
        Serial.print(F("звук ")); Serial.print(soundOn ? F("включён") : F("выключен"));
        Serial.println(F(", усилитель: GP20 = LOW на время звука, тишина 2 с — глушим"));
        break;
      case 'v': case 'V':
        diagFrames = 3;
        Serial.println(F("снимаю статистику кадра (3 кадра)..."));
        break;
      case 'w': case 'W':
        saveStore(true);
        break;
      case 's': case 'S':
        printStatus(); printSaveState(); printFlashMap(); printSlotState();
        break;
      case 'b': case 'B':
        Serial.println(F("Уходим в режим загрузчика (RPI-RP2)..."));
        Serial.flush();
        rp2040.rebootToBootloader();
        break;
      case 'q': case 'Q':
        powerOff();
        break;
      case 'h': case 'H': case '?':
        printHelp();
        break;
      default:
        ui = emuInited ? UI_GAME : UI_NOROM;
        break;
    }
  }
}

// ============================================================ удержание START / MENU
int holdIdx = -1;                 // 0 = START, 1 = MENU (какая кнопка сейчас удерживается)
static uint32_t holdT0 = 0;
static int      offCount = -1;
#define HOLD_MS      1500         // с этого момента показываем отсчёт 3-2-1
#define HOLD_OFF_MS  3000         // всего 3 секунды удержания — и питание снимается
#define STEP_MS      500

static bool holdTick(uint16_t mask) {
  int idx = -1;
  // v9.7: держать для выключения можно не только в игре: список игр, меню и
  // «NO ROM» — тоже (вопрос «как выключить, не заходя в игру»).
  if (ui == UI_GAME || ui == UI_MENU || ui == UI_ROMS || ui == UI_NOROM) {
    if (mask & (1u << IDX_START)) idx = IDX_START;
    else if (mask & (1u << IDX_MENU)) idx = IDX_MENU;
  }
  if (idx >= 0) {
    if (holdIdx != idx) { holdIdx = idx; holdT0 = millis() ? millis() : 1; offCount = -1; }
    const uint32_t held = millis() - holdT0;
    if (held >= HOLD_OFF_MS) powerOff();
    if (held >= HOLD_MS) {
      if (offCount < 0) {                     // пишем в лог: видно, кто включил отсчёт
        Serial.print(F("удержание "));
        Serial.print(idx == IDX_START ? F("START") : F("MENU"));
        Serial.println(F(" — отсчёт 3 с (отпустите кнопку, чтобы отменить)"));
        mark(PH_HOLD);
      }
      int n = 3 - (int)((held - HOLD_MS) / STEP_MS);
      if (n < 1) n = 1;
      if (n != offCount) { offCount = n; drawPowerCountdown(n); }
      return true;
    }
    return false;
  }
  if (holdIdx >= 0) {
    const uint32_t held = millis() - holdT0;
    const int was = holdIdx;
    holdIdx = -1;
    if (offCount >= 0) { offCount = -1; Serial.println(F("Выключение отменено.")); }
    else if (held < HOLD_MS && was == IDX_MENU && emuInited) {
      menuOpen();                     // короткое нажатие MENU — меню (как в стоке)
    }
  }
  return false;
}


// ============================================================ сейвстейты
// В слот пишем: заголовок (256 Б) + всю структуру gb_s (вся память и регистры
// эмулятора) + картриджную RAM. Всё сразу и целиком — «половинок» не бывает.
#define SS_SLOTS 2
#define SS_MAGIC 0x33545353UL          // "SST3" (v7: + состояние APU, выравненные страницы)

static uint32_t ssOff[SS_SLOTS] = {0, 0};
static int      ssLen = 0;             // размер слота (кратно 4096)
static bool     ssReady = false;

static uint32_t romFingerprint(void) {
  // Ключ игры. Для картриджа из списка это CRC32 образа, который посчитал упаковщик
  // (его же мы храним в заголовке сейва). Для встроенной игры ключа нет — 0.
  if (romSaveKey) return romSaveKey;
  return 0;
}

static void ssInit(void) {
  uintptr_t end = (flashEnd + 4095u) & ~(uintptr_t)4095u;
  if (end < flashBase) end = flashBase;
  // база сейвстейтов тоже должна быть кратна сектору (иначе первая страница
  // записи съезжает — именно на это и указал хостовый стенд)
  uint32_t base = (uint32_t)(end - flashBase) + (uint32_t)saveLen * (uint32_t)(bankCount > 0 ? bankCount : 1);
  base = (base + 4095u) & ~(uint32_t)4095u;
  const uint32_t need = (uint32_t)(SAVE_HDR + sizeof(struct gb_s) + sizeof(cartRam)
                                   + sizeof(struct ApuState));
  ssLen = (int)((need + 4095u) & ~4095u);
  ssReady = true;
  // v8.9o: при залитом наборе игр сейвстейты тоже держим НИЖЕ области картриджей
  const uint32_t ssLimit = romCount ? ROMS_TABLE_OFF : FLASH_LIMIT;
  for (int i = 0; i < SS_SLOTS; i++) {
    if (base + (uint32_t)ssLen <= ssLimit) { ssOff[i] = base; base += (uint32_t)ssLen; }
    else { ssOff[i] = 0; ssReady = false; }
  }
}

// ВАЖНО (это и был баг «SAVED SLOT 1 -> EMPTY SLOT 1»): pico-sdk требует,
// чтобы flash_range_program() получал смещение, кратное 256, и длину, кратную
// 256 (ровно одна страница). Структура gb_s = 16916 Б странице не кратна,
// поэтому запись «каждую часть со своего смещения» уезжала: последняя страница
// структуры затиралась началом следующего куска (SRAM), хеш не сходился —
// сейв писался, а при загрузке отвергался.
// Теперь весь слот пишется ОДНИМ потоком: собираем байты в буфер страницы и
// отдаём во flash только целые страницы, начиная с выровненного ssOff[slot].
static uint8_t  ssPage[256];
static uint32_t ssPageBase = 0;
static size_t   ssPageFill = 0;

static void flashPageWrite(void) {                 // записать собранную страницу
  wdtFeed();
  if (ssPageFill < 256) memset(ssPage + ssPageFill, 0xFF, 256 - ssPageFill);
  flash_range_program(ssPageBase, ssPage, 256);
  ssPageBase += 256;
  ssPageFill = 0;
}

static void flashStreamBegin(uint32_t alignedOff) { // off обязан быть кратен 256
  ssPageBase = alignedOff & ~(uint32_t)0xFF;
  ssPageFill = 0;
}

static void flashStream(const uint8_t *src, size_t n) {
  while (n) {
    const size_t room = 256 - ssPageFill;
    const size_t take = n < room ? n : room;
    memcpy(ssPage + ssPageFill, src, take);
    ssPageFill += take;
    src += take;
    n -= take;
    if (ssPageFill == 256) flashPageWrite();
  }
}

static void flashStreamEnd(void) { if (ssPageFill) flashPageWrite(); }

static bool ssSave(int slot) {
  if (!ssReady || slot < 0 || slot >= SS_SLOTS || !emuInited) return false;
  const uint32_t t0 = millis();
  const uint32_t gbBytes  = (uint32_t)sizeof(struct gb_s);
  const uint32_t apuBytes = (uint32_t)sizeof(struct ApuState);

  uint8_t hdr[256];
  memset(hdr, 0xFF, sizeof(hdr));
  const uint32_t magic = SS_MAGIC, len = (uint32_t)ssLen;
  const uint32_t romH = romFingerprint();
  const uint32_t h = fnv1a((const uint8_t *)&gb, (int)gbBytes)
                   ^ fnv1a(cartRam, (int)sizeof(cartRam))
                   ^ fnv1a((const uint8_t *)&apu, (int)apuBytes);
  memcpy(hdr, &magic, 4); memcpy(hdr + 4, &len, 4);
  memcpy(hdr + 8, &romH, 4); memcpy(hdr + 12, &gbBytes, 4);
  memcpy(hdr + 16, &apuBytes, 4); memcpy(hdr + 20, &h, 4);

  mark(PH_SSAVE);
  quietFlashBegin();                    // v8.9q: тихая запись (свет гаснет, звук молчит)
  noInterrupts();
  flash_range_erase(ssOff[slot], (size_t)ssLen); ssErases++;
  flashStreamBegin(ssOff[slot]);        // слот выровнен на 4096 -> страницы ровные
  flashStream(hdr, 256);
  flashStream((const uint8_t *)&gb, gbBytes);
  flashStream(cartRam, sizeof(cartRam));
  flashStream((const uint8_t *)&apu, apuBytes);
  flashStreamEnd();
  interrupts();
  quietFlashEnd();
  mark(PH_LOOP);
  Serial.print(F("сейвстейт ")); Serial.print(slot + 1); Serial.print(F(": "));
  Serial.print(millis() - t0); Serial.print(F(" мс, ")); Serial.print(ssLen / 1024); Serial.println(F(" КиБ"));
  return true;
}

static bool ssLoad(int slot) {
  if (!ssReady || slot < 0 || slot >= SS_SLOTS || !emuInited) return false;
  const uint8_t *p = (const uint8_t *)(flashBase + ssOff[slot]);
  uint32_t magic, len, romH, gbBytes, apuBytes, h;
  memcpy(&magic, p, 4); memcpy(&len, p + 4, 4); memcpy(&romH, p + 8, 4);
  memcpy(&gbBytes, p + 12, 4); memcpy(&apuBytes, p + 16, 4); memcpy(&h, p + 20, 4);
  if (magic != SS_MAGIC || len != (uint32_t)ssLen) return false;
  if (gbBytes != sizeof(struct gb_s)) return false;
  if (apuBytes != sizeof(struct ApuState)) return false;
  if (romH != romFingerprint()) return false;                 // сейв от другой игры
  const uint32_t h2 = fnv1a(p + 256, (int)gbBytes)
                    ^ fnv1a(p + 256 + gbBytes, (int)sizeof(cartRam))
                    ^ fnv1a(p + 256 + gbBytes + (uint32_t)sizeof(cartRam), (int)apuBytes);
  if (h2 != h) return false;

  soundSuspend();
  memcpy(&gb, p + 256, gbBytes);
  memcpy(cartRam, p + 256 + gbBytes, sizeof(cartRam));
  memcpy(&apu, p + 256 + gbBytes + (uint32_t)sizeof(cartRam), apuBytes);
  // указатели на колбэки и настройки вывода — наши, а не из сейва
  gb.gb_rom_read = cb_rom_read;
  gb.gb_cart_ram_read = cb_cart_read;
  gb.gb_cart_ram_write = cb_cart_write;
  gb.gb_error = cb_error;
  gb.display.lcd_draw_line = cb_lcd_line;
  gb.direct.frame_skip = true;
  gb.direct.joypad = 0xFF;
  cartDirty = false;
  soundResume();
  return true;
}

// v9.1: ЧЕСТНЫЕ СЕЙВЫ. Ничего не удаляем молча: перед вытеснением чужого сейва
// спрашиваем, в списке игр показываем, у кого сейв уже есть.
static int saveCellKey(int i, uint32_t *keyOut) {   // 0 — сейв читается, -1 — пусто/нет, -2 — старый формат, -3 — не прочитать
  if (i < 0 || i >= bankCount || !saveLen) return -1;
  const uint8_t *p = (const uint8_t *)(flashBase + bankOff[i]);
  uint32_t magic = 0, len = 0, k = 0, nk = 0;
  memcpy(&magic, p, 4); memcpy(&len, p + 4, 4);
  memcpy(&k, p + SAVE_HDR_KEY, 4); memcpy(&nk, p + SAVE_HDR_KEY + 4, 4);
  if (magic != SAVE_MAGIC) return -1;
  if (k == 0xFFFFFFFFu) return -2;                  // «безымянная» ячейка прежних версий
  if (keyOut) *keyOut = k;
  return (len == (uint32_t)saveLen && nk == ~k) ? 0 : -3;
}

static bool saveHasGame(uint32_t key) {             // есть ли загружаемый сейв этой игры
  if (!key || !saveLen || bankCount <= 0) return false;
  for (int i = 0; i < bankCount; i++) {
    uint32_t k = 0;
    if (saveCellKey(i, &k) == 0 && k == key) return true;
  }
  return false;
}

// Что будет, если привязать игру key: true — жертва занята ЧУЖИМ сейвом (надо спросить).
// Выбор жертвы — ровно тот же, что в saveBind (ранги по пустоте и давности).
static bool saveEvictPending(uint32_t key, int *victimOut, uint32_t *victimKeyOut) {
  if (!key || !saveLen || bankCount <= 0) return false;
  int victim = 0;
  uint32_t best = 0xFFFFFFFFu;
  for (int i = 0; i < bankCount; i++) {
    const uint8_t *p = (const uint8_t *)(flashBase + bankOff[i]);
    uint32_t magic = 0, len = 0, k = 0, nk = 0, seq = 0xFFFFFFFFu;
    memcpy(&magic, p, 4); memcpy(&len, p + 4, 4);
    memcpy(&k, p + SAVE_HDR_KEY, 4); memcpy(&nk, p + SAVE_HDR_KEY + 4, 4);
    memcpy(&seq, p + SAVE_HDR_SEQ, 4);
    bool legacy = false;
    if (k == 0xFFFFFFFFu) { k = 0; nk = 0xFFFFFFFFu; legacy = true; }
    if (magic == SAVE_MAGIC && len == (uint32_t)saveLen && k == key && nk == ~key) return false;
    uint32_t rank;
    if (magic != SAVE_MAGIC) rank = 0u;
    else if (legacy) rank = 0xFFFFFFFEu;
    else { if (seq > 0xFFFFFFFDu) seq = 0xFFFFFFFDu; rank = 1u + (0xFFFFFFFDu - seq); }
    if (rank < best) { best = rank; victim = i; }
  }
  const uint8_t *p = (const uint8_t *)(flashBase + bankOff[victim]);
  uint32_t magic = 0, k = 0;
  memcpy(&magic, p, 4); memcpy(&k, p + SAVE_HDR_KEY, 4);
  if (magic != SAVE_MAGIC) return false;            // жертва пустая — спрашивать не о чем
  if (victimOut) *victimOut = victim;
  if (victimKeyOut) *victimKeyOut = k;
  return true;
}

static void saveKillBank(int i) {                   // мгновенно убить ячейку: зануляем магию
  if (i < 0 || i >= bankCount || !saveLen) return;  // (программирование 1->0, стирание не нужно)
  uint8_t page[256];
  memcpy(page, (const void *)(flashBase + bankOff[i]), sizeof(page));
  page[0] = page[1] = page[2] = page[3] = 0;
  flash_range_program(bankOff[i], page, sizeof(page));
  Serial.print(F("сейвы: ячейка ")); Serial.print(i + 1);
  Serial.println(F(" стёрта (пользователь подтвердил вытеснение)"));
}

static void romNameByCrc(uint32_t crc, char *out, size_t outLen) {  // имя игры по ключу сейва
  for (int i = 0; i < romCount; i++)
    if (romList[i].crc == crc) { snprintf(out, outLen, "%s", romList[i].name); return; }
  snprintf(out, outLen, "OLD GAME");
}

static char ssSlotMark(int slot) {                  // ' ' пусто, '*' мой, 'X' чужой
  if (!ssReady || slot < 0 || slot >= SS_SLOTS || !ssOff[slot]) return ' ';
  uint32_t magic = 0, romH = 0;
  memcpy(&magic, (const void *)(flashBase + ssOff[slot]), 4);
  memcpy(&romH, (const void *)(flashBase + ssOff[slot] + 8), 4);
  if (magic != SS_MAGIC) return ' ';
  return (romH == romFingerprint()) ? '*' : 'X';
}

static bool ssSlotForeign(int slot, uint32_t *romHOut) {  // слот занят ЧУЖОЙ игрой?
  if (!ssReady || slot < 0 || slot >= SS_SLOTS || !ssOff[slot]) return false;
  uint32_t magic = 0, romH = 0;
  memcpy(&magic, (const void *)(flashBase + ssOff[slot]), 4);
  memcpy(&romH, (const void *)(flashBase + ssOff[slot] + 8), 4);
  if (magic != SS_MAGIC || romH == romFingerprint()) return false;
  if (romHOut) *romHOut = romH;
  return true;
}

// (подсветка backlight/setBacklight переехала выше, перед powerOff — v8.9u)

// ============================================================ ТИХАЯ ЗАПИСЬ ВО FLASH (v8.9q)
// Стирание сектора — ~50 мс. Если в этот момент работает ещё и всё остальное (ядро 100 %,
// панель, звук с усилителем), батарея уходит ниже порога внешней схемы контроля питания,
// и та сбрасывает чип по RUN. Именно так умирала консоль: в логе все смерти оборвались на
// строке «ящик: выгружаю во flash отметок …». Поэтому КАЖДУЮ запись делаем «тихо»:
// глушим звук с усилителем и гасим подсветку (главные потребители) на время стирания.
// Экран при этом на 0,1–0,6 с темнеет — это плата за то, что консоль не выключается.
static void quietFlashBegin(void) {
  if (gQuietBusy) return;                   // уже внутри тихой записи — не считаем дважды
  gQuietBusy = true; gQuietN++;
  soundSuspend();                           // звук — прочь
  gAmpOn = 0; gAmpSil = 0;                  // v9.4: и усилитель глушим явно (GP20 = HIGH)
  digitalWrite(PIN_AMP, HIGH);
  if (!gQuietNoLight) { analogWrite(PIN_BL, 0); digitalWrite(PIN_BL, LOW); delay(2); }
}
static void quietFlashEnd(void) {
  if (!gQuietBusy) return;
  gQuietBusy = false; gQuietBack++;
  if (!gQuietNoLight) analogWrite(PIN_BL, backlight);
  soundResume();
  ampApply();                               // v9.3: вернуть GP20 = LOW при включённом звуке
}

// ============================================================ быстрое меню (MENU)
enum { MI_LIGHT, MI_CONTRAST, MI_PALETTE, MI_INVERT,
       MI_SOUND, MI_VOLUME, MI_GAMES,
       MI_SAVE1, MI_LOAD1, MI_SAVE2, MI_LOAD2, MI_RESET, MI_PROBE, MI_RESUME, MI_COUNT };
#define MI_ROWH 14                     // 15 строк по 14 px влезают в экран 240

static int      menuSel = 0;
static char     menuMsg[26] = "";
static uint16_t menuPrev = 0xFFFF;
static int      menuConfirmSlot = -1;                               // v9.1: вопрос про чужой стейт
static uint32_t menuConfirmHash = 0;

static void drawMenu(void) {
  char row[28];
  uiClear(0);
  uiTextCentered(2, 2, "MENU", 3);
  battUiHeader(4);   // v8.9v: иконка + вольты справа
  for (int i = 0; i < MI_COUNT; i++) {
    const int y = 20 + i * MI_ROWH;
    switch (i) {
      case MI_LIGHT:    snprintf(row, sizeof(row), "LIGHT     %3d%%%s", (backlight * 100) / 255, (backlight < lightUser) ? " BAT" : ""); break;
      case MI_CONTRAST: snprintf(row, sizeof(row), "CONTRAST  %3d%%", contr); break;
      case MI_PALETTE:  snprintf(row, sizeof(row), "PALETTE   %s", PALS[palIdx].name); break;
      case MI_INVERT:   snprintf(row, sizeof(row), "INVERT    %s", invertShades ? "ON" : "OFF"); break;
      case MI_SOUND:    snprintf(row, sizeof(row), "SOUND     %s", soundOn ? "ON" : "OFF"); break;
      case MI_VOLUME:   snprintf(row, sizeof(row), "VOLUME    %3d%%", volPct); break;
      case MI_GAMES:    snprintf(row, sizeof(row), "GAMES     %d IN FLASH", romCount); break;
      case MI_SAVE1:    snprintf(row, sizeof(row), "SAVE TO SLOT 1 %c", ssSlotMark(0)); break;
      case MI_LOAD1:    snprintf(row, sizeof(row), "LOAD SLOT 1 %c", ssSlotMark(0)); break;
      case MI_SAVE2:    snprintf(row, sizeof(row), "SAVE TO SLOT 2 %c", ssSlotMark(1)); break;
      case MI_LOAD2:    snprintf(row, sizeof(row), "LOAD SLOT 2 %c", ssSlotMark(1)); break;
      case MI_RESET:    snprintf(row, sizeof(row), "RESET GAME"); break;
      case MI_PROBE:    snprintf(row, sizeof(row), "SOUND PROBE (6 TESTS)"); break;
      default:          snprintf(row, sizeof(row), "RESUME GAME"); break;
    }
    if (i == menuSel) uiRect(2, y - 2, MEM_W - 4, 13, 1);
    uiText(8, y, 2, row, 3);
  }
  uiTextCentered(232, 2, menuMsg[0] ? menuMsg : "A=OK  B=EXIT  UP/DN  L/R", 1);
  uiPush();
}

static void menuAdjust(int dir) {
  switch (menuSel) {
    case MI_LIGHT:    setBacklight((int)lightUser + dir * 25);   // v9.2: потолков нет — крутилка правит напрямую
                      break;
    case MI_CONTRAST: contr = (uint8_t)((dir > 0) ? (contr < 200 ? contr + 10 : 200) : (contr > 50 ? contr - 10 : 50));
                      rebuildPalette(); break;
    case MI_PALETTE:  palIdx = (uint8_t)((palIdx + (dir > 0 ? 1 : PAL_COUNT - 1)) % PAL_COUNT);
                      rebuildPalette(); break;
    case MI_INVERT:   invertShades = !invertShades; rebuildPalette(); break;
    case MI_SOUND:    soundSetOn(!soundOn); break;
    case MI_VOLUME:   {
                        // v9.7: мягкий лимит 10% (выше — мерцание подсветки от тока
                        // усилителя; громче в этой консоли не нужно), шаг 2
                        int v = (int)volPct + dir * 2;
                        if (v < 0) v = 0;
                        if (v > 10) v = 10;
                        volPct = (uint8_t)v;
                      } break;
    default: return;
  }
  drawMenu();
}

static void menuConfirmDraw(void) {                  // v9.1: вопрос «слот занят чужой игрой»
  char nm[17], line[26], full[25];
  romNameByCrc(menuConfirmHash, full, sizeof(full));
  snprintf(nm, sizeof(nm), "%s", full); nm[16] = 0;
  uiClear(0);
  snprintf(line, sizeof(line), "SLOT %d BUSY", menuConfirmSlot + 1);
  uiTextCentered(36, 2, line, 3);
  snprintf(line, sizeof(line), "'%s'", nm);
  uiTextCentered(66, 2, line, 3);
  uiTextCentered(96, 2, "IS SAVED HERE", 2);
  uiTextCentered(132, 2, "A=OVERWRITE", 3);
  uiTextCentered(158, 2, "B=BACK", 1);
  uiPush();
}

static void menuActivate(void) {
  switch (menuSel) {
    case MI_GAMES:
      romMenuOpen();
      return;
    case MI_SAVE1: case MI_SAVE2: {
      const int slot = (menuSel == MI_SAVE1) ? 0 : 1;
      uint32_t fh = 0;                                          // v9.1: чужой стейт затираем только с вопросом
      if (ssSlotForeign(slot, &fh)) { menuConfirmSlot = slot; menuConfirmHash = fh; menuConfirmDraw(); return; }
      snprintf(menuMsg, sizeof(menuMsg), ssSave(slot) ? "SAVED SLOT %d" : "SAVE FAILED", slot + 1);
      Serial.println(menuMsg);
      break; }
    case MI_LOAD1: case MI_LOAD2: {
      const int slot = (menuSel == MI_LOAD1) ? 0 : 1;
      snprintf(menuMsg, sizeof(menuMsg), ssLoad(slot) ? "LOADED SLOT %d" : "EMPTY SLOT %d", slot + 1);
      Serial.println(menuMsg);
      break; }
    case MI_RESET:
      saveStore(false);
      gb_reset(&gb); gb.direct.joypad = 0xFF;
      snprintf(menuMsg, sizeof(menuMsg), "RESET DONE");
      break;
    case MI_PROBE:
      toneStart();
      return;
    case MI_RESUME:
      ui = UI_GAME;
      return;
    default: return;
  }
  drawMenu();
}

static void menuOpen(void) {
  ui = UI_MENU; menuSel = 0; menuMsg[0] = 0; menuPrev = 0xFFFF;
  drawMenu();
  Serial.println(F("Меню: UP/DOWN — выбор, LEFT/RIGHT — значение, A — выполнить, B — выход."));
}

static void menuTick(uint16_t mask) {
  const uint16_t press = (uint16_t)(mask & ~menuPrev);
  menuPrev = mask;
  if (menuConfirmSlot >= 0) {                                  // v9.1: вопрос про чужой стейт
    if (press & (1u << 4)) {
      const int sl = menuConfirmSlot; menuConfirmSlot = -1;
      snprintf(menuMsg, sizeof(menuMsg), ssSave(sl) ? "SAVED SLOT %d" : "SAVE FAILED", sl + 1);
      Serial.println(menuMsg); drawMenu();
    } else if (press & ((1u << 5) | (1u << 8))) {
      menuConfirmSlot = -1; Serial.println(F("запись отменена: чужой стейт цел.")); drawMenu();
    }
    return;
  }
  if (press & (1u << 0)) { menuSel = (menuSel + MI_COUNT - 1) % MI_COUNT; menuMsg[0] = 0; drawMenu(); }
  if (press & (1u << 1)) { menuSel = (menuSel + 1) % MI_COUNT;          menuMsg[0] = 0; drawMenu(); }
  if (press & (1u << 2)) menuAdjust(-1);
  if (press & (1u << 3)) menuAdjust(+1);
  if (press & (1u << 4)) menuActivate();                       // A
  if (press & ((1u << 5) | (1u << 8))) { ui = UI_GAME; }        // B или MENU — выход
}

// ============================================================ ЗВУК: APU + ШИМ
// Из дампа стока: звук выводится ШИМ-ом на GPIO17 (слайс 0), TOP = 689 —
// это 690 уровней, «тишина» = 344. Кормится он прерыванием по PWM, а данные
// берёт из кольцевого буфера (400 семплов в ОЗУ). Мы делаем так же, только
// семплы считает APU Game Boy (apu_gb.h) по регистрам, которые отдаёт ядро.
//
// GP20: сток держит его в 1 при старте, но ПЕРЕД «писком» опускает в 0 —
// это разрешение усилителя (проба: LOW = звук, HIGH = тишина).
// v9.3: GP20 = LOW всё время, пока звук включён. Переключений по тишине больше
// нет (они щёлкали усилителем — «треск» — и мигали подсветкой); режим AMP из
// меню убран.
static void ampApply(void) {
  // v9.4: стартовое состояние — «звук идёт»; о тишине позаботится прерывание
  gAmpSil = 0;
  gAmpOn  = soundOn ? 1 : 0;
  digitalWrite(PIN_AMP, gAmpOn ? LOW : HIGH);
}

static void audioHwInit(void) {
  gpio_set_function(PIN_AUDIO, GPIO_FUNC_PWM);
  const uint slice = pwm_gpio_to_slice_num(PIN_AUDIO);
  pwm_config cfg = pwm_get_default_config();
  pwm_config_set_clkdiv(&cfg, 1.0f);
  pwm_config_set_wrap(&cfg, APU_PWM_TOP);
  pwm_init(slice, &cfg, true);
  pwm_set_gpio_level(PIN_AUDIO, APU_PWM_IDLE);
}

// прерывание таймера: 45 мкс = 22222 Гц — считаем один семпл и пишем в ШИМ.
// Считаем и его стоимость: 22 000 прерываний в секунду — это заметная доля
// процессора, и её полезно видеть в статистике (а не догадываться).
static uint32_t apuIrqUs = 0, apuIrqN = 0;

// v8.9p: ЧЕСТНАЯ СТАТИСТИКА. Раньше окно накопления начиналось в момент предыдущего
// доклада, и если между докладами консоль стояла в меню (или в списке игр) 30 секунд,
// то по строкам «звук-прерывание N шт/с», «ожидание DMA» и «fps» было видно не игру,
// а меню: например «fps=1 (1 %)» и «звук 152755 шт/с» сразу после запуска игры. Теперь
// окно сбрасывается, как только мы возвращаемся из меню/списка в игру.
static void statsClear(void) {
  statFrames = 0; statEmuUs = statAllUs = 0; statN = 0;
  statDrawUs = statDrawN = statSkipUs = statSkipN = statSpiWaitUs = 0;
  statCoreUs = statCoreN = 0;
  cbAccUs = cbCalls = 0; spiCallAcc = 0; spiCalls = 0; spiWaitAcc = 0; txRowAcc = 0;
  txDmaRows = 0; txDmaWaitAcc = 0;
  rowLoopAcc = rowLoopN = 0; txRowsOk = txRowsFail = 0;
  apuIrqUs = 0; apuIrqN = 0;
  statT0 = millis();
}

// v9.6: МЯГКИЙ ОГРАНИЧИТЕЛЬ ПИКОВ. Ток усилителя (и «дыхание» питания с мерцанием
// подсветки) пропорциональны РАЗМАХУ сигнала. Громче 120 уровней ШИМ сжимаем 3:1:
// тише становятся только пики, основная громкость музыки не трогается.
#define APU_LIM_K 120
static inline int32_t limSwing(int32_t sw) {
  if (sw >  APU_LIM_K) return APU_LIM_K + (sw - APU_LIM_K) / 3;
  if (sw < -APU_LIM_K) return -APU_LIM_K + (sw + APU_LIM_K) / 3;
  return sw;
}

static bool __attribute__((section(".time_critical.gbapu"))) apuIsr(repeating_timer_t *) {
  // Отметки прохождения прерывания (scratch[6]) — по ним в отчёте после зависания
  // видно, встал главный цикл или само прерывание звука, и на каком шаге.
  //   1 = вошли, 2 = перед синтезом семпла, 3 = синтез прошёл, пишем в ШИМ
  watchdog_hw->scratch[6] = 1;
  const uint32_t t = micros();
  int32_t lvl = APU_PWM_IDLE;
  if (soundOn && !soundPause) {
    watchdog_hw->scratch[6] = 2;
    if (gFade < 256) gFade++;                        // v9.3: плавный вход (анти-щелчок)
    // v9.3: цифровой «разделительный конденсатор» (apuDcBlock): смещение каналов
    // и ступеньки вкл/выкл не доходят до динамика, фейд гасит меню/паузу за ~12 мс.
    const int32_t s = (apuDcBlock(apuTick()) * gFade) >> 8;
    lvl = apuLevelVol(s, volNow(), 280);
  } else if (gFade) {
    watchdog_hw->scratch[6] = 2;
    gFade--;                                         // v9.3: затухание, а не обрыв на IDLE
    lvl = apuLevelVol((apuDcBlock(0) * gFade) >> 8, volNow(), 280);
    if (!gFade) { apuDcReset(); lvl = APU_PWM_IDLE; }
  }
  watchdog_hw->scratch[6] = 3;
  lvl = (uint16_t)(APU_PWM_IDLE + limSwing((int32_t)lvl - APU_PWM_IDLE));   // v9.6: пики под контролем
  pwm_set_gpio_level(PIN_AUDIO, lvl);
  // v9.4: усилитель — только на время звука (как в стоке): тишина 2 с подряд —
  // глушим (заодно гасим gFade, чтобы следующий звук вошёл мягко, без щелчка).
  if (soundOn) {
    if (lvl != APU_PWM_IDLE) {
      gAmpSil = 0;
      if (!gAmpOn) { gAmpOn = 1; digitalWrite(PIN_AMP, LOW); }
    } else if (gAmpOn && ++gAmpSil >= AMP_MUTE_TICKS) {
      gAmpOn = 0; gAmpSil = 0; gFade = 0;
      digitalWrite(PIN_AMP, HIGH);
    }
  }
  apuIrqUs += micros() - t;
  apuIrqN++;
  watchdog_hw->scratch[6] = 0;

  // ЛОВУШКА ПРОСАДКИ ПИТАНИЯ (v8.9h): каждый 8-й тик — один замер батареи.
  // Подробности в dipSample() ниже; здесь только расписание.
  if ((++gAdcTick & 7u) == 0u && !gAdcSweep) dipSample();

  // ДЕТЕКТОР ЗАЛИПАНИЯ (v8.8). Прерывание звука продолжает идти, даже если
  // главный цикл встал намертво. Значит по пропавшему «пульсу» цикла видно: это
  // НЕ сбой ядра, а вечное ожидание внутри кадра. Сообщаем и уходим.
  if (gBeatArm && !gStalled && (uint32_t)(micros() - gBeat) > STALL_US) {
    gStalled = true;
    // ВАЖНО: печатать из прерывания БЕСПОЛЕЗНО (по той же причине, что и из
    // обработчика сбоя: пока мы в прерывании, USB не выгружается). Поэтому:
    // подробности — в чёрный ящик, а печать — в обычном потоке: зажигаем сбой,
    // штатный обработчик вернёт управление в faultAftermath(), и он всё расскажет.
    gDieA = (uint32_t)spi_get_hw(spi0)->sr;
    gDieB = (uint32_t)gb.cpu_reg.pc.reg;
    gDieC = (uint32_t)frameLineCore;
    gDieD = (uint32_t)millis();
    mark(PH_STALL);
#ifndef GBEMU_HOST
    if (blkOn) blkWrite();
    faultTriggerNow();
#else
    dieReport(PH_STALL, gDieA, gDieB, gDieC, gDieD);
#endif
  }
  return true;
}

// v8.9p: МЯГКИЙ СТАРТ ЗВУКА. Сразу после смены игры громкость входит не скачком, а
// за 2 с. Усилитель (GP20) при этом включается постепенно — шаг нагрузки вверх меньше.
static uint32_t volRampMs = 0, volRampT0 = 0;
#define VOL_RAMP_MS 2000

// Громкость прямо сейчас (с учётом мягкого входа). Вызывается из прерывания звука,
// поэтому только арифметика: ни millis-циклов, ни печати.
static uint8_t volNow(void) {
  if (!volRampMs) return volPct;
  const uint32_t dt = (uint32_t)(millis() - volRampT0);
  if (dt >= volRampMs) { volRampMs = 0; return volPct; }
  return (uint8_t)((uint32_t)volPct * dt / volRampMs);
}

// Намеренный сбой: пишем в несуществующую периферию. Нужен только для того,
// чтобы «вынырнуть» из прерывания в обычный поток (см. доклад о залипании).
static void faultTriggerNow(void) {
#ifndef GBEMU_HOST
  __asm volatile ("dsb sy" ::: "memory");
  *(volatile uint32_t *)0x50000000u = 1u;         // 0x5000_0000 — пусто на RP2040
#endif
}

static void soundResume(void) {
  if (!soundOn || apuTimerOn) return;
  apuTimerOn = add_repeating_timer_us(-(int64_t)apuTmrUs, apuIsr, NULL, &apuTmr);
}

// Сменить период семпла (перезапускает таймер, если он идёт).
static void soundSetPeriod(uint16_t us) {
  if (us < 45) us = 45;                        // 45 мкс = 22222 Гц (норма для DMG)
  if (us > 130) us = 130;                      // медленнее 7.7 кГц не нужно
  if (us == apuTmrUs) return;
  apuTmrUs = us;
  if (apuTimerOn) { cancel_repeating_timer(&apuTmr); apuTimerOn = false; }
  soundResume();
}

static void soundSuspend(void) {
  if (apuTimerOn) { cancel_repeating_timer(&apuTmr); apuTimerOn = false; }
  pwm_set_gpio_level(PIN_AUDIO, APU_PWM_IDLE);
  apuDcReset();                              // v9.3: фильтр/фейд — в ноль (возврат без щелчка)
  gFade = 0;
}

// Раз в секунду подстраиваем темп звука под реальную скорость эмуляции.
static void soundSyncTick(void) {
  if (statFps) syncEmaFps = (syncEmaFps * 3 + statFps) / 4;    // сглаживание, чтобы не «плыло»
  if (soundSync) soundSetPeriod((uint16_t)((45UL * 60UL + syncEmaFps / 2) / syncEmaFps));
  else           soundSetPeriod(45);
}

static void soundSetOn(uint8_t on) {
  soundOn = on ? 1 : 0;
  if (soundOn) { audioHwInit(); soundResume(); }
  else soundSuspend();
  ampApply();
}

static void soundInit(void) {
#ifndef GBEMU_HOST
  gStackTop = readMsp() & ~3u;                  // верх стека — по нему считаем глубину
#endif
  pinMode(PIN_AMP, OUTPUT);
  irq_set_priority(TIMER_IRQ_0, 0x40);       // v9.3: прерывание таймера звука выше USB — меньше джиттер
  audioHwInit();
  apuReset();
  ampApply();
  soundResume();
  Serial.print(F("звук: ")); Serial.print(soundOn ? F("вкл") : F("выкл"));
  Serial.print(F(", громкость ")); Serial.print(volPct);
  Serial.print(F("%, усилитель: GP20 = LOW на время звука (v9.4: 2 с тишины — глушим)"));
  Serial.println();
}

// когда открыто меню/пауза — молчим, иначе залипнет последняя нота
static void soundUpdatePause(void) {
  soundPause = (ui != UI_GAME || paused) ? 1 : 0;
}

// ============================================================ ПРОБА ЗВУКА (ручная)
// Шесть опытов, которые нужно слушать. Переключение — только вручную:
//   короткое нажатие MENU — следующий опыт,
//   удержание MENU >= 0,8 с — повторить текущий,
//   любая клавиша в Serial — выйти из пробы.
// Перед каждым опытом подсветка мигает N+1 раз (N — номер опыта), как вы просили.
// Сам сигнал длится 3 с и генерируется «плотно» (микросекундные задержки), иначе
// на 1,25 кГц и 4 кГц частота бы «плыла» из-за медленного loop().
#define PROBE_N 6
// 0 = меандр 1,25 кГц (ровно как стоковый «писк»), 1 = ШИМ 440 Гц (качели 60..630),
// 2 = меандр 4 кГц (для пьезо-пищалки), 3 = развёртка 300 Гц..3 кГц
static const uint8_t PROBE_KIND[PROBE_N] = { 0, 0, 1, 1, 2, 3 };
static const uint8_t PROBE_AMP[PROBE_N]  = { HIGH, LOW, HIGH, LOW, HIGH, LOW };

static int      probeIdx = 0;
static uint8_t  probePhase = 0;         // 0 мигаем, 1 играем, 2 ждём MENU, 3 выход
static int      probeBlink = 0;
static uint32_t probeT0 = 0;
static bool     probeMenuDown = false;
static uint32_t probeMenuT0 = 0;


static const char *probeName(int i) {
  switch (PROBE_KIND[i]) {
    case 0: return "SQUARE";
    case 1: return "PWM 290k";
    case 2: return "SQUARE 4k";
    default: return "SWEEP";
  }
}
static const char *probeDesc(int i) {
  switch (PROBE_KIND[i]) {
    case 0: return "1.25 kHz, raw GPIO";
    case 1: return "440 Hz on 290 kHz";
    case 2: return "4 kHz, raw GPIO";
    default: return "300 Hz -> 3 kHz";
  }
}

static void probeSignalStop(void) {
  if (PROBE_KIND[probeIdx] == 1) pwm_set_gpio_level(PIN_AUDIO, APU_PWM_IDLE);
  else { digitalWrite(PIN_AUDIO, LOW); pinMode(PIN_AUDIO, INPUT); }
  digitalWrite(PIN_AMP, HIGH);
}

static void probeSignalStart(void) {
  digitalWrite(PIN_AMP, PROBE_AMP[probeIdx]);
  if (PROBE_KIND[probeIdx] == 1) {
    audioHwInit();                       // ШИМ как в стоке: TOP = 689
  } else {
    pinMode(PIN_AUDIO, OUTPUT);
    digitalWrite(PIN_AUDIO, LOW);
  }
}

// Три секунды сигнала: блокируем loop(), но слушаем Serial (любая клавиша — стоп).
static void probePlaySignal(void) {
  mark(PH_PROBE);
  const uint32_t t0 = millis();
  const uint8_t  kind = PROBE_KIND[probeIdx];
  uint32_t edge = micros();
  uint8_t  high = 0;
  while ((millis() - t0) < 3000) {
    wdtFeed();
    if (Serial.available()) { probePhase = 3; return; }
    uint32_t half;
    if (kind == 0)      half = 400;                       // 1,25 кГц
    else if (kind == 1) half = 1136;                      // 440 Гц
    else if (kind == 2) half = 125;                       // 4 кГц
    else {                                                // развёртка 300..3000 Гц
      const uint32_t f = 300 + (millis() - t0) * 900;
      half = 500000UL / f;
    }
    while ((int32_t)(micros() - edge) < (int32_t)half) { }
    edge += half;
    high ^= 1;
    if (kind == 1) pwm_set_gpio_level(PIN_AUDIO, high ? 630 : 60);
    else           digitalWrite(PIN_AUDIO, high ? HIGH : LOW);
  }
}

static void drawTone(void) {
  char b[34];
  uiClear(0);
  uiTextCentered(10, 3, "SOUND PROBE", 3);
  snprintf(b, sizeof(b), "%d / %d", probeIdx + 1, PROBE_N);
  uiTextCentered(50, 3, b, 3);
  uiTextCentered(84, 3, probeName(probeIdx), 3);
  uiTextCentered(118, 2, probeDesc(probeIdx), 2);
  snprintf(b, sizeof(b), "AMP: GP20 = %s", PROBE_AMP[probeIdx] ? "HIGH" : "LOW");
  uiTextCentered(146, 2, b, 2);
  uiTextCentered(174, 2, probePhase == 0 ? "BLINKS = TEST NUMBER" : "LISTEN 3 SECONDS", 1);
  uiTextCentered(190, 2, "SHORT MENU = NEXT TEST", 1);
  uiTextCentered(202, 2, "HOLD MENU  = REPEAT", 1);
  uiTextCentered(214, 2, "A / B = EXIT (NO RESET NEEDED)", 1);
  uiPush();
}

static void probeBegin(int idx) {
  probeIdx = ((idx % PROBE_N) + PROBE_N) % PROBE_N;
  probePhase = 0; probeBlink = 0; probeT0 = millis(); probeMenuDown = false;
  probeLastMs = probeT0;
  Serial.print(F("=== опыт ")); Serial.print(probeIdx + 1); Serial.print(F("/")); Serial.print(PROBE_N);
  Serial.print(F(": ")); Serial.print(probeName(probeIdx)); Serial.print(F(", "));
  Serial.print(probeDesc(probeIdx)); Serial.print(F(", GP20="));
  Serial.print(PROBE_AMP[probeIdx] ? F("HIGH") : F("LOW"));
  Serial.print(F(" (миганий: ")); Serial.print(probeIdx + 2); Serial.println(F(")"));
  drawTone();
}

static uint8_t toneBlSaved = 255;       // v8.9u: подсветка до пробы (после — вернём её)
static void toneStart(void) {
  soundSuspend();                       // ШИМ звука игры выключаем — пин свободен
  toneBlSaved = backlight;              // мигаем родной яркостью, а не насильными 200
  probeBegin(0);
  ui = UI_TONE;
  Serial.println(F("Слушайте динамик. Перед опытом подсветка мигает N+1 раз (N — номер опыта)."));
  Serial.println(F("выход в любой момент: кнопка A или B, любая клавиша здесь, либо 20 с тишины."));
  Serial.println(F("ресет для выхода не нужен — проба конечная и закрывается сама."));
}

static void toneStop(void) {
  probeSignalStop();
  lightRaw(toneBlSaved);   // v8.9y: вернуть как было (крутилку не трогаем)
  audioHwInit();
  soundSetOn(soundOn);                  // вернуть звук эмулятора
  ui = emuInited ? UI_GAME : UI_NOROM;
  if (!emuInited) drawNoRom();
  Serial.println(F("Проба звука остановлена."));
}

static void toneTick(uint16_t mask) {
  const uint32_t now = millis();

  if (probePhase == 3) { toneStop(); return; }

  // v8.9t: ВЫЙТИ ИЗ ПРОБЫ МОЖНО ВСЕГДА — кнопкой A или B. Раньше выход был только по
  // клавише в терминале, и случайно нажавший z искал зубочистку для ресета.
  if (mask & ((1u << 4) | (1u << 5))) {              // A или B
    Serial.println(F("выход из пробы по кнопке — ресет не нужен."));
    toneStop(); return;
  }
  // и сама кончается, если её оставили без внимания
  if (probeLastMs && (uint32_t)(now - probeLastMs) > 20000UL) {
    Serial.println(F("проба звука: 20 с без действий — выхожу сама (ресет не нужен)."));
    toneStop(); return;
  }
  if (mask) probeLastMs = now;                       // любое нажатие — это «занят»

  if (probePhase == 0) {                               // подсветка мигает N+1 раз
    const int total = (probeIdx + 2) * 2;              // N+1 миганий = 2*(N+1) переключений
    if (probeBlink < total) {
      lightRaw(((now - probeT0) < 140) ? toneBlSaved : 0);   // v8.9y: мимо потолков
      if ((now - probeT0) >= 280) { probeT0 = now; probeBlink++; }
      return;
    }
    lightRaw(toneBlSaved);
    probeSignalStart();
    drawTone();
    Serial.println(F("  сигнал пошёл (3 с)..."));
    probePlaySignal();                                 // блокирующие 3 с
    if (probePhase == 3) { toneStop(); return; }
    probeSignalStop();
    probePhase = 2;
    Serial.println(F("  тишина. MENU: коротко — дальше, удержать — повторить."));
    drawTone();
    return;
  }

  // probePhase == 2: ждём MENU (коротко — дальше, удержание — повтор)
  const bool down = (mask & (1u << 8)) != 0;
  if (down && !probeMenuDown) { probeMenuDown = true; probeMenuT0 = now; }
  else if (!down && probeMenuDown) {
    probeMenuDown = false;
    probeBegin((now - probeMenuT0 >= 800) ? probeIdx : probeIdx + 1);
  } else if (down && probeMenuDown && (now - probeMenuT0) >= 800) {
    probeBegin(probeIdx);                              // удержание = повтор
  }
}

// карта flash — чтобы видеть, сколько осталось под другие игры
static void printFlashMap(void) {
  const uintptr_t end = (flashEnd + 4095u) & ~(uintptr_t)4095u;
  const uint32_t usedEnd = ssReady ? (ssOff[SS_SLOTS - 1] + (uint32_t)ssLen)
                                   : (uint32_t)(end - flashBase) + (uint32_t)saveLen;
  const uint32_t freeB = (usedEnd < FLASH_LIMIT) ? (FLASH_LIMIT - usedEnd) : 0;
  Serial.println(F("--- карта flash (2 МБ) ---"));
  Serial.print(F("  прошивка (скетч+ядро): ")); Serial.print((uint32_t)(end - flashBase) / 1024); Serial.println(F(" КиБ"));
  if (romCount) {
    Serial.print(F("  картриджи (список):    ")); Serial.print(romKib / 1024); Serial.print(F(" КиБ в "));
    Serial.print(romCount); Serial.print(F(" играх, занимают 0x")); Serial.print((uint32_t)ROMS_TABLE_OFF, HEX); Serial.print(F("..0x"));
    Serial.print((uint32_t)(ROMS_DATA_OFF + (uint32_t)romKib * 1024u), HEX); Serial.println();
    Serial.print(F("  свободно в области:    ")); Serial.print((FLASH_LIMIT - ROMS_DATA_OFF - (uint32_t)romKib * 1024u) / 1024);
    Serial.println(F(" КиБ (добавить игры: пересобрать games.uf2)"));
  } else {
    Serial.print(F("  встроенная игра:       ")); Serial.print(ROM_SIZE / 1024); Serial.println(F(" КиБ (rom.h)"));
  }
  Serial.print(F("  сейвы SRAM:           ")); Serial.print(bankCount * saveLen / 1024);
  Serial.print(F(" КиБ (")); Serial.print(bankCount); Serial.println(F(" ячейки по игре)"));
  Serial.print(F("  сейвстейты:           ")); Serial.print(SS_SLOTS * ssLen / 1024); Serial.println(F(" КиБ"));
  Serial.print(F("  СВОБОДНО (под игры):   ")); Serial.print(freeB / 1024); Serial.println(F(" КиБ"));
  Serial.print(F("  размер сейвстейта:    ")); Serial.print((256 + sizeof(struct gb_s) + sizeof(cartRam)) / 1024);
  Serial.print(F(" КиБ (gb_s ")); Serial.print(sizeof(struct gb_s)); Serial.println(F(" Б + SRAM 32 КиБ)"));
}

static void printSlotState(void) {
  for (int i = 0; i < SS_SLOTS; i++) {
    const uint8_t *p = (const uint8_t *)(flashBase + ssOff[i]);
    uint32_t magic = 0, romH = 0;
    memcpy(&magic, p, 4); memcpy(&romH, p + 8, 4);
    Serial.print(F("  слот ")); Serial.print(i + 1); Serial.print(F(": "));
    if (magic == SS_MAGIC && romH == romFingerprint()) Serial.println(F("сейв этой игры"));
    else if (magic == SS_MAGIC) Serial.println(F("сейв другой игры (не загрузится)"));
    else Serial.println(F("пусто"));
  }
}

// ============================================================ СПИСОК ИГР: разбор таблицы
// Таблицу кладёт упаковщик. Здесь только ЧИТАЕМ: список игр на износ flash не
// влияет вообще (единственная запись — 4 КиБ «какая игра» в своём секторе, и та
// только при смене игры).
static void romScan(void) {
  romCount = 0; romKib = 0; romSramMax = 0; romCur = -1;
  romMenuSel = 0; romMenuTop = 0;
  romBase = ROM_DATA; romSize = ROM_SIZE; romMask = ROM_MASK; romSaveKey = 0;
  const uint8_t *t = (const uint8_t *)(flashBase + ROMS_TABLE_OFF);
  uint32_t magic = 0, count = 0, used = 0;
  memcpy(&magic, t, 4); memcpy(&count, t + 4, 4); memcpy(&used, t + 8, 4);
  if (magic != ROMS_MAGIC || count == 0 || count > ROM_MAX) {
    Serial.println(F("Картриджи: списка игр во flash нет."));
    if (ROM_SIZE >= 0x150) Serial.println(F("   Играю во встроенную игру (rom.h)."));
    else Serial.println(F("   Собрать список: python make_roms_uf2.py game1.gb game2.gb ..."));
    return;
  }
  for (uint32_t i = 0; i < count; i++) {
    RomEntry e;
    memcpy(&e, t + 16 + i * sizeof(RomEntry), sizeof(e));
    e.name[ROM_NAME_LEN - 1] = 0;
    // «Живой» считаем только запись, чей образ реально лежит в области картриджей:
    // нельзя выйти за границы и нельзя принять за игру чужой сектор.
    if (e.size < 0x8000 || (e.size & (e.size - 1)) != 0) continue;      // размер — степень двойки >= 32 КиБ
    if (e.off < ROMS_DATA_OFF || e.off + e.size > FLASH_LIMIT) continue;
    const uint8_t *r = (const uint8_t *)(flashBase + e.off);
    // Признак настоящей игры: логотип Nintendo в заголовке ИЛИ верная сумма заголовка.
    // (Хватает одного: у самодельных сборок логотип иногда вырезан, а сумма верна,
    // и наоборот — у пропатченных она не сходится, а логотип на месте.)
    const bool logoOk = (r[0x104] == 0xCE && r[0x105] == 0xED);
    // Контрольная сумма заголовка — как её считает сама Game Boy: из 0 вычитаем
    // байты 0x134..0x14C с переносом, результат должен совпасть с байтом 0x14D.
    uint8_t csum = 0;
    for (uint32_t k = 0x134; k <= 0x14C; k++) csum = (uint8_t)(csum - r[k] - 1);
    const bool sumOk = (csum == r[0x14D]);
    if (!logoOk && !sumOk) continue;
    if (romCount >= ROM_MAX) break;
    romList[romCount] = e;
    romKib += (e.size + 4095u) / 4096u * 4u;
    if (e.sram > romSramMax) romSramMax = e.sram;
    romCount++;
  }
  if (romCount == 0) {
    Serial.println(F("Картриджи: таблица есть, но ни один образ не на месте."));
    return;
  }
  Serial.print(F("Картриджи: "));
  Serial.print(romCount); Serial.print(F(" игр, ")); Serial.print(romKib); Serial.print(F(" КиБ"));
  Serial.print(romKib); Serial.print(F(" КиБ"));
  // (v8.9p) в таблице лежит УЖЕ готовое число КиБ; раньше мы делили его ещё раз и в
  // логе появлялось «960 КиБ (в таблице 0 КиБ)».
  Serial.println(F(":"));
  for (int i = 0; i < romCount; i++) {
    Serial.print(F("   ")); if (i + 1 < 10) Serial.print(' ');
    Serial.print(i + 1); Serial.print(F(") ")); Serial.print(romList[i].name);
    Serial.print(F("  ")); Serial.print(romList[i].size / 1024); Serial.print(F(" КиБ"));
    if (romList[i].sram) { Serial.print(F(", сейв ")); Serial.print(romList[i].sram / 1024); Serial.print(F(" КиБ")); }
    Serial.println();
  }
}

static bool romStateLoad(int *out) {
  const uint8_t *p = (const uint8_t *)(flashBase + ROMS_STATE_OFF);
  uint32_t magic = 0, idx = 0, len = 0;
  memcpy(&magic, p, 4); memcpy(&idx, p + 4, 4); memcpy(&len, p + 8, 4);
  if (magic != ROMS_STATE_MAGIC || len != 3u * sizeof(uint32_t) || idx >= (uint32_t)ROM_MAX) return false;
  *out = (int)idx;
  return true;
}

// «Какая игра выбрана» — отдельный сектор. Пишем ТОЛЬКО если выбор изменился:
// сперва читаем содержимое и, если там уже нужное, flash не трогаем вовсе.
// v8.9q: сектор «какая игра» пишем ТОЛЬКО в списке игр — в момент выбора, пока эмулятор
// ещё НЕ запущен (экран списка статичен, панель не молотит кадры, звук молчит). В самой
// игре flash не трогаем ВООБЩЕ: стирание сектора в игре = сброс по RUN (см. лог v8.9p,
// где все пять смертей пришлись ровно на выгрузку ящика). Если питание в момент выбора
// просевшее — запись откладываем до выключения.
static int romStatePending = -1;               // выбор, который надо записать при выключении

static void romStateWriteNow(int idx) {
  uint8_t pg[256];
  memset(pg, 0xFF, sizeof(pg));
  const uint32_t magic = ROMS_STATE_MAGIC, i = (uint32_t)idx, len = 3u * sizeof(uint32_t);
  memcpy(pg, &magic, 4); memcpy(pg + 4, &i, 4); memcpy(pg + 8, &len, 4);
  quietFlashBegin();                             // v8.9q: тихая запись
  noInterrupts();
  flash_range_erase(ROMS_STATE_OFF, 4096u);
  flash_range_program(ROMS_STATE_OFF, pg, 256);
  interrupts();
  quietFlashEnd();
}

static void romStateSave(int idx) {
  if (idx < 0) return;
  int cur = -1;
  if (romStateLoad(&cur) && cur == idx) return;  // уже записано — flash не трогаем
  if (!battGuardOk()) {                          // питание просевшее — не рискуем
    romStatePending = idx; gGuardDefers++;
    Serial.println(F("«какая игра»: питание просевшее — запишу при выключении (в игре flash не трогаю)"));
    return;
  }
  romStateWriteNow(idx);
  romStatePending = -1;
  Serial.print(F("какая игра выбрана — записано ("));
  Serial.print(idx + 1); Serial.println(F(")"));
}

// При выключении: дописать выбор, который ждал лучшего питания (экран там уже погашен).
static void romStateFlushAtExit(void) {
  if (romStatePending < 0) return;               // ждать нечего
  const int idx = romStatePending;
  romStatePending = -1;
  Serial.print(F("«какая игра»: дописываю выбор (")); Serial.print(idx + 1); Serial.println(F(")"));
  romStateWriteNow(idx);
}

// ============================================================ СПИСОК ИГР: экран
static void romMenuOpen(void) {
  ui = UI_ROMS;
  romMenuPrev = 0xFFFF;
  romMenuMsg[0] = 0;
  romMenuSel = (romCur >= 0 && romCur < romCount) ? romCur : 0;
  romMenuTop = 0;
  romMenuDraw();
  Serial.println(F("СПИСОК ИГР: UP/DOWN — выбор, A — играть, B — назад."));
}

static void romMenuDraw(void) {
  char line[40];
  uiClear(0);
  if (romCount <= 0) {
    uiTextCentered(60,  4, "GAMES", 3);
    uiTextCentered(120, 3, "NO GAMES IN FLASH", 2);
    uiTextCentered(150, 3, "RUN MAKE_ROMS_UF2.PY", 2);
    uiTextCentered(180, 3, "B - BACK", 1);
    uiPush();
    return;
  }
  snprintf(line, sizeof(line), "GAMES  %d", romCount);
  uiText(8, 4, 2, line, 2);
  battUiHeader(4);   // v8.9v: иконка + вольты справа
  // 11 строк по 17 px: 22..210 помещаются над подсказкой
  if (romMenuSel < romMenuTop) romMenuTop = romMenuSel;
  if (romMenuSel >= romMenuTop + 11) romMenuTop = romMenuSel - 10;
  if (romMenuTop > romCount - 1) romMenuTop = romCount - 1;
  if (romMenuTop < 0) romMenuTop = 0;
  for (int i = 0; i < 11; i++) {
    const int idx = romMenuTop + i;
    if (idx >= romCount) break;
    const int y = 24 + i * 17;
    if (idx == romMenuSel) uiRect(2, y - 2, MEM_W - 4, 13, 1);
    char nm[25];
    snprintf(nm, sizeof(nm), "%s", romList[idx].name);
    nm[16] = 0;                                   // 16 знаков при масштабе 2 — 128 px
    snprintf(line, sizeof(line), "%c%2d %s S%2u",
             (idx == romCur) ? '*' : ' ', idx + 1, nm, (unsigned)(romList[idx].size / 512 / 1024));
    uiText(6, y, 2, line, 3);
    if (romList[idx].sram) {                                    // v9.1: квадратик ярче и шире, если сейв уже лежит
      if (saveHasGame(romList[idx].crc)) uiRect(MEM_W - 14, y + 3, 10, 4, 3);
      else uiRect(MEM_W - 8, y + 3, 4, 4, 2);
    }
  }
  snprintf(line, sizeof(line), "%sUP/DN A=PLAY B=BACK", romMenuMsg);
  uiTextCentered(228, 1, line, 1);
  uiPush();
}

static void saveConfirmDraw(void) {                  // v9.1: вопрос «чей сейв пострадает»
  char nm[17], line[26], full[25];
  romNameByCrc(saveConfirmKey, full, sizeof(full));
  snprintf(nm, sizeof(nm), "%s", full); nm[16] = 0;
  uiClear(0);
  uiTextCentered(36, 2, "SAVE CONFLICT", 3);
  uiTextCentered(66, 2, "SAVE OF", 2);
  snprintf(line, sizeof(line), "'%s'", nm);
  uiTextCentered(92, 2, line, 3);
  uiTextCentered(122, 2, "WILL BE REPLACED", 2);
  uiTextCentered(158, 2, "A=REPLACE+PLAY", 3);
  uiTextCentered(184, 2, "B=BACK", 1);
  uiPush();
}

static void romMenuLaunch(int idx) {
  Serial.print(F("Запускаю: ")); Serial.println(romList[idx].name);
  if (romStart(idx, true)) {
    ui = UI_GAME;
    for (int i = 0; i < 6; i++) { delay(60); wdtFeed(); }    // заставка успела показаться
  } else {
    snprintf(romMenuMsg, sizeof(romMenuMsg), "LAUNCH FAILED ");
    romMenuDraw();
  }
}

static void romMenuActivate(void) {
  if (romMenuSel < 0 || romMenuSel >= romCount) return;
  if (romMenuSel == romCur && emuInited) { ui = UI_GAME; Serial.println(F("Эта игра уже идёт.")); return; }
  const int idx = romMenuSel;                                  // v9.1: вытеснение чужого сейва — только с вопросом
  if (romList[idx].sram && saveLen && bankCount > 0) {
    int vv = -1; uint32_t vk = 0;
    if (saveEvictPending(romList[idx].crc, &vv, &vk) && vk != romList[idx].crc) {
      saveConfirmGame = idx; saveConfirmVictim = vv; saveConfirmKey = vk;
      saveConfirmDraw(); return;
    }
  }
  romMenuLaunch(idx);
}

static void romMenuTick(uint16_t mask) {
  const uint16_t press = (uint16_t)(mask & ~romMenuPrev);
  romMenuPrev = mask;
  if (saveConfirmGame >= 0) {                              // v9.1: вопрос про вытеснение сейва
    if (press & (1u << 4)) {
      const int gi = saveConfirmGame, vi = saveConfirmVictim;
      saveConfirmGame = -1; saveConfirmVictim = -1;
      saveKillBank(vi);
      romMenuSel = gi; romMenuLaunch(gi);
    } else if (press & ((1u << 5) | (1u << 8))) {
      saveConfirmGame = -1; saveConfirmVictim = -1;        // B/MENU — назад в список
      Serial.println(F("запуск отменён: чужой сейв цел."));
      romMenuDraw();
    }
    return;
  }
  if (romCount <= 0) {                            // игр нет: список бесполезен
    if (mask) { ui = emuInited ? UI_GAME : UI_NOROM; if (!emuInited) drawNoRom(); }
    return;
  }
  if (press & (1u << 0)) { romMenuSel = (romMenuSel + romCount - 1) % romCount; romMenuMsg[0] = 0; romMenuDraw(); }
  if (press & (1u << 1)) { romMenuSel = (romMenuSel + 1) % romCount;          romMenuMsg[0] = 0; romMenuDraw(); }
  if (press & (1u << 4)) { romMenuActivate(); return; }                       // A — запустить
  if (press & (1u << 5)) { if (romCur < 0) romMenuDraw(); else { ui = emuInited ? UI_GAME : UI_NOROM; if (!emuInited) drawNoRom(); } }   // B — назад (v9.1: без запущенной игры остаёмся в списке)
}

// ============================================================ СПИСОК ИГР: запуск
// Возвращает false, если запустить не удалось (тогда состояние прежней игры
// восстановить нельзя — честно скажем об этом в логе).
static bool romStart(int idx, bool splash) {
  const bool running = emuInited;
  if (settingsDirty()) settingsStore();   // v9.7.2: настройки переживут и reset/пропадание питания
  if (idx >= 0) {
    if (idx >= romCount) return false;
    romBase = (const uint8_t *)(flashBase + romList[idx].off);
    romSize = romList[idx].size;
    romMask = romList[idx].size - 1;
    romSaveKey = romList[idx].crc;
  } else {
    romBase = ROM_DATA; romSize = ROM_SIZE; romMask = ROM_MASK; romSaveKey = 0;
  }
  if (running) soundSuspend();                    // во время работы ядра шину не трогаем
  const uint32_t t0 = millis();
  memset(cartRam, 0, sizeof(cartRam));            // чужую память сохранений не тянем
  cartDirty = false; saveHash = 0; romSaved = false;

  enum gb_init_error_e e = gb_init(&gb, cb_rom_read, cb_cart_read, cb_cart_write, cb_error, NULL);
  if (e != GB_INIT_NO_ERROR) {
    Serial.print(F("!! gb_init ошибка: ")); Serial.println((int)e);
    romBase = ROM_DATA; romSize = ROM_SIZE; romMask = ROM_MASK; romSaveKey = 0;
    if (running) soundResume();
    return false;
  }
  // v8.9p: МЯГКИЙ СТАРТ. Смена игры — самый тяжёлый момент для питания: ядро уходит в
  // 100 %, панель начинает качать кадры, включается звук с усилителем. Разводим это:
  // сначала 0,4 с эмуляции без панели, а громкость входит за 2 с.
  panelHoldUntil = millis() + PANEL_HOLD_MS;
  if (running) { volRampT0 = millis(); volRampMs = VOL_RAMP_MS; }
  gSagT0 = millis(); gSagMin = 4095; gSagMax = 0; gSagDone = false;

  gb.direct.joypad = 0xFF;
  gb.direct.frame_skip = true;                    // 30 кадр/с на панель, логика 60 Гц
  gb.display.lcd_draw_line = cb_lcd_line;
  gb_colour_hash(&gb);
  memset(romTitle, 0, sizeof(romTitle));
  gb_get_rom_name(&gb, romTitle);

  // Сейвы: размер ячейки — по самой «жадной» игре списка (раскладка не должна
  // меняться от того, что запущено), ячеек — по числу игр (но не больше SAVE_BANKS).
  size_t saveSize = 0;
  if (gb_get_save_size_s(&gb, &saveSize) != 0) saveSize = 0;
  const size_t ownSaveSize = saveSize;            // память сохранений именно этой игры
  if (romSramMax > saveSize) saveSize = romSramMax;
  const bool gameSaves = (ownSaveSize > 0);       // есть ли память сохранений у ЭТОЙ игры
  saveActive = false;
  if (romCount == 0) {
    if (!gameSaves) {
      saveLen = 0; bankCount = 0;
      Serial.println(F("У этой игры нет памяти сохранений — автосейв выключен (писать нечего)."));
    } else {
      saveInit(saveSize, 1);
      saveActive = (saveLen > 0);
      saveBind(0);
      romSaved = saveActive && saveLoad();
    }
  } else {
    // Раскладка ячеек одна на весь список (по самой «жадной» игре), поэтому она не
    // зависит от того, что запущено. Ячейка игры без памяти сохранений тоже метится
    // её ключом, но писать в неё нечего — saveActive не даст.
    saveInit(saveSize, romCount);
    saveActive = (saveLen > 0 && gameSaves);
    saveBind(romSaveKey);
    romSaved = saveActive && saveLoad();
    if (!gameSaves) Serial.println(F("У этой игры нет памяти сохранений — автосейв выключен (писать нечего)."));
  }
  ssInit();                                       // сейвстейты: раскладка могла измениться
  if (idx >= 0) { romCur = idx; romStateSave(idx); }
  if (running) soundResume();

  Serial.print(romCur >= 0 ? F("ИГРА: ") : F("ROM: ")); Serial.print(romTitle);
  Serial.print(F("  ")); Serial.print(romSize / 1024); Serial.print(F(" КиБ"));
  Serial.print(F("  MBC=")); Serial.print((int)gb.mbc);
  Serial.print(F("  ")); Serial.print(millis() - t0); Serial.print(F(" мс"));
  Serial.println(romSaved ? F("  сейв восстановлен") : F("  сейва нет"));
  // v8.9p: понятная строка про сохранения (раньше «SRAM=8192 Б» и рядом «нет памяти
  // сохранений» сбивали с толку: первое — размер картриджа, второе — есть ли сейв у игры).
  if (!saveLen) {
    Serial.println(F("  сохранения игры: НЕТ места во flash под сейвы — писать некуда"));
  } else if (ownSaveSize) {
    Serial.print(F("  сохранения игры: ")); Serial.print((unsigned)ownSaveSize / 1024);
    Serial.print(F(" КиБ в ячейке ")); Serial.print(saveBank + 1); Serial.print(F(" из "));
    Serial.print(bankCount); Serial.print(F(" (ячейка ")); Serial.print(saveLen / 1024);
    Serial.println(F(" КиБ, чтобы размер не «прыгал» между играми)"));
  } else {
    Serial.println(F("  сохранения игры: у этой игры памяти сохранений нет — автосейв выключен"));
  }

  if (splash) {
    splashLeft = 1;
    splashNeutral = false;   // v8.9v: игру выбрали — показываем её название
    drawSplash();
    for (int i = 0; i < 20; i++) { delay(100); wdtFeed(); }   // заставка: кормим сторожа
  }
  return true;
}

// ============================================================ режимы при включении
// Функция вынесена отдельно, чтобы её можно было проверить на стенде (там кнопки
// подставляются программно). В setup() она вызывается сразу после настройки кнопок.
static void applyBootModes(void) {
  blkLogFlash = (millis() < 20000);            // первые 20 с: каждая операция с flash — в лог

  // Смысл: если в каком-то режиме консоль живёт долго, а в обычном умирает за
  // полсекунды — виновник найден без паяльника.
  if (digitalRead(BTN_GPIO[7]) == LOW) {        // SELECT
    soundOn = 0;
    Serial.println(F("SELECT зажат при включении: звук выключен на старте (проверка «дело в звуке?»)."));
  }
  if (digitalRead(BTN_GPIO[5]) == LOW) {        // B
    liteMode = true; soundOn = 0;
    Serial.println(F("B зажат при включении: ЛЁГКИЙ РЕЖИМ — подсветка выключена, звук и усилитель выключены,"));
    Serial.println(F("   SPI панели 41,7 МГц. Если так консоль живёт долго, а обычно нет — дело в нагрузке/питании."));
  }
  if (digitalRead(BTN_GPIO[0]) == LOW) {        // UP — то же, что по умолчанию (оставлено для ясности)
    Serial.println(F("UP зажат при включении: ящик в ОЗУ (это и есть обычное поведение с v8.9k)."));
  }
  if (digitalRead(BTN_GPIO[6]) == LOW) {        // START — «умный ящик»: выгрузка между кадрами
    blkSafeFlush = true;
    Serial.println(F("START зажат при включении: УМНЫЙ ЯЩИК — отметки в ОЗУ, а во flash они"));
    Serial.println(F("   выгружаются раз в 5 с МЕЖДУ кадрами (когда панель молчит — как автосейв)."));
    Serial.println(F("   Так и играть можно, и след на диске остаётся."));
  }
  if (digitalRead(BTN_GPIO[4]) == LOW) {        // A — ящик как раньше (контроль)
    blkEraseInPlay = true;
    Serial.println(F("A зажат при включении: ЯЩИК КАК РАНЬШЕ — со стираниями секторов прямо в игре"));
    Serial.println(F("   (контроль: так консоль выключалась; нужно только чтобы показать разницу)."));
  }
  if (digitalRead(BTN_GPIO[1]) == LOW) {        // DOWN
    blkOn = false;
    Serial.println(F("DOWN зажат при включении: чёрный ящик ВЫКЛЮЧЕН (проверка «не в записи ли во flash дело»)."));
  }
  if (digitalRead(BTN_GPIO[3]) == LOW) {        // RIGHT — тихая панель
    quietPanel = true;
    Serial.println(F("RIGHT зажат при включении: ТИХАЯ ПАНЕЛЬ — SPI панели 20,8 МГц (самый мягкий"));
    Serial.println(F("   режим для питания). Если и так выключается — панель не виновата."));
  }
  if (digitalRead(BTN_GPIO[2]) == LOW) {        // LEFT
    noPanelMode = true;
    Serial.println(F("LEFT зажат при включении: ПАНЕЛЬ НЕ ТРОГАЕМ (SPI молчит) — эмуляция идёт, экран не обновляется."));
  }
  Serial.print(F("ящик: "));
  if (!blkOn)               Serial.println(F("выключен — во flash не пишем (режим DOWN)."));
  else if (blkEraseInPlay)  Serial.println(F("как раньше — со стираниями в игре (контрольный режим A)."));
  else if (blkSafeFlush)    Serial.println(F("ОЗУ + выгрузка во flash между кадрами раз в 5 с (режим START)."));
  else Serial.println(F("в игре во flash НЕ ПИШЕМ ВООБЩЕ: отметки в ОЗУ (16 последних), во flash —\n"
                        "   при выключении. Именно так консоль проиграла длинную сессию без сбоев."));
}

// ============================================================ setup
void setup(void) {
  // --- САМОЕ ПЕРВОЕ: держим питание (как сток: GPIO1 — ключ питания) ---
  pinMode(PIN_PWR_HOLD, OUTPUT); digitalWrite(PIN_PWR_HOLD, HIGH);
  pinMode(PIN_EN12, OUTPUT);     digitalWrite(PIN_EN12, HIGH);
  pinMode(PIN_EN20, OUTPUT);     digitalWrite(PIN_EN20, HIGH);
  // ВАЖНО НА БУДУЩЕЕ: при ЛЮБОЙ перезагрузке (в том числе от сторожа) все выводы
  // на мгновение становятся «входом», то есть ключ питания (GPIO1) отпускается —
  // и консоль может выключиться вместо перезагрузки (именно так, похоже, и было:
  // зависание -> сброс сторожа -> питание ушло, отчёта в логе нет).
  // Поэтому включаем на этом выводе встроенную ПОДТЯЖКУ ВВЕРХ: в работе она не
  // мешает (вывод ведём мы), а в момент сброса удерживает ключ включённым.
  gpio_set_pulls(PIN_PWR_HOLD, true, false);

  // v9.7: сторож — СРАЗУ, с самых первых шагов загрузки. Раньше он включался
  // почти в конце setup(): если консоль вешалась на старте (такое бывало после
  // выключения — не запускалась, пока не ткнуть RESET), она висела навсегда.
  // Теперь любой сбой на старте перезагрузится сам через ~4 с, а в журнале
  // останется отметка, где именно это случилось.
  watchdog_enable(WD_MS, false);

  Serial.begin(115200);
  while (!Serial && millis() < 2500) { wdtFeed(); delay(10); }
  faultTrapInstall();                        // ловушка аппаратного сбоя (HardFault)
  bootReport();                              // что случилось в прошлый раз
  blkInit();                                 // и что лежит в чёрном ящике (стирать не будем)
  blkRead();
  Serial.print(F("ловушка: дальше след по кадрам 1.."));
  Serial.print(BLK_TRAP);
  Serial.println(F(" (две записи на кадр — по ним видно, на чём встали);"));
  Serial.println(F("   ящик НЕ стираю: слоты идут по кругу, сектор стирается только когда кольцо вернётся к занятому слоту."));
  Serial.print(F("свидетели: сбой ядра ловим (адрес будет в логе), залипание цикла —"));
  Serial.print(STALL_US / 1000); Serial.println(F(" мс без движения"));
  Serial.print(F("карта адресов: строка=")); Serial.print((uint32_t)(uintptr_t)&cb_lcd_line, HEX);
  Serial.print(F(" ядро="));  Serial.print((uint32_t)(uintptr_t)&gb_run_frame, HEX);
  Serial.print(F(" вывод=")); Serial.print((uint32_t)(uintptr_t)&txRow, HEX);
  Serial.print(F(" звук="));  Serial.print((uint32_t)(uintptr_t)&apuIsr, HEX);
  Serial.print(F(" цикл="));  Serial.print((uint32_t)(uintptr_t)&loop, HEX);
  Serial.print(F(" сбой="));  Serial.println((uint32_t)(uintptr_t)&gbHardFaultC, HEX);
  Serial.println();
  Serial.println(F("=== GB EMULATOR " GBEMU_BUILD " (RP2040 + ST7789 240x240) ==="));
  Serial.println(F("новое (v9.7): настройки переживают выключение, громкость мягко ограничена 10%,"));
  Serial.println(F("       выключение долгим нажатием везде (не только в игре), сторож с первых шагов."));
  Serial.println(F("сборка: ловушка просадки питания (2777 замеров в секунду), режим «тихая панель»,"));
  Serial.println(F("        батарея читается с A3, усилитель как в стоке (GP20 только на время звука), причина сброса из чипа,"));
  Serial.println(F("        сторож питания (все каналы АЦП, дежурство 0,25 с), след о снятии питания,"));
  Serial.println(F("        доклад из обычного потока, выровненная строка, свидетели стека, режимы-изоляторы"));
  Serial.print(F("CPU: ")); Serial.print(F_CPU / 1000000U); Serial.println(F(" МГц"));
  if (F_CPU < 240000000UL)
    Serial.println(F("ВНИМАНИЕ: поставьте Tools -> CPU Speed -> 250 MHz."));
#if defined(__OPTIMIZE_SIZE__)
  Serial.println(F("!!! ВНИМАНИЕ: сборка с -Os (Optimize = Smallest)."));
  Serial.println(F("!!! Поставьте Tools -> Optimize -> Fastest (-O3) и пересоберите — это +20-40%."));
#endif
  printCorePlace();
  spiRaisePeriClock();               // без этого SPI панели остаётся 24 МГц
  watchdog_enable(WD_MS, false);     // если консоль где-то встанет — перезагрузится сама
  Serial.print(F("сторож: ")); Serial.print(WD_MS);
  Serial.println(F(" мс (встанет — перезагрузится сам; в логе будет видно, где)"));
  wdtFeed();                                   // и сразу кормим: окно отсчитывается от установки

  settingsLoad();                        // v9.7: настройки прошлого сеанса (до палитры)
  for (int i = 0; i < NBTN; i++) joyMap[i] = BTN_JOY[i];
  rebuildPalette();

  pinMode(PIN_BL, OUTPUT);
  analogWriteFreq(25000);   // v9.6: ШИМ подсветки ультразвуковой (было 1000 — видимое
                            // мерцание, которое ещё и усиливало мерцание от тока усилителя;
                            // звук живёт на своём слайсе GP17/slice 0 и не трогается)
  lightApply();   // v8.9y: 255/255/255 (крутилка/потолок/сброс)
  // v9.7: мягкий старт подсветки (0 → цель за ~300 мс): резкий всплеск тока
  // на старте — один из кандидатов «консоль не стартует, помогает только RESET».
  {
    const uint8_t tgt = backlight;
    for (int i = 1; i <= 5; i++) { analogWrite(PIN_BL, (int)tgt * i / 6); delay(40); wdtFeed(); }
    analogWrite(PIN_BL, tgt);
  }

  SPI.setRX(PIN_MISO);
  // ВНИМАНИЕ, ЛОВУШКА (на ней v7 и повис с чёрным экраном):
  // SPI.setCS() в arduino-pico для SPI0 принимает ТОЛЬКО пины 1, 5, 17 или 21.
  // Любой другой пин — это panic(): плата печатает в Serial
  //   «FATAL: Attempting to set SPI0.CS to illegal pin N» и НАМЕРТВО встаёт.
  // CS панели у нас GP3 и дёргается вручную (csL/csH), а SPI.begin() внутри
  // вызывает begin(false) — то есть аппаратный CS вообще не включается и пин из
  // _CS не трогается. Поэтому setCS() здесь не нужен ВООБЩЕ: GP17 остаётся
  // свободным под ШИМ звука.
  SPI.setSCK(PIN_SCK);
  SPI.setTX(PIN_MOSI);
  SPI.begin();                       // == begin(false): hwCS выключен, CS не занимается
  SPI.beginTransaction(SPISettings(SPI_HZ, MSBFIRST, SPI_MODE0));
  spiSetClock(SPI_HZ_TAB[spiHzIdx]);     // v9.7: восстановленная частота панели (или дефолт)

  lcdInit();
  Serial.print(F("шаг 1: экран инициализирован, SPI "));
  Serial.print(spi_get_baudrate(spi0) / 1000000.0f, 1);
  Serial.println(F(" МГц (по умолчанию самая быстрая — на ней игра идёт ровно 60 кадр/с; клавиша o — переключить)"));
  printSpiTruth();
  for (int i = 0; i < NBTN; i++) pinMode(BTN_GPIO[i], INPUT_PULLUP);   // ПОСЛЕ SPI: GP16 = SPI0.RX
  // Если при включении держать SELECT — стартуем с ВЫКЛЮЧЕННЫМ звуком. Это проверка
  // «а не звук ли роняет консоль»: держите SELECT, включая консоль.
  applyBootModes();                             // режимы «зажать кнопку при включении»
  uiClear(0);
  Serial.println(F("шаг 2: гашу экран (первый кадр)..."));
  rowsValid = false;                             // v9.7.1: зачистка обязана дойти до панели целиком
  uiPush();                                    // гасим все 240 строк (лечит полосы и следы прошлого кадра)
  txDmaInit();                                 // строки будут уходить через DMA
  Serial.println(txDmaReady
    ? F("вывод: строки уходят через DMA (двойной буфер) — ядро не ждёт панель (клавиша u — сравнить)")
    : F("вывод: DMA недоступен, остаюсь на синхронной записи строк"));
  Serial.print(F("шаг 3: первый кадр отправлен, вывод: "));
  Serial.print(txPathName());
  Serial.print(F(", строк ")); Serial.print(frameRows);
  Serial.print(F(", ")); Serial.print(frameRows * (uint32_t)ROW_BYTES); Serial.println(F(" байт"));
  // v8.9o: сперва смотрим, что лежит в области картриджей. Если там список игр —
  // играем в ту, что была выбрана в прошлый раз (или в первую). Если списка нет —
  // во встроенную игру из rom.h, как раньше.
  romScan();
  if (romCount) { saveInit(romSramMax, romCount); ssInit(); }   // v9.1: раскладка сейвов сразу (метки + проверка вытеснения)
  int bootIdx = -1;
  bool bootNeedChoice = false;                                 // v9.1: автозапуск отменён из-за чужого сейва
  if (romCount) {
    int last = -1;
    bootIdx = (romStateLoad(&last) && last < romCount) ? last : 0;
  } else if (ROM_SIZE < 0x150) {
    Serial.println(F("Игры нет: ни списка во flash, ни встроенной (rom.h = заглушка)."));
    ui = UI_NOROM;
    drawNoRom();
    return;
  }
  if (romCount && bootIdx >= 0 && romList[bootIdx].sram && saveLen && bankCount > 0) {
    int vv = -1; uint32_t vk = 0;                       // v9.1: вытеснение на старте — не молча, а через список
    if (saveEvictPending(romList[bootIdx].crc, &vv, &vk) && vk != romList[bootIdx].crc) {
      Serial.println(F("автозапуск отменён: игра вытеснила бы чужой сейв — выбирайте в списке (там спросят)."));
      bootNeedChoice = true;
    }
  }
  if (!bootNeedChoice && !romStart(bootIdx, false)) {
    Serial.println(F("!! запустить игру не удалось — экран «NO ROM»"));
    ui = UI_NOROM; drawNoRom();
    return;
  }

  battInit(); battRead(); battPrint();         // прибор питания: читаем датчик
  if (quietPanel) {
    spiHzIdx = 3; spiSetClock(SPI_HZ_TAB[3]);  // 20,8 МГц
    Serial.println(F("тихая панель: SPI 20,8 МГц."));
  }
  if (liteMode) {
    setBacklight(0);                           // выключаем подсветку (главный потребитель)
    soundSetOn(0);                             // звук и усилитель — тоже прочь
    spiHzIdx = 2; spiSetClock(SPI_HZ_TAB[2]);  // 41,7 МГц: мягче для питания
    Serial.println(F("лёгкий режим включён: подсветка 0, звук выкл, SPI 41,7 МГц."));
  }
  // v8.9y: на старте панель/яркость НЕ трогаем (скорость не режем никогда) —
  // потолок яркости по заряду применится сам на первом замере батареи.
  ui = UI_SPLASH; splashLeft = 1;
  splashNeutral = (romCount > 1);   // v8.9v: список игр впереди — заголовок нейтральный
  drawSplash();
  for (int i = 0; i < 20; i++) { delay(100); wdtFeed(); }   // заставка: кормим сторожа

  emuInited = true;
  ui = UI_GAME;
  if (romCount > 1) {                        // игр несколько — показываем список, пусть выберет
    Serial.println(F("Игр несколько: UP/DOWN — выбор, A — играть (то же в меню: GAMES, и клавиша c)."));
    romMenuOpen();
  } else if (bootNeedChoice) {                 // v9.1: одна игра, но она вытеснила бы чужой сейв — пусть подтвердят
    romMenuOpen();
  }
  statT0 = millis();
  soundInit();                       // APU + ШИМ на GP17 (и усилитель GP20, см. строку AMP)
  printHelp();
  Serial.println(F("Играем: вывод 30 кадр/с (клавиша f — переключить на 60)."));
  Serial.println(F("setup: готов, вхожу в цикл (первые 30 кадров печатаю по строке — по ним видно, где встанет)"));
  mark(PH_LOOP);
}

// ============================================================ loop
static uint32_t nextFrameUs = 0;

void loop(void) {
  gBeat = micros(); gBeatN++;                  // пульс: по нему детектор видит залипание
  if (ui == UI_GAME && romCount > 0 && romCur < 0) romMenuOpen();   // v9.1: игра не запущена — только список
  if (!gBeatArm) gBeatArm = true;               // включаем детектор только когда цикл уже идёт
  gLcdOn = (gb.hram_io[IO_LCDC] & 0x80) ? 1 : 0;
  wdtTick();                                   // «кормим» сторожа: консоль жива
  blkTick();                                   // 0,25 с (первая минута) / 5 с — отметка в ящик
  blkSafeTick();                               // (режим START) выгрузка во flash, только если панель свободна
  // v8.9q: ЗДЕСЬ БОЛЬШЕ НЕТ НИ ВЫГРУЗКИ ЯЩИКА, НИ ЗАПИСИ «КАКАЯ ИГРА»: в игре во flash не
  // пишем вообще. В логе v8.9p все пять сбросов оборвались на строке «ящик: выгружаю во
  // flash отметок …» — то есть на стирании сектора (это ~50 мс, за которые батарея садится
  // ниже порога внешней схемы, и она сбрасывает чип по RUN). След просадки копится в ОЗУ
  // (16 последних отметок) и уходит во flash при выключении, когда экран уже погашен;
  // «какая игра» пишется в списке игр — до старта эмулятора.
  mark(PH_LOOP);
  handleSerial();
  soundUpdatePause();               // в меню/на паузе не синтезируем (нет залипших нот)

  // v8.9q: мягкий порог (3,55 В) — роняем нагрузку ЗАРАНЕЕ, не дожидаясь обрыва.
  if (gShedAsk) {
    gShedAsk = false;
    if (gShedAuto) shedLoad(false);
  }
  shedTick();                        // v8.9r: и ВОЗВРАЩАЕМ яркость, когда стало тихо

  // v8.9t: раз в минуту смотрим НАГРЕВ кристалла (не врущее абсолютное значение).
  // Единственная реальная опасность разгона до 250 МГц — перегрев.
  {
    static uint32_t tempChkMs = 0;
    if ((uint32_t)(millis() - tempChkMs) > 60000UL) {
      tempChkMs = millis();
      int rise = 0;
      const int mv = tempReadMv(&rise);
      if (mv && rise >= TEMP_RISE_WARN) {
        Serial.print(F("!! чип греется: +")); Serial.print(rise);
        Serial.println(F(" °C к базовому замеру (это уже не вранье датчика — это нагрев)."));
        Serial.println(F("   что можно сделать сейчас: f (30 кадр/с), o (панель медленнее),"));
        Serial.println(F("   [ (яркость ниже), x (звук выкл). Если корпус горячий — напишите,"));
        Serial.println(F("   сделаю переключатель частоты ядра (250 -> 133 МГц) клавишей."));
      }
    }
  }

  // ПРОСАДКА ПИТАНИЯ: докладываем из обычного цикла (из прерывания печатать нельзя)
  if (gDipWarn) {
    gDipWarn = false; gDipEvents++;
    mark(PH_DIP);
    Serial.print(F("!! ПРОСАДКА ПИТАНИЯ: батарея просела до "));
    Serial.print((uint32_t)gDipMin * 3300u / 4096u * 2); Serial.print(F(" мВ ("));
    Serial.print((uint32_t)gDipMin * 2 * 3300u / 4096u / 1000.0f, 2);
    Serial.print(F(" В) при норме "));
    Serial.print((uint32_t)battBRaw * 2 * 3300u / 4096u / 1000.0f, 2); Serial.println(F(" В"));
    Serial.println(F("   это и есть объяснение: питание клюёт, внешняя схема от этого сбрасывает чип по RUN"));
    Serial.println(F("   что помогает: клавиша [ (яркость ниже), o (SPI панели ниже), x (звук выкл)"));
    // v8.9p: ЗДЕСЬ БОЛЬШЕ НЕТ ЗАПИСИ ВО FLASH. Раньше в этот момент мы делали полный
    // перебор каналов АЦП и выгрузку чёрного ящика (стирание + запись сектора) — то
    // есть добавляли нагрузку ровно тогда, когда питание и так на грани. Отметка о
    // просадке уже лежит в кольце ОЗУ и уйдёт во flash при выключении, когда питания
    // будет достаточно.
    // v8.9q: здесь больше НЕ ставим отложенную выгрузку ящика: именно она (стирание сектора
    // в игре) и роняла консоль. След остаётся в ОЗУ и уйдёт во flash при выключении.
    Serial.println(F("   (во flash не пишу и в игре вообще не буду: след остаётся в ОЗУ, уйдёт при выключении)"));
    Serial.flush();
    // Автосброс нагрузки: временно опускаем яркость до 50 % (скорость не трогаем).
    if (gShedAuto && (uint32_t)(millis() - gShedLastMs) > SHED_COOLDOWN_MS) shedLoad(true);
  }

  // v8.9p: доклад «как питание живёт после запуска игры» — через 2,5 с после старта.
  if (!gSagDone && (uint32_t)(millis() - gSagT0) >= SAG_WINDOW_MS) {
    gSagDone = true;
    const uint32_t idle = (uint32_t)battBRaw * 2u * 3300u / 4096u;      // холостое (последний замер)
    const uint32_t lo   = (uint32_t)((gSagMin > 4000) ? 0 : gSagMin) * 2u * 3300u / 4096u;
    const uint32_t hi   = (uint32_t)gSagMax * 2u * 3300u / 4096u;
    if (gSagMax == 0) {
      // Замеров не было: ловушка просадки живёт в прерывании звука, а он выключен.
      Serial.println(F("питание после запуска игры: замеров не было (звук выключен — ловушка молчит)"));
    } else {
      Serial.print(F("питание после запуска игры: "));
      Serial.print(hi / 1000.0f, 2); Serial.print(F(" В (лучшее) .. "));
      Serial.print(lo / 1000.0f, 2); Serial.print(F(" В (худшее), холостое "));
      Serial.print(idle / 1000.0f, 2); Serial.print(F(" В => просадка "));
      Serial.print((idle > lo) ? (idle - lo) : 0); Serial.println(F(" мВ"));
      Serial.println(F("   (если просадка больше ~200 мВ — при запуске игры питанию не хватает:"));
      Serial.println(F("    поможет зарядка, кнопка x (звук выкл), [ (яркость ниже), o (панель медленнее))"));
    }
  }

  mark(PH_KEYS);
  const uint16_t mask = readMask();
  const bool holding = holdTick(mask);

  if (ui == UI_NOROM) {
    static uint16_t prev = 0xFFFF;
    if (mask != prev) { prev = mask; drawButtonScreen("TEST", mask, "GPIO NUMBERS"); }
    delay(20);
    return;
  }
  if (ui == UI_TEST) {
    static uint16_t prev = 0xFFFF;
    if (mask != prev) {
      prev = mask;
      drawButtonScreen("TEST", mask, "GPIO NUMBERS");
      Serial.print(F("mask=0x")); Serial.print((int)mask, HEX); Serial.print(F("  нажато: "));
      for (int i = 0; i < NBTN; i++) if (mask & (1u << i)) { Serial.print(BTN_NAME[i]); Serial.print(' '); }
      Serial.println();
    }
    delay(20);
    return;
  }
  if (ui == UI_LEARN) { learnTick(mask); delay(5); return; }
  if (ui == UI_MENU)  { menuTick(mask); delay(5); return; }
  if (ui == UI_ROMS)  { romMenuTick(mask); delay(5); return; }
  if (ui == UI_TONE)  { toneTick(mask); delay(2); return; }
  if (ui == UI_SHADES) { if (mask) { ui = UI_GAME; } else { delay(20); return; } }
  if (!emuInited) { ui = UI_NOROM; drawNoRom(); return; }
  if (paused || holding) { delay(5); return; }

  // ------- игра -------
  uint8_t joy = 0xFF;
  for (int i = 0; i < NBTN; i++)
    if (joyMap[i] && (mask & (1u << i))) joy &= (uint8_t)~joyMap[i];
  gb.direct.joypad = joy;

  // предсказываем, будет ли peanut рисовать этот кадр (режим 30 кадр/с):
  // на пропущенном кадре на панель НЕ отправляем ничего — картинка остаётся прежней
  // (v8.9p) и первые 0,4 с после смены игры панель тоже не трогаем — «мягкий старт»
  const bool panelHold = (int32_t)(panelHoldUntil - millis()) > 0;
  const bool willDraw = !noPanelMode && !panelHold && !(gb.direct.frame_skip && !gb.display.frame_skip_count);

  // Ждём, пока уедет прошлый кадр: строка идёт сразу в панель, и начинать новый
  // кадр, пока старый ещё на шине, нельзя. Дольше 3 мс не ждём — если панель не
  // успела, этот кадр пропускаем целиком (картинка не портится, просто на кадр старше).
  gateWaits++;
  mark(PH_GATE);
  const bool panelBusy = !txWaitIdle(TX_GUARD_US);
  if (panelBusy) {
    gateSkips++;
    if (gateSkips <= 3) Serial.println(F("!! панель не успела принять прошлый кадр — пропускаю вывод этого кадра"));
  }
  const bool drawThis = willDraw && !panelBusy;   // рисуем только если панель готова
  drawThisDbg = drawThis;

  if (gFramesTotal < 5) {                      // первые кадры: пишем начало и итог
    Serial.print(F("кадр ")); Serial.print(gFramesTotal + 1); Serial.print(F(": начало (путь "));
    Serial.print(txPathName()); Serial.println(F(")"));
  }
  const uint32_t t0 = micros();                 // начало всего кадра
  stackWitness();                               // свидетель стека: самая глубокая точка
  if (drawThis) { frameStart(); rowBl(GAME_TOP); }
  mark(PH_CORE);
  blkTrap();                                    // ЛОВУШКА: «вот этот кадр начал считаться»
  const uint32_t tc0 = micros();                // начало работы ядра
  gb_run_frame(&gb);
  const uint32_t t1 = micros();                 // конец работы ядра
  mark(PH_FINISH);
  txCheckHealth();                               // если SPI встал — перезапустим шину и скажем в лог
  gFramesTotal++;
  { const uint32_t fr = micros() - t0; if (fr > 30000U) gSlowFrames++; }
  if (drawThis) {
    statCoreUs += t1 - tc0; statCoreN++;
    // добиваем кадр до конца окна: в норме строк уже 240, а если ядро отдало
    // меньше (или строки не ушли из-за сбоя) — низ экрана будет чёрным,
    // а не «остатками прошлого кадра»
    if (frameRows < MEM_H) rowBlTail(MEM_H - frameRows);   // v8.9v: внизу полосы — индикатор батареи
    frameFinish();
  }
  const uint32_t t2 = micros();
  if (drawThis) watchdog_hw->scratch[7] = (uint32_t)gb.cpu_reg.pc.reg;   // «последний вздох»: где игра
  blkTrap();                                    // ЛОВУШКА: «кадр закончен»

  mark(PH_TRACE);
  if (gFramesTotal <= 30) {                    // по строке на кадр: где время и где встало
    // Печатаем ОДНОЙ строкой и только если USB может её принять. Блокирующий
    // Serial.print ждёт хост бесконечно — именно так прошивка могла «встать
    // намертво» на 12-м кадре, когда терминал не успевал читать.
    char line[220];
    if (!drawThis) {                           // пропущенный кадр: 30 кадр/с или мягкий старт
      snprintf(line, sizeof(line), "кадр %lu: пропущен (%s)",
               (unsigned long)gFramesTotal,
               noPanelMode ? "панель не трогаем (режим при включении)"
                           : (panelHold ? "мягкий старт: панель ещё отдыхает после запуска игры"
                                        : "30 кадр/с: на панель идёт каждый второй кадр"));
    } else {
      // СТРАЖ: физику не обмануть. Если за кадр «ушло» больше байт, чем шина может
      // передать за это время — значит часть данных на самом деле не ушла.
      const uint32_t cap = (uint32_t)((uint64_t)spi_get_baudrate(spi0) * (t2 - t0) / 8000000ULL);
      snprintf(line, sizeof(line),
               "кадр %lu: всего %lu мкс, ядро %lu, выход %lu, строк %lu (проп %lu), байт в панель %lu из %lu возможных%s",
               (unsigned long)gFramesTotal, (unsigned long)(t2 - t0), (unsigned long)(t1 - t0),
               (unsigned long)(t2 - t1), (unsigned long)frameRows, (unsigned long)frameSkip,
               (unsigned long)txBytesFrame,
               (unsigned long)cap,
               (txBytesFrame > cap + cap / 20) ? "  !! БОЛЬШЕ ПРЕДЕЛА — данные не уходят!" : "");
    }
    traceLine(line);
  }

  if (diagFrames && --diagFrames == 0) diagReport(&gb);

  statFrames++;
  statEmuUs += (t1 - t0);
  statAllUs += (drawThis ? (t2 - t0) : (t1 - t0));
  if (drawThis) { statDrawUs += (t2 - t0); statDrawN++; }
  else          { statSkipUs  += (t1 - t0); statSkipN++; }
  statN++;

  // автосейв
  // Автосейв — раз в 2 минуты (было 30 с): игры обычно пишут в SRAM часто, а каждое
  // сохранение — это стирания секторов. При выключении и по клавише 'w' сохраняем сразу.
  if (cartDirty && saveLen && (millis() - lastSaveMs) > 120000 && battGuardOk()) saveStore(false);

  if (millis() - statT0 >= 1000) {
    statFps  = statFrames;                 // эмулированных кадров в секунду
    avgEmuUs = statN ? statEmuUs / statN : 0;
    avgAllUs = statN ? statAllUs / statN : 0;
    avgDrawUs = statDrawN ? statDrawUs / statDrawN : 0;
    avgSkipUs = statSkipN ? statSkipUs / statSkipN : 0;
    avgWaitUs = statN ? spiWaitAcc / statN : 0;   // (в v7.1/v7.2 здесь читалась всегда нулевая переменная)
    avgCoreUs = statCoreN ? statCoreUs / statCoreN : 0;
    avgCbUs   = statN ? cbAccUs / statN : 0;
    avgCbUsPer= cbCalls ? cbAccUs / cbCalls : 0;
    avgSpiUs  = statN ? spiCallAcc / statN : 0;
    avgSpiCalls = statN ? spiCalls / statN : 0;
    avgCbCalls = statN ? cbCalls / statN : 0;
    avgRowUs   = txRowsOk ? txRowAcc / txRowsOk : 0;
    avgRowsW   = statN ? txRowsOk / statN : 0;
    avgRowsL   = txRowsFail;
    avgDmaBad  = spiStuck;
    avgSpiSyncUs = statN ? txRowAcc / statN : 0;
    avgDmaRows   = statN ? txDmaRows / statN : 0;
    avgDmaWaitUs = statN ? txDmaWaitAcc / statN : 0;
    avgIrqUs   = apuIrqN ? apuIrqUs / apuIrqN : 0;   // средняя стоимость одного прерывания звука
    avgIrqN    = apuIrqN;
    statsClear();

    markTick();                            // отметка «сколько прожили» — для отчёта сторожа
    soundSyncTick();                       // темп звука под скорость игры
    mark(PH_STATUS);
    printStatus();
  }

  // пейсинг 59.7 кадр/с
  const uint32_t now = micros();
  if (nextFrameUs == 0) nextFrameUs = now;
  nextFrameUs += FRAME_US;
  const int32_t wait = (int32_t)(nextFrameUs - now);
  if (wait > 0) {
    if (wait > 2000) delay((wait - 1500) / 1000);
    while ((int32_t)(micros() - nextFrameUs) < 0) { }
  } else {
    nextFrameUs = now;
  }
}
